/*@@var:*/
variables
{

dword gCycCheckId;

dword glbHandle = 0; //file handle
long resWait;

byte byte0RQ;
byte byte1RQ;
byte byte0R;
byte byte1R;
byte byte2R;
byte byte0;

MESSAGE TEST_MSG_ENGINE_REQ msgengReq;
MESSAGE TEST_MSG_ENGINE_RES msgengRes;


}
/*@@end*/

/*@@mainTest:MainTest():*/
void MainTest()
{
  
  //preconditions
  //  TestWaitForMessage(0x050,10000); //wait for response
  // if(resWait)
  // { write(" msgReq byte0 %X      msgRes byte0 %X", msgengReq.byte(0) ,msgengRes.byte(0));}
  // else
  //   { write("message not arrived"); }
  // TestWaitForTimeout(15000);

   write("*****************************");
   write(" Engine Validation Test");
   write("*****************************");
   write(" ");


  TestGroupBegin("Message Read", "Check the engine ID and RPM");
    
   TestCase5();


  TestGroupEnd(); 


}
/*@@end*/

/*@@msg:CAN1.flfcrd_test1_db::TEST_MSG_ENGINE_RES (0x50):*/
on message TEST_MSG_ENGINE_RES
{

msgengRes=this;

}
/*@@end*/

/*@@testcase:TestCase5():*/
testcase TestCase5 ()
{

  byte byte0RQ;
  byte byte1RQ;
  byte byte0R;
  byte byte1R;
  byte byte2R;
  byte byte0;
  dword byte23;
  write("````````````````````````````````````````TEST CASE 3````````````````````````````````````");
  TestCaseTitle("ID_3","1.3 - Write Engine Serial Number-");
  TestCaseDescription("Rewrite the engine serail number ");
  
  ///////////////////////////////////////////////////////////////////////////////
  //------------------------------ TEST STEPS -----------------------------------
  ///////////////////////////////////////////////////////////////////////////////

  //TestStep("step 01"," Negative response not allowed ");
    
  //----------------------
  //---- PRECONDITION ---- 
  //----------------------
    
  //----------------------
  //----- TEST STEP ------
  //----------------------
    //start default  session
  //send change session message request
   
   msgengReq.byte(0)=0x012;
   msgengReq.byte(1)=0x001;
   msgengReq.byte(2)=0x001; // default session =1
   msgengReq.byte(3)=0x000;
   msgengReq.byte(4)=0x000;
   msgengReq.byte(5)=0x000; 
   msgengReq.byte(6)=0x000;
   msgengReq.byte(7)=0x000;
   msgengReq.can=1;
   output(msgengReq);
  
  write("change session req  sent!!!!!!!!!!");
   if( 1 != TestWaitForMessage(80, 10000) )
	{
	   TestStepFail("Diagnosis Response timed out");
	}
   else
    {
      if(msgengRes.byte(0)== 0x052) //positive response
       {  
         write("default session start");
         testStepPass("default session start");
       }
      else //negative response
       {
        write(" default session start");
        testStepFail("default session start");
       }    
    }
 
   msgengReq.byte(0)=0x032;
   msgengReq.byte(1)=0x001;
   msgengReq.dword(2)=0xd10; //new serial number = 33 44
   msgengReq.byte(4)=0x000;
   msgengReq.byte(5)=0x000; 
   msgengReq.byte(6)=0x000;
   msgengReq.byte(7)=0x000;
   msgengReq.can=1;
   output(msgengReq);

   //-----------------------
   //--- EXPECTED RESULT ---
   //-----------------------
   //start - default session

   if( 1 != TestWaitForMessage(80, 10000) )
	{
	   TestStepFail("Diagnosis Response timed out");
	}

   else
    {

    byte0R = msgengRes.BYTE(0);
    byte2R = msgengRes.BYTE(2);
    byte23 = msgengRes.dword(2);

    write("first write req in normal session sent!!!!!!!!!!");
    write("-----------------------------------------------TEST CASE 3 STEP 1-------------------------------------------------------------------");
    write("MESSAGE REQUEST FROM TEST id %x byte0 %X  byte1 %X ",msgengReq.ID,msgengReq.byte(0),msgengReq.byte(1));
    write("MESSAGE RESPONSE FROM TEST id %x byte0 %x  byte2 %x  byte 23 %d",msgengRes.ID,msgengRes.byte(0),byte2R,byte23);
    write("-----------------------------------------------------------------------------------------------------------------------");
    
    // check response content
  
   if(byte0R == 0x072) //pos resp
   { 
    write("write request not allowed in default session ");
    testStepFail("write request not allowed in default session!!! should fail  ");
   }

   else //neg resp
   {
    write("write request in default session not allowed");
    testStepPass("write request in default session not allowed");
   }

   }
  //start programming session
  //send change session message request
   
   msgengReq.byte(0)=0x012;
   msgengReq.byte(1)=0x001;
   msgengReq.byte(2)=0x002; // programming session =2
   msgengReq.byte(3)=0x000;
   msgengReq.byte(4)=0x000;
   msgengReq.byte(5)=0x000; 
   msgengReq.byte(6)=0x000;
   msgengReq.byte(7)=0x000;
   msgengReq.can=1;
   output(msgengReq);
  
  write("change session req  sent!!!!!!!!!!");
   if( 1 != TestWaitForMessage(80, 10000) )
	{
	   TestStepFail("Diagnosis Response timed out");
	}
   else
    {
      if(msgengRes.byte(0)== 0x052) //positive response
       {  
         write("programming session start");
         testStepPass("programming session start");
       }
      else //negative response
       {
        write(" programming session start");
        testStepFail(" programming session start");
       }    
    }

   //send new write request

   msgengReq.byte(0)=0x032;
   msgengReq.byte(1)=0x001;
   msgengReq.word(2)=0xd10; //new serial number = 33 44
   msgengReq.byte(4)=0x000;
   msgengReq.byte(5)=0x000; 
   msgengReq.byte(6)=0x000;
   msgengReq.byte(7)=0x000;
   msgengReq.can=1;
   output(msgengReq);

   write("second write req in normal session sent!!!!!!!!!!");
   //-----------------------
   //--- EXPECTED RESULT ---
   //-----------------------
    
   //start - default session
	if( 1 != TestWaitForMessage(80, 15000) )
	{
	   TestStepFail("Diagnosis Response timed out");
	}
   else
    {

    byte0R = msgengRes.BYTE(0);
    byte2R = msgengRes.BYTE(2);
    byte23 = msgengRes.dword(2);

    write("-----------------------------------------------TEST CASE 3 STEP 3-------------------------------------------------------------------");
    write("MESSAGE REQUEST FROM TEST id %x byte2 %x  byte3 %x ",msgengReq.ID,msgengReq.byte(2),msgengReq.byte(3));
    write("MESSAGE RESPONSE FROM TEST id %x byte2 %x  byte3 %x",msgengRes.ID,msgengRes.byte(2),msgengRes.byte(3));
    write("-----------------------------------------------------------------------------------------------------------------------");

     if(byte0R == 0x072) //pos resp
      {  
       write("write in programming session succes");
       if((msgengRes.byte(2) ==0x010) && (msgengRes.byte(3) == 0x00d)) 
         {testStepPass("write new serial number succesfully completed");}
       else
          {
          write(" why it failed byte2 %x byte3 %x",msgengRes.byte(2),msgengRes.byte(3));
          testStepFail("write new serial number failed - the expected serial no not correct");}

      }
     else //neg resp
     { 
       write("write in programming session");
       testStepFail("write in programming session failed ");
     }//else
    }


  //----------------------
  //--- POSTCONDITION ----
  //----------------------

  ///////////////////////////////////////////////////////////////////////////////
  //------------------------------ TEST CASE END --------------------------------
  ///////////////////////////////////////////////////////////////////////////////






}
/*@@end*/

