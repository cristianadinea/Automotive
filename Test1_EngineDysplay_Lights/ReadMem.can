/*@@includes:*/
includes
{
  #include "..\Includes\ExportedVariablesAndFunctions.cin"
  #include "..\Includes\LogisticData.cin"
  #include "..\Includes\EEPROM_Addresses.cin"
  #include "..\Includes\CCP.cin"
}
/*@@end*/

/*@@var:*/
variables
{
    byte  TesterPresent = 0;

    msTimer T_TesterPresent;
}
/*@@end*/

/*@@mainTest:MainTest():*/
void MainTest()
{

 //////////////////////////
 // Set the preconditions
    v_UnlockArea81();
    // v_WriteCameraLogisticData();
    DumpDefaultEEPROM ();
    TestWaitForTimeout(6000);
    TesterPresent = 0;
    v_ResetECU();
    TestWaitForMessage(Dia_4F1h, TimeOut);
    TestWaitForTimeout(15000);




 write("*****************************");
 write(" DCT LDW - SW Validation Test");
 write(" 4.13 ReadMemory             ");
 write("*****************************");
 write(" ");



 ////////////////////////
 //4.13 Read Memory     /
 ////////////////////////


//4.13.1 General :
         TC_1_ReadMemory_NoSupportedPID();
//4.13.2 Keyword + ZGS :
         TC_21_ReadKeywordZGS_default();
         TC_22_ReadKeywordZGS_ActiveDiagnosis();
         TC_23_ReadKeywordZGS_ParametrizationMode();
         TC_24_ReadKeywordZGS_FBLmode();
         TC_25_ReadKeywordZGS_VDOmode();

//4.13.3 MB part number :
         TC_31_ReadMBPartNumber_default();
         TC_32_ReadMBPartNumber_active();
         TC_33_ReadMBPartNumber_parametrization();
         TC_34_ReadMBPartNumber_FBL();
         TC_35_ReadMBPartNumber_VDO();

//4.13.4 Tester program number :
         TC_41_ReadTesterProgramNumber_default();
         TC_42_ReadTesterProgramNumber_active();
         TC_43_ReadTesterProgramNumber_parametrization();
         TC_44_ReadTesterProgramNumber_FBL();
         TC_45_ReadTesterProgramNumber_VDO();

//4.13.5 ECU abbreviation :
         TC_51_ReadECUAbbreviation_default();
         TC_52_ReadECUAbbreviation_active();
         TC_53_ReadECUAbbreviation_parametrization();
         TC_54_ReadECUAbbreviation_FBL();
         TC_55_ReadECUAbbreviation_VDO();  

//4.13.6 Supplier software version :
         TC_61_ReadSupplierSoftwareVersion_default();
         TC_62_ReadSupplierSoftwareVersion_active();
         TC_63_ReadSupplierSoftwareVersion_parametrization();
         TC_64_ReadSupplierSoftwareVersion_FBL();
         TC_65_ReadSupplierSoftwareVersion_VDO();

//4.13.7 DC hardware version :
         TC_71_ReadDCHardwareVersion_default();
         TC_72_ReadDCHardwareVersion_active();
         TC_73_ReadDCHardwareVersion_parametrization();
         TC_74_ReadDCHardwareVersion_FBL();
         TC_75_ReadDCHardwareVersion_VDO();
        
//4.13.8 DC software version :
         TC_81_ReadDCSoftwareVersion_default();
         TC_82_ReadDCSoftwareVersion_active();
         TC_83_ReadDCSoftwareVersion_parametrization();
         TC_84_ReadDCSoftwareVersion_FBL();
         TC_85_ReadDCSoftwareVersion_VDO(); 


//4.13.9 Camera height : 
         TC_91_ReadCameraHeight_not_calibrated();
         TC_92_ReadCameraHeight_default();
         TC_93_ReadCameraHeight_active();
         TC_94_ReadCameraHeight_parametrization();
         TC_95_ReadCameraHeight_VDO();


//4.13.10 Vehicle width :
         TC_101_ReadVehicleWidth_default();
         TC_102_ReadVehicleWidth_active();
         TC_103_ReadVehicleWidth_parametrization();
         TC_104_ReadVehicleWidth_VDO();


//4.13.11 Camera displacement :
          TC_111_ReadCameraDisplacement_default();
          TC_112_ReadCameraDisplacement_active();
          TC_113_ReadCameraDisplacement_parametrization();
          TC_114_ReadCameraDisplacement_VDO();
          TC_115_ReadCameraDisplacement_NegativeValue();


//4.13.12 Pitch angle :
          TC_121_ReadPitchAngle_default();
          TC_122_ReadPitchAngle_active();
          TC_123_ReadPitchAngle_parametrization();
          TC_124_ReadPitchAngle_VDO();
          TC_125_ReadPitchAngle_NegativeValue();


//4.13.13 Roll angle :
          TC_131_ReadRollAngle_default();
          TC_132_ReadRollAngle_active();
          TC_133_ReadRollAngle_parametrization();
          TC_134_ReadRollAngle_VDO();
          TC_135_ReadRollAngle_NegativeValue();

        
//4.13.14 Start state after ignition :
          TC_141_ReadStartStateAfterIgnition_default();
          TC_142_ReadStartStateAfterIgnition_active();
          TC_143_ReadStartStateAfterIgnition_parametrization();
          TC_144_ReadStartStateAfterIgnition_VDO();


//4.13.15 Mute enable :
          TC_151_ReadMuteEnable_default();
          TC_152_ReadMuteEnable_active();
          TC_153_ReadMuteEnable_parametrization();
          TC_154_ReadMuteEnable_VDO();


/*
//4.13.16 Switch LED enable/disable :
          TC_161_ReadSwitchLedEnable_default();
          TC_162_ReadSwitchLedEnable_active();
          TC_163_ReadSwitchLedEnable_parametrization();
          TC_164_ReadSwitchLedEnable_VDO();

//4.13.17 Turn signal source :
          TC_171_ReadTurnSignalSource_default();
          TC_172_ReadTurnSignalSource_active();
          TC_173_ReadTurnSignalSource_parametrization();
          TC_174_ReadTurnSignalSource_VDO();

//4.13.18 Switch source :
          TC_181_ReadSwitchSource_default();
          TC_182_ReadSwitchSource_active();
          TC_183_ReadSwitchSource_parametrization();
          TC_184_ReadSwitchSource_VDO();

//4.13.19 Type of CAN matrix :
          TC_191_ReadTypeOfCanMatrix_default();
          TC_192_ReadTypeOfCanMatrix_active();
          TC_193_ReadTypeOfCanMatrix_parametrization();
          TC_194_ReadTypeOfCanMatrix_VDO();

//4.13.20 Type of Status lamp :
          TC_201_ReadTypeOfStatusLamp_default();
          TC_202_ReadTypeOfStatusLamp_active();
          TC_203_ReadTypeOfStatusLamp_parametrization();
          TC_204_ReadTypeOfStatusLamp_VDO();

//4.13.21 Warning destination :
          TC_211_ReadWarningDestination_default();
          TC_212_ReadWarningDestination_active();
          TC_213_ReadWarningDestination_parametrization();
          TC_214_ReadWarningDestination_VDO();

//4.13.22 Activation speed :
          TC_221_ReadActivationSpeed_default();
          TC_222_ReadActivationSpeed_active();
          TC_223_ReadActivationSpeed_parametrization();
          TC_224_ReadActivationSpeed_VDO();
*/


/*
//4.13.23 Read Tester Identification :

 // 4.17.23.1 Tester identification arrea 71:
          TC_ReadTesterIdentificationArrea71();
// 4.17.23.2 Tester identification arrea 73:
          TC_ReadTesterIdentificationArrea73();
// 4.17.23.3 Tester identification arrea 77:
          TC_ReadTesterIdentificationArrea77();
// 4.17.23.5 Tester identification arrea 81:
          TC_ReadTesterIdentificationArrea81();
// 4.17.23.6 Tester identification arrea unsupported:
          TC_ReadTesterIdentificationUnsupportedArrea();


// 4.17.23.7 Tester access date arrea 71:
          TC_ReadTesterAccessDateArrea71();
// 4.17.23.8 Tester access date arrea 73:
          TC_ReadTesterAccessDateArrea73();
// 4.17.23.9 Tester access date arrea 77:
          TC_ReadTesterAccessDateArrea77();
// 4.17.23.11 Tester access date arrea 81:
          TC_ReadTesterAccessDateArrea81();
// 4.17.23.12 Tester access date arrea  unsupported:
          TC_ReadTesterAccessDateUnsupportedArrea();

*/
 
}
/*@@end*/

/*@@testcase:_Template():*/
testcase _Template ()
{
 //LOCALS

///////////////////////////////////////////////////////////////////////////////
//----------------------------- TEST CASE INFO --------------------------------
///////////////////////////////////////////////////////////////////////////////
	TestCaseTitle("x.x.x.x","...");
	TestCaseDescription("...");
	//TestCaseDescription("...");
	//TestCaseDescription("...");
///////////////////////////////////////////////////////////////////////////////
//------------------------------ TEST STEPS -----------------------------------
///////////////////////////////////////////////////////////////////////////////
/*
TestStep
("step 01"," ... ");
    //----------------------
	//----- STEP-ENTRY -----
	//----------------------


    //----------------------
	//----- STIMULATE ------
	//----------------------




	if(1 != TestWaitForMessage(bus::message, Tout))
	{
	 TestStepFail("message bus::message timed out");
	}

    //-----------------------
	//- EVALUATION & REPORT -
    //-----------------------


	if(1 != TestWaitForMessage(bus::message, ...))
	{
	 TestStepFail("message bus::message timed out");
	}

    //----------------------
	//----- STEP-EXIT ------
    //----------------------

//-----------------------------------------------------------------------------
*/

///////////////////////////////////////////////////////////////////////////////
//------------------------------ TEST CASE END --------------------------------
///////////////////////////////////////////////////////////////////////////////
}
/*@@end*/

/*@@testcase:TC_21_ReadKeywordZGS_default():*/
testcase TC_21_ReadKeywordZGS_default ()
{
   //LOCALS


///////////////////////////////////////////////////////////////////////////////
//----------------------------- TEST CASE INFO --------------------------------
///////////////////////////////////////////////////////////////////////////////
	TestCaseTitle("ID_1148","4.13.2.1 - Read keyword and ZGS (default)");
	TestCaseDescription("This test should prove that the Read Memory diagnosis");
	TestCaseDescription("service for the keyword/ZGS works correctly in passive diagnosis.");


///////////////////////////////////////////////////////////////////////////////
//------------------------------ TEST STEPS -----------------------------------
///////////////////////////////////////////////////////////////////////////////


TestStep
("step 01"," Keyword/ZGS ");
    //----------------------
	//---- PRECONDITION ----
	//----------------------
    

    //----------------------
	//----- TEST STEP ------
	//----------------------
    DiagnosticRequest.BYTE(0) = DiagnosticAddress;
    DiagnosticRequest.BYTE(1) = SID_ReadMemory;
    DiagnosticRequest.BYTE(2) = PID_Keyword;
    DiagnosticRequest.BYTE(3) = 0xFF;
    DiagnosticRequest.BYTE(4) = 0xFF;
    DiagnosticRequest.BYTE(5) = 0xFF;
    DiagnosticRequest.BYTE(6) = 0xFF;
    DiagnosticRequest.BYTE(7) = 0xFF;

    output(DiagnosticRequest);


    //-----------------------
	//--- EXPECTED RESULT ---
    //-----------------------
	if( 1 != TestWaitForMessage(Dia_4F1h, TimeOut) )
	{
	   TestStepFail("Diagnosis Response timed out");
	}
    // check response time
    if( 1 == TestResponseTime )
    {
       if( MaxResponseTime < GetResponseTime())
       {
          write("Time of request = %d ms", ResponseTime);
          TestStepFail("Max. response time exceeded");
       }
    }
    // check response content 
    if(   ( DiagnosticAddress       != getSignal(Dia_4F1h::STA_DIAG_ANTWORT_TN) )
       || ( (SID_ReadMemory + 0x40) != getSignal(Dia_4F1h::STA_DIAG_ANTWORT_B1) )
       || ( PID_Keyword             != getSignal(Dia_4F1h::STA_DIAG_ANTWORT_B2) )
       || ( Keyword_1   != getSignal(Dia_4F1h::STA_DIAG_ANTWORT_B3) )
       || ( Keyword_2   != getSignal(Dia_4F1h::STA_DIAG_ANTWORT_B4) )
       || ( ZGS_H       != getSignal(Dia_4F1h::STA_DIAG_ANTWORT_B5) )
       || ( ZGS_Z       != getSignal(Dia_4F1h::STA_DIAG_ANTWORT_B6) )
       || ( ZGS_E       != getSignal(Dia_4F1h::STA_DIAG_ANTWORT_B7) )
      )
    {
        TestStepFail("wrong message content");
    }


    //----------------------
	//--- POSTCONDITION ----
    //----------------------



///////////////////////////////////////////////////////////////////////////////
//------------------------------ TEST CASE END --------------------------------
///////////////////////////////////////////////////////////////////////////////
}
/*@@end*/

/*@@testcase:TC_31_ReadMBPartNumber_default():*/
testcase TC_31_ReadMBPartNumber_default ()
{
   //LOCALS


///////////////////////////////////////////////////////////////////////////////
//----------------------------- TEST CASE INFO --------------------------------
///////////////////////////////////////////////////////////////////////////////
	TestCaseTitle("ID_1150","4.13.3.1 - Read MB part number (default)");
	TestCaseDescription("This test should prove that the Read Memory diagnosis");
	TestCaseDescription("service for the MB part number works correctly.");


///////////////////////////////////////////////////////////////////////////////
//------------------------------ TEST STEPS -----------------------------------
///////////////////////////////////////////////////////////////////////////////


TestStep
("step 01"," MB Part Number ");
    //----------------------
	//---- PRECONDITION ----
	//----------------------
    

    //----------------------
	//----- TEST STEP ------
	//----------------------
    DiagnosticRequest.BYTE(0) = DiagnosticAddress;
    DiagnosticRequest.BYTE(1) = SID_ReadMemory;
    DiagnosticRequest.BYTE(2) = PID_MBPartNumber;
    DiagnosticRequest.BYTE(3) = 0xFF;
    DiagnosticRequest.BYTE(4) = 0xFF;
    DiagnosticRequest.BYTE(5) = 0xFF;
    DiagnosticRequest.BYTE(6) = 0xFF;
    DiagnosticRequest.BYTE(7) = 0xFF;

    output(DiagnosticRequest);


    //-----------------------
	//--- EXPECTED RESULT ---
    //-----------------------
	if( 1 != TestWaitForMessage(Dia_4F1h, TimeOut) )
	{
	   TestStepFail("Diagnosis Response timed out");
	}
    // check response time
    if( 1 == TestResponseTime )
    {
       if( MaxResponseTime < GetResponseTime())
       {
          write("Time of request = %d ms", ResponseTime);
          TestStepFail("Max. response time exceeded");
       }
    }
    // check response content
    if(   ( DiagnosticAddress      != getSignal(Dia_4F1h::STA_DIAG_ANTWORT_TN) )
       || ( (SID_ReadMemory + 0x40)!= getSignal(Dia_4F1h::STA_DIAG_ANTWORT_B1) )
       || ( PID_MBPartNumber       != getSignal(Dia_4F1h::STA_DIAG_ANTWORT_B2) )
       || ( MSB1  != getSignal(Dia_4F1h::STA_DIAG_ANTWORT_B3) )
       || ( MSB2  != getSignal(Dia_4F1h::STA_DIAG_ANTWORT_B4) )
       || ( MSB3  != getSignal(Dia_4F1h::STA_DIAG_ANTWORT_B5) )
       || ( MSB4  != getSignal(Dia_4F1h::STA_DIAG_ANTWORT_B6) )
       || ( MSB5  != getSignal(Dia_4F1h::STA_DIAG_ANTWORT_B7) )
      )
    {
        TestStepFail("wrong message content");
    }


    //----------------------
	//--- POSTCONDITION ----
    //----------------------




///////////////////////////////////////////////////////////////////////////////
//------------------------------ TEST CASE END --------------------------------
///////////////////////////////////////////////////////////////////////////////
}
/*@@end*/

/*@@testcase:TC_41_ReadTesterProgramNumber_default():*/
testcase TC_41_ReadTesterProgramNumber_default ()
{
   //LOCALS


///////////////////////////////////////////////////////////////////////////////
//----------------------------- TEST CASE INFO --------------------------------
///////////////////////////////////////////////////////////////////////////////
	TestCaseTitle("ID_1152","4.13.4.1 - Read tester program number / date / HW&SW version (default)");
	TestCaseDescription("The test program number informs about the level of");
    TestCaseDescription("diagnosis of the ECU. This number is given by DCT.");
	TestCaseDescription("In addition this service also provides production ");
    TestCaseDescription("date and the HW/SW version of the ECU.");


///////////////////////////////////////////////////////////////////////////////
//------------------------------ TEST STEPS -----------------------------------
///////////////////////////////////////////////////////////////////////////////


TestStep
("step 01"," Tester Program Number ");
    //----------------------
	//---- PRECONDITION ----
	//----------------------
    

    //----------------------
	//----- TEST STEP ------
	//----------------------
    DiagnosticRequest.BYTE(0) = DiagnosticAddress;
    DiagnosticRequest.BYTE(1) = SID_ReadMemory;
    DiagnosticRequest.BYTE(2) = PID_TesterProgramNumber;
    DiagnosticRequest.BYTE(3) = 0xFF;
    DiagnosticRequest.BYTE(4) = 0xFF;
    DiagnosticRequest.BYTE(5) = 0xFF;
    DiagnosticRequest.BYTE(6) = 0xFF;
    DiagnosticRequest.BYTE(7) = 0xFF;

    output(DiagnosticRequest);


    //-----------------------
	//--- EXPECTED RESULT ---
    //-----------------------
	if( 1 != TestWaitForMessage(Dia_4F1h, TimeOut) )
	{
	   TestStepFail("Diagnosis Response timed out");
	}
    // check response time
    if( 1 == TestResponseTime )
    {
       if( MaxResponseTime < GetResponseTime())
       {
          write("Time of request = %d ms", ResponseTime);
          TestStepFail("Max. response time exceeded");
       }
    }
    // check response content
    if(   ( DiagnosticAddress       != getSignal(Dia_4F1h::STA_DIAG_ANTWORT_TN) )
       || ( (SID_ReadMemory + 0x40) != getSignal(Dia_4F1h::STA_DIAG_ANTWORT_B1) )
       || ( PID_TesterProgramNumber != getSignal(Dia_4F1h::STA_DIAG_ANTWORT_B2) )
       || ( TesterProgramNumber     != getSignal(Dia_4F1h::STA_DIAG_ANTWORT_B3) )
       || ( Date1         != getSignal(Dia_4F1h::STA_DIAG_ANTWORT_B4) )
       || ( Date2         != getSignal(Dia_4F1h::STA_DIAG_ANTWORT_B5) )
       || ( HW_Version    != getSignal(Dia_4F1h::STA_DIAG_ANTWORT_B6) )
       || ( SW_Version    != getSignal(Dia_4F1h::STA_DIAG_ANTWORT_B7) )
      )
    {
        TestStepFail("wrong message content");
    }


    //----------------------
	//--- POSTCONDITION ----
    //----------------------



///////////////////////////////////////////////////////////////////////////////
//------------------------------ TEST CASE END --------------------------------
///////////////////////////////////////////////////////////////////////////////
}
/*@@end*/

/*@@testcase:TC_51_ReadECUAbbreviation_default():*/
testcase TC_51_ReadECUAbbreviation_default ()
{
   //LOCALS


///////////////////////////////////////////////////////////////////////////////
//----------------------------- TEST CASE INFO --------------------------------
///////////////////////////////////////////////////////////////////////////////
	TestCaseTitle("ID_1154","4.13.5.1 - Read ECU abbreviation (default)");
	TestCaseDescription("This test case request the abbrevation of the ECU");
	TestCaseDescription("used for CAN communication and the most prio CAN-ID.");


///////////////////////////////////////////////////////////////////////////////
//------------------------------ TEST STEPS -----------------------------------
///////////////////////////////////////////////////////////////////////////////


TestStep
("step 01"," ECU abbreviation ");
    //----------------------
	//---- PRECONDITION ----
	//----------------------
    

    //----------------------
	//----- TEST STEP ------
	//----------------------
    DiagnosticRequest.BYTE(0) = DiagnosticAddress;
    DiagnosticRequest.BYTE(1) = SID_ReadMemory;
    DiagnosticRequest.BYTE(2) = PID_ECUAbbreviation;
    DiagnosticRequest.BYTE(3) = 0xFF;
    DiagnosticRequest.BYTE(4) = 0xFF;
    DiagnosticRequest.BYTE(5) = 0xFF;
    DiagnosticRequest.BYTE(6) = 0xFF;
    DiagnosticRequest.BYTE(7) = 0xFF;

    output(DiagnosticRequest);


    //-----------------------
	//--- EXPECTED RESULT ---
    //-----------------------
	if( 1 != TestWaitForMessage(Dia_4F1h, TimeOut) )
	{
	   TestStepFail("Diagnosis Response timed out");
	}
    // check response time
    if( 1 == TestResponseTime )
    {
       if( MaxResponseTime < GetResponseTime())
       {
          write("Time of request = %d ms", ResponseTime);
          TestStepFail("Max. response time exceeded");
       }
    }
    // check response content
    if(   ( DiagnosticAddress       != getSignal(Dia_4F1h::STA_DIAG_ANTWORT_TN) )
       || ( (SID_ReadMemory + 0x40) != getSignal(Dia_4F1h::STA_DIAG_ANTWORT_B1) )
       || ( PID_ECUAbbreviation     != getSignal(Dia_4F1h::STA_DIAG_ANTWORT_B2) )
       || ( ECU_1     != getSignal(Dia_4F1h::STA_DIAG_ANTWORT_B3) )
       || ( ECU_2     != getSignal(Dia_4F1h::STA_DIAG_ANTWORT_B4) )
       || ( ECU_3     != getSignal(Dia_4F1h::STA_DIAG_ANTWORT_B5) )
       || ( ID_Low    != getSignal(Dia_4F1h::STA_DIAG_ANTWORT_B6) )
       || ( ID_High   != getSignal(Dia_4F1h::STA_DIAG_ANTWORT_B7) )
      )
    {
        TestStepFail("wrong message content");
    }


    //----------------------
	//--- POSTCONDITION ----
    //----------------------




///////////////////////////////////////////////////////////////////////////////
//------------------------------ TEST CASE END --------------------------------
///////////////////////////////////////////////////////////////////////////////
}
/*@@end*/

/*@@testcase:TC_61_ReadSupplierSoftwareVersion_default():*/
testcase TC_61_ReadSupplierSoftwareVersion_default ()
{
   //LOCALS


///////////////////////////////////////////////////////////////////////////////
//----------------------------- TEST CASE INFO --------------------------------
///////////////////////////////////////////////////////////////////////////////
	TestCaseTitle("ID_1156","4.13.6.1 - Read Supplier Software Version (default)");
	TestCaseDescription("This test case request the supplier specific SW");
	TestCaseDescription("identification of the ECU");
	TestCaseDescription("Version: format   XX.XX e.g.  04.00 (= C1 release)");



///////////////////////////////////////////////////////////////////////////////
//------------------------------ TEST STEPS -----------------------------------
///////////////////////////////////////////////////////////////////////////////


TestStep
("step 01"," Supplier Software Version ");
    //----------------------
	//---- PRECONDITION ----
	//----------------------
    

    //----------------------
	//----- TEST STEP ------
	//----------------------
    DiagnosticRequest.BYTE(0) = DiagnosticAddress;
    DiagnosticRequest.BYTE(1) = SID_ReadMemory;
    DiagnosticRequest.BYTE(2) = PID_SupplierSoftwareVersion;
    DiagnosticRequest.BYTE(3) = 0xFF;
    DiagnosticRequest.BYTE(4) = 0xFF;
    DiagnosticRequest.BYTE(5) = 0xFF;
    DiagnosticRequest.BYTE(6) = 0xFF;
    DiagnosticRequest.BYTE(7) = 0xFF;

    output(DiagnosticRequest);


    //-----------------------
	//--- EXPECTED RESULT ---
    //-----------------------
	if( 1 != TestWaitForMessage(Dia_4F1h, TimeOut) )
	{
	   TestStepFail("Diagnosis Response timed out");
	}
    // check response time
    if( 1 == TestResponseTime )
    {
       if( MaxResponseTime < GetResponseTime())
       {
          write("Time of request = %d ms", ResponseTime);
          TestStepFail("Max. response time exceeded");
       }
    }
    // check response content
    if(   ( DiagnosticAddress           != getSignal(Dia_4F1h::STA_DIAG_ANTWORT_TN) )
       || ( (SID_ReadMemory + 0x40)     != getSignal(Dia_4F1h::STA_DIAG_ANTWORT_B1) )
       || ( PID_SupplierSoftwareVersion != getSignal(Dia_4F1h::STA_DIAG_ANTWORT_B2) )
       || ( SW_ASCII_1  != getSignal(Dia_4F1h::STA_DIAG_ANTWORT_B3) )
       || ( SW_ASCII_2  != getSignal(Dia_4F1h::STA_DIAG_ANTWORT_B4) )
       || ( SW_ASCII_3  != getSignal(Dia_4F1h::STA_DIAG_ANTWORT_B5) )
       || ( SW_ASCII_4  != getSignal(Dia_4F1h::STA_DIAG_ANTWORT_B6) )
       || ( SW_ASCII_5  != getSignal(Dia_4F1h::STA_DIAG_ANTWORT_B7) )
      )
    {
        TestStepFail("wrong message content");
    }


    //----------------------
	//--- POSTCONDITION ----
    //----------------------




///////////////////////////////////////////////////////////////////////////////
//------------------------------ TEST CASE END --------------------------------
///////////////////////////////////////////////////////////////////////////////
}
/*@@end*/

/*@@testcase:TC_71_ReadDCHardwareVersion_default():*/
testcase TC_71_ReadDCHardwareVersion_default ()
{
   //LOCALS


///////////////////////////////////////////////////////////////////////////////
//----------------------------- TEST CASE INFO --------------------------------
///////////////////////////////////////////////////////////////////////////////
	TestCaseTitle("ID_1162","4.13.7.1 - Read DC Hardware Version (default)");
	TestCaseDescription("This test case request the DCT specific HW");
    TestCaseDescription("identification of the ECU.");
	TestCaseDescription("Format: calender week (WW), year (JJ), patchlevel (patch)");
    

///////////////////////////////////////////////////////////////////////////////
//------------------------------ TEST STEPS -----------------------------------
///////////////////////////////////////////////////////////////////////////////


TestStep
("step 01"," DC Hardware Version ");
    //----------------------
	//---- PRECONDITION ----
	//----------------------
    

    //----------------------
	//----- TEST STEP ------
	//----------------------
    DiagnosticRequest.BYTE(0) = DiagnosticAddress;
    DiagnosticRequest.BYTE(1) = SID_ReadMemory;
    DiagnosticRequest.BYTE(2) = PID_DCHardwareVersion;
    DiagnosticRequest.BYTE(3) = 0xFF;
    DiagnosticRequest.BYTE(4) = 0xFF;
    DiagnosticRequest.BYTE(5) = 0xFF;
    DiagnosticRequest.BYTE(6) = 0xFF;
    DiagnosticRequest.BYTE(7) = 0xFF;

    output(DiagnosticRequest);


    //-----------------------
	//--- EXPECTED RESULT ---
    //-----------------------
	if( 1 != TestWaitForMessage(Dia_4F1h, TimeOut) )
	{
	   TestStepFail("Diagnosis Response timed out");
	}
    // check response time
    if( 1 == TestResponseTime )
    {
       if( MaxResponseTime < GetResponseTime())
       {
          write("Time of request = %d ms", ResponseTime);
          TestStepFail("Max. response time exceeded");
       }
    }
    // check response content
    if(   ( DiagnosticAddress      != getSignal(Dia_4F1h::STA_DIAG_ANTWORT_TN) )
       || ( (SID_ReadMemory + 0x40)!= getSignal(Dia_4F1h::STA_DIAG_ANTWORT_B1) )
       || ( PID_DCHardwareVersion  != getSignal(Dia_4F1h::STA_DIAG_ANTWORT_B2) )
       || ( DC_HW_KW               != getSignal(Dia_4F1h::STA_DIAG_ANTWORT_B3) )
       || ( DC_HW_Year             != getSignal(Dia_4F1h::STA_DIAG_ANTWORT_B4) )
       || ( DC_HW_Patch            != getSignal(Dia_4F1h::STA_DIAG_ANTWORT_B5) )
       || ( 0xFF != getSignal(Dia_4F1h::STA_DIAG_ANTWORT_B6) )
       || ( 0xFF != getSignal(Dia_4F1h::STA_DIAG_ANTWORT_B7) )
      )
    {
        TestStepFail("wrong message content");
    }


    //----------------------
	//--- POSTCONDITION ----
    //----------------------




///////////////////////////////////////////////////////////////////////////////
//------------------------------ TEST CASE END --------------------------------
///////////////////////////////////////////////////////////////////////////////
}
/*@@end*/

/*@@testcase:TC_81_ReadDCSoftwareVersion_default():*/
testcase TC_81_ReadDCSoftwareVersion_default ()
{
   //LOCALS


///////////////////////////////////////////////////////////////////////////////
//----------------------------- TEST CASE INFO --------------------------------
///////////////////////////////////////////////////////////////////////////////
	TestCaseTitle("ID_1158","4.17.8.1 - Read DC Software Version (default)");
	TestCaseDescription("This test case request the DCT specific SW ");
	TestCaseDescription("identification of the ECU.");
	TestCaseDescription("Format: calender week, year, patchlevel");


///////////////////////////////////////////////////////////////////////////////
//------------------------------ TEST STEPS -----------------------------------
///////////////////////////////////////////////////////////////////////////////


TestStep
("step 01"," DC Software Version ");
    //----------------------
	//---- PRECONDITION ----
	//----------------------
    

    //----------------------
	//----- TEST STEP ------
	//----------------------
    DiagnosticRequest.BYTE(0) = DiagnosticAddress;
    DiagnosticRequest.BYTE(1) = SID_ReadMemory;
    DiagnosticRequest.BYTE(2) = PID_DCSoftwareVersion;
    DiagnosticRequest.BYTE(3) = 0xFF;
    DiagnosticRequest.BYTE(4) = 0xFF;
    DiagnosticRequest.BYTE(5) = 0xFF;
    DiagnosticRequest.BYTE(6) = 0xFF;
    DiagnosticRequest.BYTE(7) = 0xFF;

    output(DiagnosticRequest);


    //-----------------------
	//--- EXPECTED RESULT ---
    //-----------------------
	if( 1 != TestWaitForMessage(Dia_4F1h, TimeOut) )
	{
	   TestStepFail("Diagnosis Response timed out");
	}
    // check response time
    if( 1 == TestResponseTime )
    {
       if( MaxResponseTime < GetResponseTime())
       {
          write("Time of request = %d ms", ResponseTime);
          TestStepFail("Max. response time exceeded");
       }
    }
    // check response content
    if(   ( DiagnosticAddress      != getSignal(Dia_4F1h::STA_DIAG_ANTWORT_TN) )
       || ( (SID_ReadMemory + 0x40)!= getSignal(Dia_4F1h::STA_DIAG_ANTWORT_B1) )
       || ( PID_DCSoftwareVersion  != getSignal(Dia_4F1h::STA_DIAG_ANTWORT_B2) )
       || ( DC_SW_KW               != getSignal(Dia_4F1h::STA_DIAG_ANTWORT_B3) )
       || ( DC_SW_Year             != getSignal(Dia_4F1h::STA_DIAG_ANTWORT_B4) )
       || ( DC_SW_Patch            != getSignal(Dia_4F1h::STA_DIAG_ANTWORT_B5) )
       || ( 0xFF != getSignal(Dia_4F1h::STA_DIAG_ANTWORT_B6) )
       || ( 0xFF != getSignal(Dia_4F1h::STA_DIAG_ANTWORT_B7) )
      )
    {
        TestStepFail("wrong message content");
    }


    //----------------------
	//--- POSTCONDITION ----
    //----------------------




///////////////////////////////////////////////////////////////////////////////
//------------------------------ TEST CASE END --------------------------------
///////////////////////////////////////////////////////////////////////////////
}
/*@@end*/

/*@@testcase:TC_92_ReadCameraHeight_default():*/
testcase TC_92_ReadCameraHeight_default ()
{
   //LOCALS
   word EE_Parameter;


///////////////////////////////////////////////////////////////////////////////
//----------------------------- TEST CASE INFO --------------------------------
///////////////////////////////////////////////////////////////////////////////
	TestCaseTitle("ID_941","4.17.9.1 - Read CameraHeight (default)");
	TestCaseDescription("This test should prove that the Read Memory diagnosis service");
	TestCaseDescription("for Camera Height (PID = 0x10) works correctly.");


///////////////////////////////////////////////////////////////////////////////
//------------------------------ TEST STEPS -----------------------------------
///////////////////////////////////////////////////////////////////////////////


TestStep
("step 01"," Camera Height ");
    //----------------------
	//---- PRECONDITION ----
	//----------------------
    v_WriteCameraHeight();
    TestWaitForTimeout(5000); 


    //----------------------
	//----- TEST STEP ------
	//----------------------
    DiagnosticRequest.BYTE(0) = DiagnosticAddress;
    DiagnosticRequest.BYTE(1) = SID_ReadMemory;
    DiagnosticRequest.BYTE(2) = PID_CameraHeight;
    DiagnosticRequest.BYTE(3) = 0xFF;
    DiagnosticRequest.BYTE(4) = 0xFF;
    DiagnosticRequest.BYTE(5) = 0xFF;
    DiagnosticRequest.BYTE(6) = 0xFF;
    DiagnosticRequest.BYTE(7) = 0xFF;

    output(DiagnosticRequest);


    //-----------------------
	//--- EXPECTED RESULT ---
    //-----------------------
	if( 1 != TestWaitForMessage(Dia_4F1h, TimeOut) )
	{
	   TestStepFail("Diagnosis Response timed out");
	}
    // check response time
    if( 1 == TestResponseTime )
    {
       if( MaxResponseTime < GetResponseTime())
       {
          write("Time of request = %d ms", ResponseTime);
          TestStepFail("Max. response time exceeded");
       }
    }
    // check response content
    if(   ( DiagnosticAddress      != getSignal(Dia_4F1h::STA_DIAG_ANTWORT_TN) )
       || ( (SID_ReadMemory + 0x40)!= getSignal(Dia_4F1h::STA_DIAG_ANTWORT_B1) )
       || ( PID_CameraHeight       != getSignal(Dia_4F1h::STA_DIAG_ANTWORT_B2) )
       || ( 0x16                   != getSignal(Dia_4F1h::STA_DIAG_ANTWORT_B3) )
       || ( 0x01                   != getSignal(Dia_4F1h::STA_DIAG_ANTWORT_B4) )
      )
    {
        TestStepFail("wrong message content");
    }


    //----------------------
	//--- POSTCONDITION ----
    //----------------------
    TestWaitForTimeout(5000);
    v_UnlockArea81();
    TestWaitForTimeout(100);
    EE_Parameter = v_ReadCCP(EE_ADDR_CameraHeight, 2);
	if( 0x00BC != EE_Parameter )
	{
	   TestStepFail("EEPROM parameter wrong");
       write("Read EE_Parameter = 0x%x", EE_Parameter);
	}
    TesterPresent = 0;
    v_StopDiagnosis();
    TestWaitForMessage(Dia_4F1h, TimeOut);



///////////////////////////////////////////////////////////////////////////////
//------------------------------ TEST CASE END --------------------------------
///////////////////////////////////////////////////////////////////////////////
}
/*@@end*/

/*@@testcase:TC_101_ReadVehicleWidth_default():*/
testcase TC_101_ReadVehicleWidth_default ()
{
   //LOCALS


///////////////////////////////////////////////////////////////////////////////
//----------------------------- TEST CASE INFO --------------------------------
///////////////////////////////////////////////////////////////////////////////
	TestCaseTitle("ID_954","4.13.10.1 - Read VehicleWidth (default)");
	TestCaseDescription("This test should prove that the Read Memory diagnosis service");
	TestCaseDescription("for Vehicle Width (PID = 0x11) works correctly.");
	TestCaseDescription("default value of vehicle width = 2.50m = 250 cm");
	TestCaseDescription("=> 0x00FA ( 0x0064 @ EEPROM )");


///////////////////////////////////////////////////////////////////////////////
//------------------------------ TEST STEPS -----------------------------------
///////////////////////////////////////////////////////////////////////////////


TestStep
("step 01"," Vehicle Width ");
    //----------------------
	//---- PRECONDITION ----
	//----------------------
    

    //----------------------
	//----- TEST STEP ------
	//----------------------
    DiagnosticRequest.BYTE(0) = DiagnosticAddress;
    DiagnosticRequest.BYTE(1) = SID_ReadMemory;
    DiagnosticRequest.BYTE(2) = PID_VehicleWidth;
    DiagnosticRequest.BYTE(3) = 0xFF;
    DiagnosticRequest.BYTE(4) = 0xFF;
    DiagnosticRequest.BYTE(5) = 0xFF;
    DiagnosticRequest.BYTE(6) = 0xFF;
    DiagnosticRequest.BYTE(7) = 0xFF;

    output(DiagnosticRequest);


    //-----------------------
	//--- EXPECTED RESULT ---
    //-----------------------
	if( 1 != TestWaitForMessage(Dia_4F1h, TimeOut) )
	{
	   TestStepFail("Diagnosis Response timed out");
	}
    // check response time
    if( 1 == TestResponseTime )
    {
       if( MaxResponseTime < GetResponseTime())
       {
          write("Time of request = %d ms", ResponseTime);
          TestStepFail("Max. response time exceeded");
       }
    }
    // check response content
    if(   ( DiagnosticAddress      != getSignal(Dia_4F1h::STA_DIAG_ANTWORT_TN) )
       || ( (SID_ReadMemory + 0x40)!= getSignal(Dia_4F1h::STA_DIAG_ANTWORT_B1) )
       || ( PID_VehicleWidth       != getSignal(Dia_4F1h::STA_DIAG_ANTWORT_B2) )
       || ( 0xFA != getSignal(Dia_4F1h::STA_DIAG_ANTWORT_B3) )
       || ( 0x00 != getSignal(Dia_4F1h::STA_DIAG_ANTWORT_B4) )
      )
    {
        TestStepFail("wrong message content");
    }


    //----------------------
	//--- POSTCONDITION ----
    //----------------------




///////////////////////////////////////////////////////////////////////////////
//------------------------------ TEST CASE END --------------------------------
///////////////////////////////////////////////////////////////////////////////
}
/*@@end*/

/*@@testcase:TC_111_ReadCameraDisplacement_default():*/
testcase TC_111_ReadCameraDisplacement_default ()
{
   //LOCALS


///////////////////////////////////////////////////////////////////////////////
//----------------------------- TEST CASE INFO --------------------------------
///////////////////////////////////////////////////////////////////////////////
	TestCaseTitle("ÍD_996","4.13.11.1 - Read Camera Displacement (default)");
	TestCaseDescription("This test should prove that the Read Memory diagnosis service");
	TestCaseDescription("for Camera Displacement/Lateral Offset (PID = 0x12)");
	TestCaseDescription("works correctly, by returning the value strored in EEPROM");
	TestCaseDescription("default value of vehicle width = 0.00m = 0 cm");



///////////////////////////////////////////////////////////////////////////////
//------------------------------ TEST STEPS -----------------------------------
///////////////////////////////////////////////////////////////////////////////


TestStep
("step 01"," Camera Displacement ");
    //----------------------
	//---- PRECONDITION ----
	//----------------------
    

    //----------------------
	//----- TEST STEP ------
	//----------------------
    DiagnosticRequest.BYTE(0) = DiagnosticAddress;
    DiagnosticRequest.BYTE(1) = SID_ReadMemory;
    DiagnosticRequest.BYTE(2) = PID_CameraDisplacement;
    DiagnosticRequest.BYTE(3) = 0xFF;
    DiagnosticRequest.BYTE(4) = 0xFF;
    DiagnosticRequest.BYTE(5) = 0xFF;
    DiagnosticRequest.BYTE(6) = 0xFF;
    DiagnosticRequest.BYTE(7) = 0xFF;

    output(DiagnosticRequest);


    //-----------------------
	//--- EXPECTED RESULT ---
    //-----------------------
	if( 1 != TestWaitForMessage(Dia_4F1h, TimeOut) )
	{
	   TestStepFail("Diagnosis Response timed out");
	}
    // check response time
    if( 1 == TestResponseTime )
    {
       if( MaxResponseTime < GetResponseTime())
       {
          write("Time of request = %d ms", ResponseTime);
          TestStepFail("Max. response time exceeded");
       }
    }
    // check response content
    if(   ( DiagnosticAddress      != getSignal(Dia_4F1h::STA_DIAG_ANTWORT_TN) )
       || ( (SID_ReadMemory + 0x40)!= getSignal(Dia_4F1h::STA_DIAG_ANTWORT_B1) )
       || ( PID_CameraDisplacement != getSignal(Dia_4F1h::STA_DIAG_ANTWORT_B2) )
       || ( 0x00 != getSignal(Dia_4F1h::STA_DIAG_ANTWORT_B3) )
       || ( 0x00 != getSignal(Dia_4F1h::STA_DIAG_ANTWORT_B4) )
      )
    {
        TestStepFail("wrong message content");
    }


    //----------------------
	//--- POSTCONDITION ----
    //----------------------




///////////////////////////////////////////////////////////////////////////////
//------------------------------ TEST CASE END --------------------------------
///////////////////////////////////////////////////////////////////////////////
}
/*@@end*/

/*@@testcase:TC_121_ReadPitchAngle_default():*/
testcase TC_121_ReadPitchAngle_default ()
{
   //LOCALS


///////////////////////////////////////////////////////////////////////////////
//----------------------------- TEST CASE INFO --------------------------------
///////////////////////////////////////////////////////////////////////////////
	TestCaseTitle("ID_1007","4.13.12.1 - Read Pitch Angle (default)");
	TestCaseDescription("This test should prove that the Read Memory diagnosis service");
	TestCaseDescription("Pitch Angle - nominal works correctly.");
	TestCaseDescription("default value:  12,5°=> 0x007B ( 0x004D @ EEPROM )");



///////////////////////////////////////////////////////////////////////////////
//------------------------------ TEST STEPS -----------------------------------
///////////////////////////////////////////////////////////////////////////////


TestStep
("step 01"," Pitch Angle ");
    //----------------------
	//---- PRECONDITION ----
	//----------------------
    

    //----------------------
	//----- TEST STEP ------
    DiagnosticRequest.BYTE(0) = DiagnosticAddress;
    DiagnosticRequest.BYTE(1) = SID_ReadMemory;
    DiagnosticRequest.BYTE(2) = PID_PitchAngle;
    DiagnosticRequest.BYTE(3) = 0xFF;
    DiagnosticRequest.BYTE(4) = 0xFF;
    DiagnosticRequest.BYTE(5) = 0xFF;
    DiagnosticRequest.BYTE(6) = 0xFF;
    DiagnosticRequest.BYTE(7) = 0xFF;

    output(DiagnosticRequest);


    //-----------------------
	//--- EXPECTED RESULT ---
    //-----------------------
	if( 1 != TestWaitForMessage(Dia_4F1h, TimeOut) )
	{
	   TestStepFail("Diagnosis Response timed out");
	}
    // check response time
    if( 1 == TestResponseTime )
    {
       if( MaxResponseTime < GetResponseTime())
       {
          write("Time of request = %d ms", ResponseTime);
          TestStepFail("Max. response time exceeded");
       }
    }
    // check response content
    if(   ( DiagnosticAddress      != getSignal(Dia_4F1h::STA_DIAG_ANTWORT_TN) )
       || ( (SID_ReadMemory + 0x40)!= getSignal(Dia_4F1h::STA_DIAG_ANTWORT_B1) )
       || ( PID_PitchAngle         != getSignal(Dia_4F1h::STA_DIAG_ANTWORT_B2) )
       || ( 0x7B != getSignal(Dia_4F1h::STA_DIAG_ANTWORT_B3) )
       || ( 0x00 != getSignal(Dia_4F1h::STA_DIAG_ANTWORT_B4) )

      )
    {
        TestStepFail("wrong message content");
    }


    //----------------------
	//--- POSTCONDITION ----
    //----------------------




///////////////////////////////////////////////////////////////////////////////
//------------------------------ TEST CASE END --------------------------------
///////////////////////////////////////////////////////////////////////////////
}
/*@@end*/

/*@@testcase:TC_131_ReadRollAngle_default():*/
testcase TC_131_ReadRollAngle_default ()
{
   //LOCALS


///////////////////////////////////////////////////////////////////////////////
//----------------------------- TEST CASE INFO --------------------------------
///////////////////////////////////////////////////////////////////////////////
	TestCaseTitle("ID_1009","4.13.13.1 - Read Roll Angle (default)");
	TestCaseDescription("This test should prove that the Read Memory diagnosis service");
	TestCaseDescription("for Roll Angle - nominal works correctly.");
	TestCaseDescription("default value:  0° => 0x0000 ( 0x0064 @ EEPROM )");



///////////////////////////////////////////////////////////////////////////////
//------------------------------ TEST STEPS -----------------------------------
///////////////////////////////////////////////////////////////////////////////


TestStep
("step 01"," Roll Angle ");
    //----------------------
	//---- PRECONDITION ----
	//----------------------
    

    //----------------------
	//----- TEST STEP ------
	//----------------------
    DiagnosticRequest.BYTE(0) = DiagnosticAddress;
    DiagnosticRequest.BYTE(1) = SID_ReadMemory;
    DiagnosticRequest.BYTE(2) = PID_RollAngle;
    DiagnosticRequest.BYTE(3) = 0xFF;
    DiagnosticRequest.BYTE(4) = 0xFF;
    DiagnosticRequest.BYTE(5) = 0xFF;
    DiagnosticRequest.BYTE(6) = 0xFF;
    DiagnosticRequest.BYTE(7) = 0xFF;

    output(DiagnosticRequest);


    //-----------------------
	//--- EXPECTED RESULT ---
    //-----------------------
	if( 1 != TestWaitForMessage(Dia_4F1h, TimeOut) )
	{
	   TestStepFail("Diagnosis Response timed out");
	}
    // check response time
    if( 1 == TestResponseTime )
    {
       if( MaxResponseTime < GetResponseTime())
       {
          write("Time of request = %d ms", ResponseTime);
          TestStepFail("Max. response time exceeded");
       }
    }
    // check response content
    if(   ( DiagnosticAddress      != getSignal(Dia_4F1h::STA_DIAG_ANTWORT_TN) )
       || ( (SID_ReadMemory + 0x40)!= getSignal(Dia_4F1h::STA_DIAG_ANTWORT_B1) )
       || ( PID_RollAngle          != getSignal(Dia_4F1h::STA_DIAG_ANTWORT_B2) )
       || ( 0x00 != getSignal(Dia_4F1h::STA_DIAG_ANTWORT_B3) )
       || ( 0x00 != getSignal(Dia_4F1h::STA_DIAG_ANTWORT_B4) )
      )
    {
        TestStepFail("wrong message content");
    }


    //----------------------
	//--- POSTCONDITION ----
    //----------------------




///////////////////////////////////////////////////////////////////////////////
//------------------------------ TEST CASE END --------------------------------
///////////////////////////////////////////////////////////////////////////////
}
/*@@end*/

/*@@testcase:TC_141_ReadStartStateAfterIgnition_default():*/
testcase TC_141_ReadStartStateAfterIgnition_default ()
{
   //LOCALS


///////////////////////////////////////////////////////////////////////////////
//----------------------------- TEST CASE INFO --------------------------------
///////////////////////////////////////////////////////////////////////////////
	TestCaseTitle("ID_963","4.13.14.1 - Read StartStateAfterIgnition (default)");
	TestCaseDescription("This test should prove that the Read Memory diagnosis service");
	TestCaseDescription("for Start State After Ignition On works correctly.");
	TestCaseDescription("default:  0xFD = enabled"); 


///////////////////////////////////////////////////////////////////////////////
//------------------------------ TEST STEPS -----------------------------------
///////////////////////////////////////////////////////////////////////////////


TestStep
("step 01"," Start State After Ignition ON ");
    //----------------------
	//---- PRECONDITION ----
	//----------------------
    

    //----------------------
	//----- TEST STEP ------
	//----------------------
    DiagnosticRequest.BYTE(0) = DiagnosticAddress;
    DiagnosticRequest.BYTE(1) = SID_ReadMemory;
    DiagnosticRequest.BYTE(2) = PID_StartStateAfterIgnition;
    DiagnosticRequest.BYTE(3) = 0xFF;
    DiagnosticRequest.BYTE(4) = 0xFF;
    DiagnosticRequest.BYTE(5) = 0xFF;
    DiagnosticRequest.BYTE(6) = 0xFF;
    DiagnosticRequest.BYTE(7) = 0xFF;

    output(DiagnosticRequest);


    //-----------------------
	//--- EXPECTED RESULT ---
    //-----------------------
	if( 1 != TestWaitForMessage(Dia_4F1h, TimeOut) )
	{
	   TestStepFail("Diagnosis Response timed out");
	}
    // check response time
    if( 1 == TestResponseTime )
    {
       if( MaxResponseTime < GetResponseTime())
       {
          write("Time of request = %d ms", ResponseTime);
          TestStepFail("Max. response time exceeded");
       }
    }
    // check response content 
    if(   ( DiagnosticAddress          != getSignal(Dia_4F1h::STA_DIAG_ANTWORT_TN) )
       || ( (SID_ReadMemory + 0x40)    != getSignal(Dia_4F1h::STA_DIAG_ANTWORT_B1) )
       || ( PID_StartStateAfterIgnition!= getSignal(Dia_4F1h::STA_DIAG_ANTWORT_B2) )
       || ( 0xFD != getSignal(Dia_4F1h::STA_DIAG_ANTWORT_B3) )
      )
    {
        TestStepFail("wrong message content");
    }


    //----------------------
	//--- POSTCONDITION ----
    //----------------------




///////////////////////////////////////////////////////////////////////////////
//------------------------------ TEST CASE END --------------------------------
///////////////////////////////////////////////////////////////////////////////
}
/*@@end*/

/*@@testcase:TC_151_ReadMuteEnable_default():*/
testcase TC_151_ReadMuteEnable_default ()
{
   //LOCALS


///////////////////////////////////////////////////////////////////////////////
//----------------------------- TEST CASE INFO --------------------------------
///////////////////////////////////////////////////////////////////////////////
	TestCaseTitle("ID_967","4.13.15.1 - Read Mute Enable (default)");
	TestCaseDescription("This test should prove that the Read Memory diagnosis service");
	TestCaseDescription("for Mute Enable works correctly.");
	TestCaseDescription("default:	0xFD = enabled");


///////////////////////////////////////////////////////////////////////////////
//------------------------------ TEST STEPS -----------------------------------
///////////////////////////////////////////////////////////////////////////////


TestStep
("step 01"," Mute Enable/Disable ");
    //----------------------
	//---- PRECONDITION ----
	//----------------------
    

    //----------------------
	//----- TEST STEP ------
	//----------------------
    DiagnosticRequest.BYTE(0) = DiagnosticAddress;
    DiagnosticRequest.BYTE(1) = SID_ReadMemory;
    DiagnosticRequest.BYTE(2) = PID_MuteEnable;
    DiagnosticRequest.BYTE(3) = 0xFF;
    DiagnosticRequest.BYTE(4) = 0xFF;
    DiagnosticRequest.BYTE(5) = 0xFF;
    DiagnosticRequest.BYTE(6) = 0xFF;
    DiagnosticRequest.BYTE(7) = 0xFF;

    output(DiagnosticRequest);


    //-----------------------
	//--- EXPECTED RESULT ---
    //-----------------------
	if( 1 != TestWaitForMessage(Dia_4F1h, TimeOut) )
	{
	   TestStepFail("Diagnosis Response timed out");
	}
    // check response time
    if( 1 == TestResponseTime )
    {
       if( MaxResponseTime < GetResponseTime())
       {
          write("Time of request = %d ms", ResponseTime);
          TestStepFail("Max. response time exceeded");
       }
    }
    // check response content 
    if(   ( DiagnosticAddress      != getSignal(Dia_4F1h::STA_DIAG_ANTWORT_TN) )
       || ( (SID_ReadMemory + 0x40)!= getSignal(Dia_4F1h::STA_DIAG_ANTWORT_B1) )
       || ( PID_MuteEnable         != getSignal(Dia_4F1h::STA_DIAG_ANTWORT_B2) )
       || ( 0xFD != getSignal(Dia_4F1h::STA_DIAG_ANTWORT_B3) )
      )
    {
        TestStepFail("wrong message content");
    }


    //----------------------
	//--- POSTCONDITION ----
    //----------------------




///////////////////////////////////////////////////////////////////////////////
//------------------------------ TEST CASE END --------------------------------
///////////////////////////////////////////////////////////////////////////////
}
/*@@end*/

/*@@testcase:TC_ReadSwitchLedEnable():*/
testcase TC_ReadSwitchLedEnable ()
{
   //LOCALS


///////////////////////////////////////////////////////////////////////////////
//----------------------------- TEST CASE INFO --------------------------------
///////////////////////////////////////////////////////////////////////////////
	TestCaseTitle("ID_971","4.17.16.1 - Read for Switch LED Enable/Disable (default)");
	TestCaseDescription("This test should prove that the Read Memory diagnosis service");
	TestCaseDescription("for for Switch LED Enable/Disable works correctly.");
	TestCaseDescription("default:	0xFD = enabled");


///////////////////////////////////////////////////////////////////////////////
//------------------------------ TEST STEPS -----------------------------------
///////////////////////////////////////////////////////////////////////////////


TestStep
("step 01"," Switch LED Enable ");
    //----------------------
	//----- STEP-ENTRY -----
	//----------------------


    //----------------------
	//----- STIMULATE ------
	//----------------------
    DiagnosticRequest.BYTE(0) = DiagnosticAddress;
    DiagnosticRequest.BYTE(1) = SID_ReadMemory;
    DiagnosticRequest.BYTE(2) = PID_SwitchLedEnable;
    DiagnosticRequest.BYTE(3) = 0xFF;
    DiagnosticRequest.BYTE(4) = 0xFF;
    DiagnosticRequest.BYTE(5) = 0xFF;
    DiagnosticRequest.BYTE(6) = 0xFF;
    DiagnosticRequest.BYTE(7) = 0xFF;

    output(DiagnosticRequest);


    //-----------------------
	//- EVALUATION & REPORT -
    //-----------------------
	if( 1 != TestWaitForMessage(Dia_4F1h, TimeOut) )
	{
	   TestStepFail("Diagnosis Response timed out");
	}

    if( 1 == TestResponseTime )
    {
       //TimeStampRequest  = getSignalTime(Dia_4F0h::STA_DIAG_FRAGE_TN);
       //TimeStampResponse = getSignalTime(Dia_4F1h::STA_DIAG_ANTWORT_TN);
       ResponseTime      = GetResponseTime();
       if( MaxResponseTime < ResponseTime)
       {
          write("Time of request = %d ms", ResponseTime);
          TestStepFail("Max. response time exceeded");
       }
    }

    
    if(   ( DiagnosticAddress      != getSignal(Dia_4F1h::STA_DIAG_ANTWORT_TN) )
       || ( (SID_ReadMemory + 0x40)!= getSignal(Dia_4F1h::STA_DIAG_ANTWORT_B1) )
       || ( PID_SwitchLedEnable    != getSignal(Dia_4F1h::STA_DIAG_ANTWORT_B2) )
       || ( 0xFD != getSignal(Dia_4F1h::STA_DIAG_ANTWORT_B3) )
       || ( 0xFF != getSignal(Dia_4F1h::STA_DIAG_ANTWORT_B4) )
       || ( 0xFF != getSignal(Dia_4F1h::STA_DIAG_ANTWORT_B5) )
       || ( 0xFF != getSignal(Dia_4F1h::STA_DIAG_ANTWORT_B6) )
       || ( 0xFF != getSignal(Dia_4F1h::STA_DIAG_ANTWORT_B7) )
      )
    {
        TestStepFail("wrong message content");
    }


    //----------------------
	//----- STEP-EXIT ------
    //----------------------




///////////////////////////////////////////////////////////////////////////////
//------------------------------ TEST CASE END --------------------------------
///////////////////////////////////////////////////////////////////////////////
}
/*@@end*/

/*@@testcase:TC_ReadTurnSignalSource():*/
testcase TC_ReadTurnSignalSource ()
{
   //LOCALS


///////////////////////////////////////////////////////////////////////////////
//----------------------------- TEST CASE INFO --------------------------------
///////////////////////////////////////////////////////////////////////////////
	TestCaseTitle("ID_975","4.17.18.1 - Read TurnSignalSource (default)");
	TestCaseDescription("This test should prove that the Read Memory diagnosis service");
    TestCaseDescription("for Turn Signal Source works correctly, by returning the value");
	TestCaseDescription(" stored in EEPROM.");
    TestCaseDescription("default:	0xFC = CAN");


///////////////////////////////////////////////////////////////////////////////
//------------------------------ TEST STEPS -----------------------------------
///////////////////////////////////////////////////////////////////////////////


TestStep
("step 01"," Turn Signal Source ");
    //----------------------
	//----- STEP-ENTRY -----
	//----------------------


    //----------------------
	//----- STIMULATE ------
	//----------------------
    DiagnosticRequest.BYTE(0) = DiagnosticAddress;
    DiagnosticRequest.BYTE(1) = SID_ReadMemory;
    DiagnosticRequest.BYTE(2) = PID_TurnSignalSource;
    DiagnosticRequest.BYTE(3) = 0xFF;
    DiagnosticRequest.BYTE(4) = 0xFF;
    DiagnosticRequest.BYTE(5) = 0xFF;
    DiagnosticRequest.BYTE(6) = 0xFF;
    DiagnosticRequest.BYTE(7) = 0xFF;

    output(DiagnosticRequest);


    //-----------------------
	//- EVALUATION & REPORT -
    //-----------------------
	if( 1 != TestWaitForMessage(Dia_4F1h, TimeOut) )
	{
	   TestStepFail("Diagnosis Response timed out");
	}

    if( 1 == TestResponseTime )
    {
       //TimeStampRequest  = getSignalTime(Dia_4F0h::STA_DIAG_FRAGE_TN);
       //TimeStampResponse = getSignalTime(Dia_4F1h::STA_DIAG_ANTWORT_TN);
       ResponseTime      = GetResponseTime();
       if( MaxResponseTime < ResponseTime)
       {
          write("Time of request = %d ms", ResponseTime);
          TestStepFail("Max. response time exceeded");
       }
    }

    
    if(   ( DiagnosticAddress      != getSignal(Dia_4F1h::STA_DIAG_ANTWORT_TN) )
       || ( (SID_ReadMemory + 0x40)!= getSignal(Dia_4F1h::STA_DIAG_ANTWORT_B1) )
       || ( PID_TurnSignalSource   != getSignal(Dia_4F1h::STA_DIAG_ANTWORT_B2) )
       || ( 0xFC != getSignal(Dia_4F1h::STA_DIAG_ANTWORT_B3) )
       || ( 0xFF != getSignal(Dia_4F1h::STA_DIAG_ANTWORT_B4) )
       || ( 0xFF != getSignal(Dia_4F1h::STA_DIAG_ANTWORT_B5) )
       || ( 0xFF != getSignal(Dia_4F1h::STA_DIAG_ANTWORT_B6) )
       || ( 0xFF != getSignal(Dia_4F1h::STA_DIAG_ANTWORT_B7) )
      )
    {
        TestStepFail("wrong message content");
    }


    //----------------------
	//----- STEP-EXIT ------
    //----------------------




///////////////////////////////////////////////////////////////////////////////
//------------------------------ TEST CASE END --------------------------------
///////////////////////////////////////////////////////////////////////////////
}
/*@@end*/

/*@@testcase:TC_ReadSwitchSource():*/
testcase TC_ReadSwitchSource ()
{
   //LOCALS


///////////////////////////////////////////////////////////////////////////////
//----------------------------- TEST CASE INFO --------------------------------
///////////////////////////////////////////////////////////////////////////////
	TestCaseTitle("ID_979","4.20.18.1 - Read SwitchSource (default)");
	TestCaseDescription("This test should prove that the Read Memory diagnosis service");
    TestCaseDescription("for Switch Source works correctly, by returning the value");
	TestCaseDescription("stored in EEPROM.");
    TestCaseDescription("default:	0xFC = CAN");


///////////////////////////////////////////////////////////////////////////////
//------------------------------ TEST STEPS -----------------------------------
///////////////////////////////////////////////////////////////////////////////


TestStep
("step 01"," Switch Source ");
    //----------------------
	//----- STEP-ENTRY -----
	//----------------------


    //----------------------
	//----- STIMULATE ------
	//----------------------
    DiagnosticRequest.BYTE(0) = DiagnosticAddress;
    DiagnosticRequest.BYTE(1) = SID_ReadMemory;
    DiagnosticRequest.BYTE(2) = PID_SwitchSource;
    DiagnosticRequest.BYTE(3) = 0xFF;
    DiagnosticRequest.BYTE(4) = 0xFF;
    DiagnosticRequest.BYTE(5) = 0xFF;
    DiagnosticRequest.BYTE(6) = 0xFF;
    DiagnosticRequest.BYTE(7) = 0xFF;

    output(DiagnosticRequest);


    //-----------------------
	//- EVALUATION & REPORT -
    //-----------------------
	if( 1 != TestWaitForMessage(Dia_4F1h, TimeOut) )
	{
	   TestStepFail("Diagnosis Response timed out");
	}

    if( 1 == TestResponseTime )
    {
       //TimeStampRequest  = getSignalTime(Dia_4F0h::STA_DIAG_FRAGE_TN);
       //TimeStampResponse = getSignalTime(Dia_4F1h::STA_DIAG_ANTWORT_TN);
       ResponseTime      = GetResponseTime();
       if( MaxResponseTime < ResponseTime)
       {
          write("Time of request = %d ms", ResponseTime);
          TestStepFail("Max. response time exceeded");
       }
    }

    
    if(   ( DiagnosticAddress      != getSignal(Dia_4F1h::STA_DIAG_ANTWORT_TN) )
       || ( (SID_ReadMemory + 0x40)!= getSignal(Dia_4F1h::STA_DIAG_ANTWORT_B1) )
       || ( PID_SwitchSource       != getSignal(Dia_4F1h::STA_DIAG_ANTWORT_B2) )
       || ( 0xFC != getSignal(Dia_4F1h::STA_DIAG_ANTWORT_B3) )
       || ( 0xFF != getSignal(Dia_4F1h::STA_DIAG_ANTWORT_B4) )
       || ( 0xFF != getSignal(Dia_4F1h::STA_DIAG_ANTWORT_B5) )
       || ( 0xFF != getSignal(Dia_4F1h::STA_DIAG_ANTWORT_B6) )
       || ( 0xFF != getSignal(Dia_4F1h::STA_DIAG_ANTWORT_B7) )
      )
    {
        TestStepFail("wrong message content");
    }


    //----------------------
	//----- STEP-EXIT ------
    //----------------------




///////////////////////////////////////////////////////////////////////////////
//------------------------------ TEST CASE END --------------------------------
///////////////////////////////////////////////////////////////////////////////
}
/*@@end*/

/*@@testcase:TC_ReadTypeOfCanMatrix():*/
testcase TC_ReadTypeOfCanMatrix ()
{
   //LOCALS


///////////////////////////////////////////////////////////////////////////////
//----------------------------- TEST CASE INFO --------------------------------
///////////////////////////////////////////////////////////////////////////////
	TestCaseTitle("ID_983","4.17.20.1 - Read TypeOfCANMatrix (default)");
	TestCaseDescription("This test should prove that the Read Memory diagnosis service");
	TestCaseDescription("for Type Of  CAN Matrix works correctly, by returning the value");
	TestCaseDescription("stored in EEPROM.");
	TestCaseDescription("default: 	0x0001 = DC-Truck");


///////////////////////////////////////////////////////////////////////////////
//------------------------------ TEST STEPS -----------------------------------
///////////////////////////////////////////////////////////////////////////////


TestStep
("step 01"," Type of CAN Matrix ");
    //----------------------
	//----- STEP-ENTRY -----
	//----------------------


    //----------------------
	//----- STIMULATE ------
	//----------------------
    DiagnosticRequest.BYTE(0) = DiagnosticAddress;
    DiagnosticRequest.BYTE(1) = SID_ReadMemory;
    DiagnosticRequest.BYTE(2) = PID_TypeOfCanMatrix;
    DiagnosticRequest.BYTE(3) = 0xFF;
    DiagnosticRequest.BYTE(4) = 0xFF;
    DiagnosticRequest.BYTE(5) = 0xFF;
    DiagnosticRequest.BYTE(6) = 0xFF;
    DiagnosticRequest.BYTE(7) = 0xFF;

    output(DiagnosticRequest);


    //-----------------------
	//- EVALUATION & REPORT -
    //-----------------------
	if( 1 != TestWaitForMessage(Dia_4F1h, TimeOut) )
	{
	   TestStepFail("Diagnosis Response timed out");
	}

    if( 1 == TestResponseTime )
    {
       //TimeStampRequest  = getSignalTime(Dia_4F0h::STA_DIAG_FRAGE_TN);
       //TimeStampResponse = getSignalTime(Dia_4F1h::STA_DIAG_ANTWORT_TN);
       ResponseTime      = GetResponseTime();
       if( MaxResponseTime < ResponseTime)
       {
          write("Time of request = %d ms", ResponseTime);
          TestStepFail("Max. response time exceeded");
       }
    }

    
    if(   ( DiagnosticAddress      != getSignal(Dia_4F1h::STA_DIAG_ANTWORT_TN) )
       || ( (SID_ReadMemory + 0x40)!= getSignal(Dia_4F1h::STA_DIAG_ANTWORT_B1) )
       || ( PID_TypeOfCanMatrix    != getSignal(Dia_4F1h::STA_DIAG_ANTWORT_B2) )
       || ( 0x00 != getSignal(Dia_4F1h::STA_DIAG_ANTWORT_B3) )
       || ( 0x01 != getSignal(Dia_4F1h::STA_DIAG_ANTWORT_B4) )
       || ( 0xFF != getSignal(Dia_4F1h::STA_DIAG_ANTWORT_B5) )
       || ( 0xFF != getSignal(Dia_4F1h::STA_DIAG_ANTWORT_B6) )
       || ( 0xFF != getSignal(Dia_4F1h::STA_DIAG_ANTWORT_B7) )
      )
    {
        TestStepFail("wrong message content");
    }


    //----------------------
	//----- STEP-EXIT ------
    //----------------------




///////////////////////////////////////////////////////////////////////////////
//------------------------------ TEST CASE END --------------------------------
///////////////////////////////////////////////////////////////////////////////
}
/*@@end*/

/*@@testcase:TC_ReadTypeOfStatusLamp():*/
testcase TC_ReadTypeOfStatusLamp ()
{
   //LOCALS


///////////////////////////////////////////////////////////////////////////////
//----------------------------- TEST CASE INFO --------------------------------
///////////////////////////////////////////////////////////////////////////////
	TestCaseTitle("ID_987","4.17.21.1 - Read TypeOfStatusLamp (default)");
	TestCaseDescription("This test should prove that the Read Memory diagnosis service");
	TestCaseDescription("for Type Of Status Lamp works correctly, by returning the value");
	TestCaseDescription("stored in EEPROM.");
	TestCaseDescription("default: 	0x0002 = ** ??");


///////////////////////////////////////////////////////////////////////////////
//------------------------------ TEST STEPS -----------------------------------
///////////////////////////////////////////////////////////////////////////////


TestStep
("step 01"," Type of Status Lamp ");
    //----------------------
	//----- STEP-ENTRY -----
	//----------------------


    //----------------------
	//----- STIMULATE ------
	//----------------------
    DiagnosticRequest.BYTE(0) = DiagnosticAddress;
    DiagnosticRequest.BYTE(1) = SID_ReadMemory;
    DiagnosticRequest.BYTE(2) = PID_TypeOfStatusLamp;
    DiagnosticRequest.BYTE(3) = 0xFF;
    DiagnosticRequest.BYTE(4) = 0xFF;
    DiagnosticRequest.BYTE(5) = 0xFF;
    DiagnosticRequest.BYTE(6) = 0xFF;
    DiagnosticRequest.BYTE(7) = 0xFF;

    output(DiagnosticRequest);


    //-----------------------
	//- EVALUATION & REPORT -
    //-----------------------
	if( 1 != TestWaitForMessage(Dia_4F1h, TimeOut) )
	{
	   TestStepFail("Diagnosis Response timed out");
	}

    if( 1 == TestResponseTime )
    {
       //TimeStampRequest  = getSignalTime(Dia_4F0h::STA_DIAG_FRAGE_TN);
       //TimeStampResponse = getSignalTime(Dia_4F1h::STA_DIAG_ANTWORT_TN);
       ResponseTime      = GetResponseTime();
       if( MaxResponseTime < ResponseTime)
       {
          write("Time of request = %d ms", ResponseTime);
          TestStepFail("Max. response time exceeded");
       }
    }

    
    if(   ( DiagnosticAddress      != getSignal(Dia_4F1h::STA_DIAG_ANTWORT_TN) )
       || ( (SID_ReadMemory + 0x40)!= getSignal(Dia_4F1h::STA_DIAG_ANTWORT_B1) )
       || ( PID_TypeOfStatusLamp   != getSignal(Dia_4F1h::STA_DIAG_ANTWORT_B2) )
       || ( 0x00 != getSignal(Dia_4F1h::STA_DIAG_ANTWORT_B3) )
       || ( 0x02 != getSignal(Dia_4F1h::STA_DIAG_ANTWORT_B4) )
       || ( 0xFF != getSignal(Dia_4F1h::STA_DIAG_ANTWORT_B5) )
       || ( 0xFF != getSignal(Dia_4F1h::STA_DIAG_ANTWORT_B6) )
       || ( 0xFF != getSignal(Dia_4F1h::STA_DIAG_ANTWORT_B7) )
      )
    {
        TestStepFail("wrong message content");
    }


    //----------------------
	//----- STEP-EXIT ------
    //----------------------




///////////////////////////////////////////////////////////////////////////////
//------------------------------ TEST CASE END --------------------------------
///////////////////////////////////////////////////////////////////////////////
}
/*@@end*/

/*@@testcase:TC_ReadWarningDestination():*/
testcase TC_ReadWarningDestination ()
{
   //LOCALS


///////////////////////////////////////////////////////////////////////////////
//----------------------------- TEST CASE INFO --------------------------------
///////////////////////////////////////////////////////////////////////////////
	TestCaseTitle("ID_959","4.17.22.1 - Read WarningDestination (default)");
	TestCaseDescription("This test should prove that the Read Memory diagnosis service");
	TestCaseDescription("for Warning Destination works correctly, by returning the value");
	TestCaseDescription("stored in EEPROM.");
	TestCaseDescription("default: 	0x0028 = ** ??");



///////////////////////////////////////////////////////////////////////////////
//------------------------------ TEST STEPS -----------------------------------
///////////////////////////////////////////////////////////////////////////////


TestStep
("step 01"," Warning Destination ");
    //----------------------
	//----- STEP-ENTRY -----
	//----------------------


    //----------------------
	//----- STIMULATE ------
	//----------------------
    DiagnosticRequest.BYTE(0) = DiagnosticAddress;
    DiagnosticRequest.BYTE(1) = SID_ReadMemory;
    DiagnosticRequest.BYTE(2) = PID_WarningDestination;
    DiagnosticRequest.BYTE(3) = 0xFF;
    DiagnosticRequest.BYTE(4) = 0xFF;
    DiagnosticRequest.BYTE(5) = 0xFF;
    DiagnosticRequest.BYTE(6) = 0xFF;
    DiagnosticRequest.BYTE(7) = 0xFF;

    output(DiagnosticRequest);


    //-----------------------
	//- EVALUATION & REPORT -
    //-----------------------
	if( 1 != TestWaitForMessage(Dia_4F1h, TimeOut) )
	{
	   TestStepFail("Diagnosis Response timed out");
	}

    if( 1 == TestResponseTime )
    {
       //TimeStampRequest  = getSignalTime(Dia_4F0h::STA_DIAG_FRAGE_TN);
       //TimeStampResponse = getSignalTime(Dia_4F1h::STA_DIAG_ANTWORT_TN);
       ResponseTime      = GetResponseTime();
       if( MaxResponseTime < ResponseTime)
       {
          write("Time of request = %d ms", ResponseTime);
          TestStepFail("Max. response time exceeded");
       }
    }

    
    if(   ( DiagnosticAddress      != getSignal(Dia_4F1h::STA_DIAG_ANTWORT_TN) )
       || ( (SID_ReadMemory + 0x40)!= getSignal(Dia_4F1h::STA_DIAG_ANTWORT_B1) )
       || ( PID_WarningDestination != getSignal(Dia_4F1h::STA_DIAG_ANTWORT_B2) )
       || ( 0x00 != getSignal(Dia_4F1h::STA_DIAG_ANTWORT_B3) )
       || ( 0x28 != getSignal(Dia_4F1h::STA_DIAG_ANTWORT_B4) )
       || ( 0xFF != getSignal(Dia_4F1h::STA_DIAG_ANTWORT_B5) )
       || ( 0xFF != getSignal(Dia_4F1h::STA_DIAG_ANTWORT_B6) )
       || ( 0xFF != getSignal(Dia_4F1h::STA_DIAG_ANTWORT_B7) )
      )
    {
        TestStepFail("wrong message content");
    }


    //----------------------
	//----- STEP-EXIT ------
    //----------------------




///////////////////////////////////////////////////////////////////////////////
//------------------------------ TEST CASE END --------------------------------
///////////////////////////////////////////////////////////////////////////////
}
/*@@end*/

/*@@testcase:TC_ReadActivationSpeed():*/
testcase TC_ReadActivationSpeed ()
{
   //LOCALS


///////////////////////////////////////////////////////////////////////////////
//----------------------------- TEST CASE INFO --------------------------------
///////////////////////////////////////////////////////////////////////////////
	TestCaseTitle("ID_1165","4.17.23.1 - Read ActivationSpeed (default)");
	TestCaseDescription("This test should prove that the Read Memory diagnosis service for Activation");
	TestCaseDescription("Width works correctly, by returning the value written in EEPROM.");
	TestCaseDescription("default: 	60km/h = 0x003C ( 0x0341 @ EEPROM )");
	TestCaseDescription("resolution:	1km/h");


///////////////////////////////////////////////////////////////////////////////
//------------------------------ TEST STEPS -----------------------------------
///////////////////////////////////////////////////////////////////////////////


TestStep
("step 01"," Activation Speed ");
    //----------------------
	//----- STEP-ENTRY -----
	//----------------------


    //----------------------
	//----- STIMULATE ------
	//----------------------
    DiagnosticRequest.BYTE(0) = DiagnosticAddress;
    DiagnosticRequest.BYTE(1) = SID_ReadMemory;
    DiagnosticRequest.BYTE(2) = PID_ActivationSpeed;
    DiagnosticRequest.BYTE(3) = 0xFF;
    DiagnosticRequest.BYTE(4) = 0xFF;
    DiagnosticRequest.BYTE(5) = 0xFF;
    DiagnosticRequest.BYTE(6) = 0xFF;
    DiagnosticRequest.BYTE(7) = 0xFF;

    output(DiagnosticRequest);


    //-----------------------
	//- EVALUATION & REPORT -
    //-----------------------
	if( 1 != TestWaitForMessage(Dia_4F1h, TimeOut) )
	{
	   TestStepFail("Diagnosis Response timed out");
	}

    if( 1 == TestResponseTime )
    {
       if( MaxResponseTime < GetResponseTime())
       {
          write("Time of request = %d ms", ResponseTime);
          TestStepFail("Max. response time exceeded");
       }
    }

    
    if(   ( DiagnosticAddress      != getSignal(Dia_4F1h::STA_DIAG_ANTWORT_TN) )
       || ( (SID_ReadMemory + 0x40)!= getSignal(Dia_4F1h::STA_DIAG_ANTWORT_B1) )
       || ( PID_ActivationSpeed    != getSignal(Dia_4F1h::STA_DIAG_ANTWORT_B2) )
       || ( 0x00 != getSignal(Dia_4F1h::STA_DIAG_ANTWORT_B3) )
       || ( 0x3C != getSignal(Dia_4F1h::STA_DIAG_ANTWORT_B4) )
       || ( 0xFF != getSignal(Dia_4F1h::STA_DIAG_ANTWORT_B5) )
       || ( 0xFF != getSignal(Dia_4F1h::STA_DIAG_ANTWORT_B6) )
       || ( 0xFF != getSignal(Dia_4F1h::STA_DIAG_ANTWORT_B7) )
      )
    {
        TestStepFail("wrong message content");
    }


    //----------------------
	//----- STEP-EXIT ------
    //----------------------




///////////////////////////////////////////////////////////////////////////////
//------------------------------ TEST CASE END --------------------------------
///////////////////////////////////////////////////////////////////////////////
}
/*@@end*/

/*@@testcase:TC_ReadTesterIdentificationArrea71():*/
testcase TC_ReadTesterIdentificationArrea71()
{
   //LOCALS
 
 byte b0;
 byte b1;
 byte b2;
 byte b3;
 byte b4;
 byte b5;
 byte b6;
 byte b7;

///////////////////////////////////////////////////////////////////////////////
//----------------------------- TEST CASE INFO --------------------------------
///////////////////////////////////////////////////////////////////////////////
	TestCaseTitle("ID_1168","4.17.24.1 - Read tester identification area (address)");
	TestCaseDescription("This test case request the tester identification,");
    TestCaseDescription("accessed on area $71 last.");


///////////////////////////////////////////////////////////////////////////////
//------------------------------ TEST STEPS -----------------------------------
///////////////////////////////////////////////////////////////////////////////


TestStep
("step 01"," Tester Program Number ");
    //----------------------
	//----- STEP-ENTRY -----
	//----------------------

    //----------------------
	//----- STIMULATE ------
	//----------------------
    DiagnosticRequest.BYTE(0) = DiagnosticAddress;
    DiagnosticRequest.BYTE(1) = SID_ReadMemory;
    DiagnosticRequest.BYTE(2) = PID_TestIdentArr71Arrea;
    DiagnosticRequest.BYTE(3) = 0xFF;
    DiagnosticRequest.BYTE(4) = 0xFF;
    DiagnosticRequest.BYTE(5) = 0xFF;
    DiagnosticRequest.BYTE(6) = 0xFF;
    DiagnosticRequest.BYTE(7) = 0xFF;

    output(DiagnosticRequest);


    //-----------------------
	//- EVALUATION & REPORT -
    //-----------------------
	if( 1 != TestWaitForMessage(Dia_4F1h, TimeOut) )
	{
	   TestStepFail("Diagnosis Response timed out");
	}

    if( 1 == TestResponseTime )
    {
       //TimeStampRequest  = getSignalTime(Dia_4F0h::STA_DIAG_FRAGE_TN);
       //TimeStampResponse = getSignalTime(Dia_4F1h::STA_DIAG_ANTWORT_TN);
       ResponseTime      = GetResponseTime();
       if( MaxResponseTime < ResponseTime)
       {
          write("Time of request = %d ms", ResponseTime);
          TestStepFail("Max. response time exceeded");
       }
    }

    
    if(   ( DiagnosticAddress        !=  (b0 = getSignal(Dia_4F1h::STA_DIAG_ANTWORT_TN)) )
       || ( (SID_ReadMemory + 0x40)  !=  (b1 = getSignal(Dia_4F1h::STA_DIAG_ANTWORT_B1)) )
       || ( PID_TestIdentArr71Arrea  !=  (b2 = getSignal(Dia_4F1h::STA_DIAG_ANTWORT_B2)) )
       || ( cRespIdentArr71Manufactor!=  (b3 = getSignal(Dia_4F1h::STA_DIAG_ANTWORT_B3)) )
       || ( cRespIdentArr71Id1       !=  (b4 = getSignal(Dia_4F1h::STA_DIAG_ANTWORT_B4)) )
       || ( cRespIdentArr71Id2       !=  (b5 = getSignal(Dia_4F1h::STA_DIAG_ANTWORT_B5)) )
       || ( cRespIdentArr71Id3       !=  (b6 = getSignal(Dia_4F1h::STA_DIAG_ANTWORT_B6)) )
       || ( cRespIdentArr71Id4       !=  (b7 = getSignal(Dia_4F1h::STA_DIAG_ANTWORT_B7)) )
      ) 
    { 
        write("EEP-Values: %x, %x, %x, %x, %x, %x, %x, %x", b0,b1,b2,b3,b4,b5,b6,b7); 
        TestStepFail("wrong message content ");
    } 
 
 
    //----------------------
	//----- STEP-EXIT ------
    //----------------------




///////////////////////////////////////////////////////////////////////////////
//------------------------------ TEST CASE END --------------------------------
///////////////////////////////////////////////////////////////////////////////
}
/*@@end*/

/*@@msg:CAN1.KM_24_4g_SPA_v02::SPA_6EBh (0x6EB):*/
on message SPA_6EBh
{
	int i;

/*
	if (ub_CCP_Activity == EEPROM_DUMP)
	{
		aub_CCP_response[0] = this.BYTE(3);
		aub_CCP_response[1] = this.BYTE(4);
		aub_CCP_response[2] = this.BYTE(5);
		aub_CCP_response[3] = this.BYTE(6);
		DumpEEPROM();
	} */
	
    if (ub_CCP_Activity == EEPROM_REVERSE)
	{
		aub_CCP_response[0] = this.BYTE(3);
		aub_CCP_response[1] = this.BYTE(4);
		aub_CCP_response[2] = this.BYTE(5);
		aub_CCP_response[3] = this.BYTE(6);
	    ReverseDumpECU();
	}
	else
	{
       switch (this.BYTE(1))
	   {
	   case 0x00:
           write("Positive Response");
		   break;
      	case 0x01:
      	   //	PutValue(Message_Interpretation, "DAQ Processor Overflow");
           write("DAQ Processor Overflow");
		   break;
	   case 0x10:
	      //	PutValue(Message_Interpretation, "Command Processor Busy");
           write("Command Processor Busy");
		   break;
	   case 0x11:
	   //	PutValue(Message_Interpretation, "DAQ Processor Busy");
           write("DAQ Processor Busy");
		   break;
	   case 0x12:
	   //	PutValue(Message_Interpretation, "Internal Timeout");
           write("Internal Timeout");
		   break;
	   case 0x18:
	   //	PutValue(Message_Interpretation, "Key Request");
           write("Key Request");
		   break;
	   case 0x19:
	   //	PutValue(Message_Interpretation, "Session Status Request");
           write("Session Status Request");
		   break;
	   case 0x20:
	   //	PutValue(Message_Interpretation, "Cold Start Request");
           write("Cold Start Request");
		   break;
	   case 0x21:
	   //	PutValue(Message_Interpretation, "Calibration Data Initialization Request");
           write("Calibration Data Initialization Request");
		   break;
	   case 0x22:
	   //	PutValue(Message_Interpretation, "DAQ List Initialization Request");
           write("DAQ List Initialization Request");
		   break;
	   case 0x23:
	   //	PutValue(Message_Interpretation, "Code Update Request");
           write("Code Update Request");
		   break;
	   case 0x30:
	   //	PutValue(Message_Interpretation, "Unknown Command");
           write("Unknown Command");
		   break;
	   case 0x31:
	   //	PutValue(Message_Interpretation, "Command Syntax");
           write("Command Syntax");
		   break;
	   case 0x32:
	   //	PutValue(Message_Interpretation, "Parameter Out of Range");
           write("Parameter Out of Range");
		   break;
	   case 0x33:
	   //	PutValue(Message_Interpretation, "Access Denied");
           write("Access Denied");
		   break;
	   case 0x34:
	   //	PutValue(Message_Interpretation, "Overload");
           write("Overload");
		   break;
	   case 0x35:
	   //	PutValue(Message_Interpretation, "Access Locked");
           write("Access Locked");
		   break;
	   case 0x36:
           write("Resource or Function Not Available");
	       break;
	   }
	}
}
/*@@end*/

/*@@testcase:TC_1_ReadMemory_NoSupportedPID():*/
testcase TC_1_ReadMemory_NoSupportedPID ()
{
   //LOCALS


///////////////////////////////////////////////////////////////////////////////
//----------------------------- TEST CASE INFO --------------------------------
///////////////////////////////////////////////////////////////////////////////
	TestCaseTitle("ID_1982","4.13.1 - ReadMemory - No supported PID");
	TestCaseDescription("In case of no supported PID for the read memory service, the ECU should");
	TestCaseDescription("response with a negative response. This test case verifies the correct");
	TestCaseDescription("working of the negative response.");

  
///////////////////////////////////////////////////////////////////////////////
//------------------------------ TEST STEPS -----------------------------------
///////////////////////////////////////////////////////////////////////////////


TestStep
("step 01"," Not supported PID ");
    //----------------------
	//---- PRECONDITION ----
	//----------------------
    

    //----------------------
	//----- TEST STEP ------
	//----------------------
    DiagnosticRequest.BYTE(0) = DiagnosticAddress;
    DiagnosticRequest.BYTE(1) = SID_ReadMemory;
    DiagnosticRequest.BYTE(2) = 0xAA;  // invalid PID
    DiagnosticRequest.BYTE(3) = 0xFF;
    DiagnosticRequest.BYTE(4) = 0xFF;
    DiagnosticRequest.BYTE(5) = 0xFF;
    DiagnosticRequest.BYTE(6) = 0xFF;
    DiagnosticRequest.BYTE(7) = 0xFF;

    output(DiagnosticRequest);


    //-----------------------
	//--- EXPECTED RESULT ---
    //-----------------------
	if( 1 != TestWaitForMessage(Dia_4F1h, TimeOut) )
	{
	   TestStepFail("Diagnosis Response timed out");
	}
    // check response time
    if( 1 == TestResponseTime )
    {
       if( MaxResponseTime < GetResponseTime())
       {
          write("Time of request = %d ms", ResponseTime);
          TestStepFail("Max. response time exceeded");
       }
    }
    // check response content
    if(   ( DiagnosticAddress      != getSignal(Dia_4F1h::STA_DIAG_ANTWORT_TN) )
       || ( NegativeResponse       != getSignal(Dia_4F1h::STA_DIAG_ANTWORT_B1) )
       || ( SID_ReadMemory         != getSignal(Dia_4F1h::STA_DIAG_ANTWORT_B2) )
       || ( INVALID_FORMAT         != getSignal(Dia_4F1h::STA_DIAG_ANTWORT_B3) )      )
    {
        TestStepFail("wrong message content");
    }


    //----------------------
	//--- POSTCONDITION ----
    //----------------------


///////////////////////////////////////////////////////////////////////////////
//------------------------------ TEST CASE END --------------------------------
///////////////////////////////////////////////////////////////////////////////
}
/*@@end*/

/*@@testcase:TC_ReadTesterIdentificationArrea73():*/
testcase TC_ReadTesterIdentificationArrea73()
{
   //LOCALS


///////////////////////////////////////////////////////////////////////////////
//----------------------------- TEST CASE INFO --------------------------------
///////////////////////////////////////////////////////////////////////////////
	TestCaseTitle("ID_1168","4.17.24.1 - Read tester identification area (address)");
	TestCaseDescription("This test case request the tester identification,");
    TestCaseDescription("accessed on area $71 last.");


///////////////////////////////////////////////////////////////////////////////
//------------------------------ TEST STEPS -----------------------------------
///////////////////////////////////////////////////////////////////////////////


TestStep
("step 01"," Tester Program Number ");
    //----------------------
	//----- STEP-ENTRY -----
	//----------------------

    //----------------------
	//----- STIMULATE ------
	//----------------------
    DiagnosticRequest.BYTE(0) = DiagnosticAddress;
    DiagnosticRequest.BYTE(1) = SID_ReadMemory;
    DiagnosticRequest.BYTE(2) = PID_TestIdentArr73Arrea;
    DiagnosticRequest.BYTE(3) = 0xFF;
    DiagnosticRequest.BYTE(4) = 0xFF;
    DiagnosticRequest.BYTE(5) = 0xFF;
    DiagnosticRequest.BYTE(6) = 0xFF;
    DiagnosticRequest.BYTE(7) = 0xFF;

    output(DiagnosticRequest);


    //-----------------------
	//- EVALUATION & REPORT -
    //-----------------------
	if( 1 != TestWaitForMessage(Dia_4F1h, TimeOut) )
	{
	   TestStepFail("Diagnosis Response timed out");
	}

    if( 1 == TestResponseTime )
    {
       //TimeStampRequest  = getSignalTime(Dia_4F0h::STA_DIAG_FRAGE_TN);
       //TimeStampResponse = getSignalTime(Dia_4F1h::STA_DIAG_ANTWORT_TN);
       ResponseTime      = GetResponseTime();
       if( MaxResponseTime < ResponseTime)
       {
          write("Time of request = %d ms", ResponseTime);
          TestStepFail("Max. response time exceeded");
       }
    }

    
   if(   ( DiagnosticAddress         != getSignal(Dia_4F1h::STA_DIAG_ANTWORT_TN) )
       || ( (SID_ReadMemory + 0x40)  != getSignal(Dia_4F1h::STA_DIAG_ANTWORT_B1) )
       || ( PID_TestIdentArr73Arrea  != getSignal(Dia_4F1h::STA_DIAG_ANTWORT_B2) )
       || ( cRespIdentArr73Manufactor!= getSignal(Dia_4F1h::STA_DIAG_ANTWORT_B3) )
       || ( cRespIdentArr73Id1       != getSignal(Dia_4F1h::STA_DIAG_ANTWORT_B4) )
       || ( cRespIdentArr73Id2       != getSignal(Dia_4F1h::STA_DIAG_ANTWORT_B5) )
       || ( cRespIdentArr73Id3       != getSignal(Dia_4F1h::STA_DIAG_ANTWORT_B6) )
       || ( cRespIdentArr73Id4       != getSignal(Dia_4F1h::STA_DIAG_ANTWORT_B7) )
      )
    {
        TestStepFail("wrong message content");
    }

    //----------------------
	//----- STEP-EXIT ------
    //----------------------




///////////////////////////////////////////////////////////////////////////////
//------------------------------ TEST CASE END --------------------------------
///////////////////////////////////////////////////////////////////////////////
}
/*@@end*/

/*@@testcase:TC_ReadTesterIdentificationArrea77():*/
testcase TC_ReadTesterIdentificationArrea77()
{
   //LOCALS

///////////////////////////////////////////////////////////////////////////////
//----------------------------- TEST CASE INFO --------------------------------
///////////////////////////////////////////////////////////////////////////////
	TestCaseTitle("ID_1168","4.17.24.1 - Read tester identification area (address)");
	TestCaseDescription("This test case request the tester identification,");
    TestCaseDescription("accessed on area $71 last.");


///////////////////////////////////////////////////////////////////////////////
//------------------------------ TEST STEPS -----------------------------------
///////////////////////////////////////////////////////////////////////////////


TestStep
("step 01"," Tester Program Number ");
    //----------------------
	//----- STEP-ENTRY -----
	//----------------------

    //----------------------
	//----- STIMULATE ------
	//----------------------
    DiagnosticRequest.BYTE(0) = DiagnosticAddress;
    DiagnosticRequest.BYTE(1) = SID_ReadMemory;
    DiagnosticRequest.BYTE(2) = PID_TestIdentArr77Arrea;
    DiagnosticRequest.BYTE(3) = 0xFF;
    DiagnosticRequest.BYTE(4) = 0xFF;
    DiagnosticRequest.BYTE(5) = 0xFF;
    DiagnosticRequest.BYTE(6) = 0xFF;
    DiagnosticRequest.BYTE(7) = 0xFF;

    output(DiagnosticRequest);


    //-----------------------
	//- EVALUATION & REPORT -
    //-----------------------
	if( 1 != TestWaitForMessage(Dia_4F1h, TimeOut) )
	{
	   TestStepFail("Diagnosis Response timed out");
	}

    if( 1 == TestResponseTime )
    {
       //TimeStampRequest  = getSignalTime(Dia_4F0h::STA_DIAG_FRAGE_TN);
       //TimeStampResponse = getSignalTime(Dia_4F1h::STA_DIAG_ANTWORT_TN);
       ResponseTime      = GetResponseTime();
       if( MaxResponseTime < ResponseTime)
       {
          write("Time of request = %d ms", ResponseTime);
          TestStepFail("Max. response time exceeded");
       }
    }

    

    if(   ( DiagnosticAddress        != getSignal(Dia_4F1h::STA_DIAG_ANTWORT_TN) )
       || ( (SID_ReadMemory + 0x40)  != getSignal(Dia_4F1h::STA_DIAG_ANTWORT_B1) )
       || ( PID_TestIdentArr77Arrea  != getSignal(Dia_4F1h::STA_DIAG_ANTWORT_B2) )
       || ( cRespIdentArr77Manufactor!= getSignal(Dia_4F1h::STA_DIAG_ANTWORT_B3) )
       || ( cRespIdentArr77Id1       != getSignal(Dia_4F1h::STA_DIAG_ANTWORT_B4) )
       || ( cRespIdentArr77Id2       != getSignal(Dia_4F1h::STA_DIAG_ANTWORT_B5) )
       || ( cRespIdentArr77Id3       != getSignal(Dia_4F1h::STA_DIAG_ANTWORT_B6) )
       || ( cRespIdentArr77Id4       != getSignal(Dia_4F1h::STA_DIAG_ANTWORT_B7) )
      )
    {
        TestStepFail("wrong message content");
    }

    //----------------------
	//----- STEP-EXIT ------
    //----------------------




///////////////////////////////////////////////////////////////////////////////
//------------------------------ TEST CASE END --------------------------------
///////////////////////////////////////////////////////////////////////////////
}
/*@@end*/

/*@@testcase:TC_ReadTesterIdentificationArrea81():*/
testcase TC_ReadTesterIdentificationArrea81()
{
   //LOCALS

///////////////////////////////////////////////////////////////////////////////
//----------------------------- TEST CASE INFO --------------------------------
///////////////////////////////////////////////////////////////////////////////
	TestCaseTitle("ID_1168","4.17.24.1 - Read tester identification area (address)");
	TestCaseDescription("This test case request the tester identification,");
    TestCaseDescription("accessed on area $71 last.");


///////////////////////////////////////////////////////////////////////////////
//------------------------------ TEST STEPS -----------------------------------
///////////////////////////////////////////////////////////////////////////////


TestStep
("step 01"," Tester Program Number ");
    //----------------------
	//----- STEP-ENTRY -----
	//----------------------

    //----------------------
	//----- STIMULATE ------
	//----------------------
    DiagnosticRequest.BYTE(0) = DiagnosticAddress;
    DiagnosticRequest.BYTE(1) = SID_ReadMemory;
    DiagnosticRequest.BYTE(2) = PID_TestIdentArr81Arrea;
    DiagnosticRequest.BYTE(3) = 0xFF;
    DiagnosticRequest.BYTE(4) = 0xFF;
    DiagnosticRequest.BYTE(5) = 0xFF;
    DiagnosticRequest.BYTE(6) = 0xFF;
    DiagnosticRequest.BYTE(7) = 0xFF;

    output(DiagnosticRequest);


    //-----------------------
	//- EVALUATION & REPORT -
    //-----------------------
	if( 1 != TestWaitForMessage(Dia_4F1h, TimeOut) )
	{
	   TestStepFail("Diagnosis Response timed out");
	}

    if( 1 == TestResponseTime )
    {
       //TimeStampRequest  = getSignalTime(Dia_4F0h::STA_DIAG_FRAGE_TN);
       //TimeStampResponse = getSignalTime(Dia_4F1h::STA_DIAG_ANTWORT_TN);
       ResponseTime      = GetResponseTime();
       if( MaxResponseTime < ResponseTime)
       {
          write("Time of request = %d ms", ResponseTime);
          TestStepFail("Max. response time exceeded");
       }
    }

    
    if(   ( DiagnosticAddress        != getSignal(Dia_4F1h::STA_DIAG_ANTWORT_TN) )
       || ( (SID_ReadMemory + 0x40)  != getSignal(Dia_4F1h::STA_DIAG_ANTWORT_B1) )
       || ( PID_TestIdentArr81Arrea  != getSignal(Dia_4F1h::STA_DIAG_ANTWORT_B2) )
       || ( cRespIdentArr81Manufactor!= getSignal(Dia_4F1h::STA_DIAG_ANTWORT_B3) )
       || ( cRespIdentArr81Id1       != getSignal(Dia_4F1h::STA_DIAG_ANTWORT_B4) )
       || ( cRespIdentArr81Id2       != getSignal(Dia_4F1h::STA_DIAG_ANTWORT_B5) )
       || ( cRespIdentArr81Id3       != getSignal(Dia_4F1h::STA_DIAG_ANTWORT_B6) )
       || ( cRespIdentArr81Id4       != getSignal(Dia_4F1h::STA_DIAG_ANTWORT_B7) )
      )
    {
        TestStepFail("wrong message content");
    }

    //----------------------
	//----- STEP-EXIT ------
    //----------------------




///////////////////////////////////////////////////////////////////////////////
//------------------------------ TEST CASE END --------------------------------
///////////////////////////////////////////////////////////////////////////////
}
/*@@end*/

/*@@testcase:TC_ReadTesterIdentificationUnsupportedArrea():*/
testcase TC_ReadTesterIdentificationUnsupportedArrea()
{
   //LOCALS


///////////////////////////////////////////////////////////////////////////////
//----------------------------- TEST CASE INFO --------------------------------
///////////////////////////////////////////////////////////////////////////////
	TestCaseTitle("ID_1168","4.17.24.1 - Read tester identification area (address)");
	TestCaseDescription("This test case request the tester identification,");
    TestCaseDescription("accessed on area $71 last.");


///////////////////////////////////////////////////////////////////////////////
//------------------------------ TEST STEPS -----------------------------------
///////////////////////////////////////////////////////////////////////////////


TestStep
("step 01"," Tester Program Number ");
    //----------------------
	//----- STEP-ENTRY -----
	//----------------------


    //----------------------
	//----- STIMULATE ------
	//----------------------
    DiagnosticRequest.BYTE(0) = DiagnosticAddress;
    DiagnosticRequest.BYTE(1) = SID_ReadMemory;
    DiagnosticRequest.BYTE(2) = PID_TestIdentUnsupportedArrea;
    DiagnosticRequest.BYTE(3) = 0xFF;
    DiagnosticRequest.BYTE(4) = 0xFF;
    DiagnosticRequest.BYTE(5) = 0xFF;
    DiagnosticRequest.BYTE(6) = 0xFF;
    DiagnosticRequest.BYTE(7) = 0xFF;

    output(DiagnosticRequest);


    //-----------------------
	//- EVALUATION & REPORT -
    //-----------------------
	if( 1 != TestWaitForMessage(Dia_4F1h, TimeOut) )
	{
	   TestStepFail("Diagnosis Response timed out");
	}

    if( 1 == TestResponseTime )
    {
       //TimeStampRequest  = getSignalTime(Dia_4F0h::STA_DIAG_FRAGE_TN);
       //TimeStampResponse = getSignalTime(Dia_4F1h::STA_DIAG_ANTWORT_TN);
       ResponseTime      = GetResponseTime();
       if( MaxResponseTime < ResponseTime)
       {
          write("Time of request = %d ms", ResponseTime);
          TestStepFail("Max. response time exceeded");
       }
    }

    
 
   if(   ( DiagnosticAddress    != getSignal(Dia_4F1h::STA_DIAG_ANTWORT_TN) )
       || ( NegativeResponse    != getSignal(Dia_4F1h::STA_DIAG_ANTWORT_B1) )
       || ( SID_ReadMemory      != getSignal(Dia_4F1h::STA_DIAG_ANTWORT_B2) )
       || ( INVALID_FORMAT      != getSignal(Dia_4F1h::STA_DIAG_ANTWORT_B3) )
      )
    {
        TestStepFail("wrong message content");
    }

    //----------------------
	//----- STEP-EXIT ------
    //----------------------




///////////////////////////////////////////////////////////////////////////////
//------------------------------ TEST CASE END --------------------------------
///////////////////////////////////////////////////////////////////////////////
}
/*@@end*/

/*@@testcase:TC_ReadTesterAccessDateArrea71():*/
testcase TC_ReadTesterAccessDateArrea71()
{
   //LOCALS


///////////////////////////////////////////////////////////////////////////////
//----------------------------- TEST CASE INFO --------------------------------
///////////////////////////////////////////////////////////////////////////////
	TestCaseTitle("ID_1173","4.17.23.7 - This request asks for the last");
	TestCaseDescription("access date on arrea 71. The device response will");
    TestCaseDescription("be based on this format: [date1,date2,p-counter].");


///////////////////////////////////////////////////////////////////////////////
//------------------------------ TEST STEPS -----------------------------------
///////////////////////////////////////////////////////////////////////////////


TestStep
("step 01"," Tester Program Number ");
    //----------------------
	//----- STEP-ENTRY -----
	//----------------------

    //----------------------
	//----- STIMULATE ------
	//----------------------
    DiagnosticRequest.BYTE(0) = DiagnosticAddress;
    DiagnosticRequest.BYTE(1) = SID_ReadMemory;
    DiagnosticRequest.BYTE(2) = PID_TestIdentArr71Date;
    DiagnosticRequest.BYTE(3) = 0xFF;
    DiagnosticRequest.BYTE(4) = 0xFF;
    DiagnosticRequest.BYTE(5) = 0xFF;
    DiagnosticRequest.BYTE(6) = 0xFF;
    DiagnosticRequest.BYTE(7) = 0xFF;

    output(DiagnosticRequest);


    //-----------------------
	//- EVALUATION & REPORT -
    //-----------------------
	if( 1 != TestWaitForMessage(Dia_4F1h, TimeOut) )
	{
	   TestStepFail("Diagnosis Response timed out");
	}

    if( 1 == TestResponseTime )
    {
       //TimeStampRequest  = getSignalTime(Dia_4F0h::STA_DIAG_FRAGE_TN);
       //TimeStampResponse = getSignalTime(Dia_4F1h::STA_DIAG_ANTWORT_TN);
       ResponseTime      = GetResponseTime();
       if( MaxResponseTime < ResponseTime)
       {
          write("Time of request = %d ms", ResponseTime);
          TestStepFail("Max. response time exceeded");
       }
    }


    if(   ( DiagnosticAddress       != getSignal(Dia_4F1h::STA_DIAG_ANTWORT_TN) )
       || ( (SID_ReadMemory + 0x40) != getSignal(Dia_4F1h::STA_DIAG_ANTWORT_B1) )
       || ( PID_TestIdentArr71Date  != getSignal(Dia_4F1h::STA_DIAG_ANTWORT_B2) )
       || ( cRespAccessArr71Date1   != getSignal(Dia_4F1h::STA_DIAG_ANTWORT_B3) )
       || ( cRespAccessArr71Date2   != getSignal(Dia_4F1h::STA_DIAG_ANTWORT_B4) )
       || ( cRespAccessArr71PCounter!= getSignal(Dia_4F1h::STA_DIAG_ANTWORT_B5) )
      )
    {
        TestStepFail("wrong message content");
    }


    //----------------------
	//----- STEP-EXIT ------
    //----------------------




///////////////////////////////////////////////////////////////////////////////
//------------------------------ TEST CASE END --------------------------------
///////////////////////////////////////////////////////////////////////////////
}
/*@@end*/

/*@@testcase:TC_ReadTesterAccessDateArrea73():*/
testcase TC_ReadTesterAccessDateArrea73()
{
   //LOCALS


///////////////////////////////////////////////////////////////////////////////
//----------------------------- TEST CASE INFO --------------------------------
///////////////////////////////////////////////////////////////////////////////
	TestCaseTitle("ID_1174","4.17.23.8 - This request asks for the last");
	TestCaseDescription("access date on arrea 73. The device response will");
    TestCaseDescription("be based on this format: [date1,date2,p-counter].");


///////////////////////////////////////////////////////////////////////////////
//------------------------------ TEST STEPS -----------------------------------
///////////////////////////////////////////////////////////////////////////////


TestStep
("step 01"," Tester Program Number ");
    //----------------------
	//----- STEP-ENTRY -----
	//----------------------

    //----------------------
	//----- STIMULATE ------
	//----------------------
    DiagnosticRequest.BYTE(0) = DiagnosticAddress;
    DiagnosticRequest.BYTE(1) = SID_ReadMemory;
    DiagnosticRequest.BYTE(2) = PID_TestIdentArr73Date;
    DiagnosticRequest.BYTE(3) = 0xFF;
    DiagnosticRequest.BYTE(4) = 0xFF;
    DiagnosticRequest.BYTE(5) = 0xFF;
    DiagnosticRequest.BYTE(6) = 0xFF;
    DiagnosticRequest.BYTE(7) = 0xFF;

    output(DiagnosticRequest);


    //-----------------------
	//- EVALUATION & REPORT -
    //-----------------------
	if( 1 != TestWaitForMessage(Dia_4F1h, TimeOut) )
	{
	   TestStepFail("Diagnosis Response timed out");
	}

    if( 1 == TestResponseTime )
    {
       //TimeStampRequest  = getSignalTime(Dia_4F0h::STA_DIAG_FRAGE_TN);
       //TimeStampResponse = getSignalTime(Dia_4F1h::STA_DIAG_ANTWORT_TN);
       ResponseTime      = GetResponseTime();
       if( MaxResponseTime < ResponseTime)
       {
          write("Time of request = %d ms", ResponseTime);
          TestStepFail("Max. response time exceeded");
       }
    }


    if(   ( DiagnosticAddress       != getSignal(Dia_4F1h::STA_DIAG_ANTWORT_TN) )
       || ( (SID_ReadMemory + 0x40) != getSignal(Dia_4F1h::STA_DIAG_ANTWORT_B1) )
       || ( PID_TestIdentArr73Date  != getSignal(Dia_4F1h::STA_DIAG_ANTWORT_B2) )
       || ( cRespAccessArr73Date1   != getSignal(Dia_4F1h::STA_DIAG_ANTWORT_B3) )
       || ( cRespAccessArr73Date2   != getSignal(Dia_4F1h::STA_DIAG_ANTWORT_B4) )
       || ( cRespAccessArr73PCounter!= getSignal(Dia_4F1h::STA_DIAG_ANTWORT_B5) )
      )
    {
        TestStepFail("wrong message content");
    }


    //----------------------
	//----- STEP-EXIT ------
    //----------------------




///////////////////////////////////////////////////////////////////////////////
//------------------------------ TEST CASE END --------------------------------
///////////////////////////////////////////////////////////////////////////////
}
/*@@end*/

/*@@testcase:TC_ReadTesterAccessDateArrea77():*/
testcase TC_ReadTesterAccessDateArrea77()
{
   //LOCALS

///////////////////////////////////////////////////////////////////////////////
//----------------------------- TEST CASE INFO --------------------------------
///////////////////////////////////////////////////////////////////////////////
	TestCaseTitle("ID_1175","4.17.23.9 - This request asks for the last");
	TestCaseDescription("access date on arrea 77. The device response will");
    TestCaseDescription("be based on this format: [date1,date2,p-counter].");


///////////////////////////////////////////////////////////////////////////////
//------------------------------ TEST STEPS -----------------------------------
///////////////////////////////////////////////////////////////////////////////


TestStep
("step 01"," Tester Program Number ");
    //----------------------
	//----- STEP-ENTRY -----
	//----------------------

    //----------------------
	//----- STIMULATE ------
	//----------------------
    DiagnosticRequest.BYTE(0) = DiagnosticAddress;
    DiagnosticRequest.BYTE(1) = SID_ReadMemory;
    DiagnosticRequest.BYTE(2) = PID_TestIdentArr77Date;
    DiagnosticRequest.BYTE(3) = 0xFF;
    DiagnosticRequest.BYTE(4) = 0xFF;
    DiagnosticRequest.BYTE(5) = 0xFF;
    DiagnosticRequest.BYTE(6) = 0xFF;
    DiagnosticRequest.BYTE(7) = 0xFF;

    output(DiagnosticRequest);


    //-----------------------
	//- EVALUATION & REPORT -
    //-----------------------
	if( 1 != TestWaitForMessage(Dia_4F1h, TimeOut) )
	{
	   TestStepFail("Diagnosis Response timed out");
	}

    if( 1 == TestResponseTime )
    {
       //TimeStampRequest  = getSignalTime(Dia_4F0h::STA_DIAG_FRAGE_TN);
       //TimeStampResponse = getSignalTime(Dia_4F1h::STA_DIAG_ANTWORT_TN);
       ResponseTime      = GetResponseTime();
       if( MaxResponseTime < ResponseTime)
       {
          write("Time of request = %d ms", ResponseTime);
          TestStepFail("Max. response time exceeded");
       }
    }


    if(   ( DiagnosticAddress       != getSignal(Dia_4F1h::STA_DIAG_ANTWORT_TN) )
       || ( (SID_ReadMemory + 0x40) != getSignal(Dia_4F1h::STA_DIAG_ANTWORT_B1) )
       || ( PID_TestIdentArr77Date  != getSignal(Dia_4F1h::STA_DIAG_ANTWORT_B2) )
       || ( cRespAccessArr77Date1   != getSignal(Dia_4F1h::STA_DIAG_ANTWORT_B3) )
       || ( cRespAccessArr77Date2   != getSignal(Dia_4F1h::STA_DIAG_ANTWORT_B4) )
       || ( cRespAccessArr77PCounter!= getSignal(Dia_4F1h::STA_DIAG_ANTWORT_B5) )
      )
    {
        TestStepFail("wrong message content");
    }


    //----------------------
	//----- STEP-EXIT ------
    //----------------------




///////////////////////////////////////////////////////////////////////////////
//------------------------------ TEST CASE END --------------------------------
///////////////////////////////////////////////////////////////////////////////
}
/*@@end*/

/*@@testcase:TC_ReadTesterAccessDateArrea81():*/
testcase TC_ReadTesterAccessDateArrea81()
{
   //LOCALS


///////////////////////////////////////////////////////////////////////////////
//----------------------------- TEST CASE INFO --------------------------------
///////////////////////////////////////////////////////////////////////////////
	TestCaseTitle("ID_1177","4.17.23.11 - This request asks for the last");
	TestCaseDescription("access date on arrea 81. The device response will");
    TestCaseDescription("be based on this format: [date1,date2,p-counter].");


///////////////////////////////////////////////////////////////////////////////
//------------------------------ TEST STEPS -----------------------------------
///////////////////////////////////////////////////////////////////////////////


TestStep
("step 01"," Tester Program Number ");
    //----------------------
	//----- STEP-ENTRY -----
	//----------------------


    //----------------------
	//----- STIMULATE ------
	//----------------------
    DiagnosticRequest.BYTE(0) = DiagnosticAddress;
    DiagnosticRequest.BYTE(1) = SID_ReadMemory;
    DiagnosticRequest.BYTE(2) = PID_TestIdentArr81Date;
    DiagnosticRequest.BYTE(3) = 0xFF;
    DiagnosticRequest.BYTE(4) = 0xFF;
    DiagnosticRequest.BYTE(5) = 0xFF;
    DiagnosticRequest.BYTE(6) = 0xFF;
    DiagnosticRequest.BYTE(7) = 0xFF;

    output(DiagnosticRequest);


    //-----------------------
	//- EVALUATION & REPORT -
    //-----------------------
	if( 1 != TestWaitForMessage(Dia_4F1h, TimeOut) )
	{
	   TestStepFail("Diagnosis Response timed out");
	}

    if( 1 == TestResponseTime )
    {
       //TimeStampRequest  = getSignalTime(Dia_4F0h::STA_DIAG_FRAGE_TN);
       //TimeStampResponse = getSignalTime(Dia_4F1h::STA_DIAG_ANTWORT_TN);
       ResponseTime      = GetResponseTime();
       if( MaxResponseTime < ResponseTime)
       {
          write("Time of request = %d ms", ResponseTime);
          TestStepFail("Max. response time exceeded");
       }
    }


    if(   ( DiagnosticAddress       != getSignal(Dia_4F1h::STA_DIAG_ANTWORT_TN) )
       || ( (SID_ReadMemory + 0x40) != getSignal(Dia_4F1h::STA_DIAG_ANTWORT_B1) )
       || ( PID_TestIdentArr81Date  != getSignal(Dia_4F1h::STA_DIAG_ANTWORT_B2) )
       || ( cRespAccessArr81Date1   != getSignal(Dia_4F1h::STA_DIAG_ANTWORT_B3) )
       || ( cRespAccessArr81Date2   != getSignal(Dia_4F1h::STA_DIAG_ANTWORT_B4) )
       || ( cRespAccessArr81PCounter!= getSignal(Dia_4F1h::STA_DIAG_ANTWORT_B5) )
      )
    {
        TestStepFail("wrong message content");
    }


    //----------------------
	//----- STEP-EXIT ------
    //----------------------




///////////////////////////////////////////////////////////////////////////////
//------------------------------ TEST CASE END --------------------------------
///////////////////////////////////////////////////////////////////////////////
}
/*@@end*/

/*@@testcase:TC_ReadTesterAccessDateUnsupportedArrea():*/
testcase TC_ReadTesterAccessDateUnsupportedArrea()
{
   //LOCALS


///////////////////////////////////////////////////////////////////////////////
//----------------------------- TEST CASE INFO --------------------------------
///////////////////////////////////////////////////////////////////////////////
	TestCaseTitle("ID_2240","4.17.23.12 - This request asks for the last");
	TestCaseDescription("access date on arrea 81. The device response will");
    TestCaseDescription("be based on this format: [date1,date2,p-counter].");


///////////////////////////////////////////////////////////////////////////////
//------------------------------ TEST STEPS -----------------------------------
///////////////////////////////////////////////////////////////////////////////


TestStep
("step 01"," Tester Program Number ");
    //----------------------
	//----- STEP-ENTRY -----
	//----------------------


    //----------------------
	//----- STIMULATE ------
	//----------------------
    DiagnosticRequest.BYTE(0) = DiagnosticAddress;
    DiagnosticRequest.BYTE(1) = SID_ReadMemory;
    DiagnosticRequest.BYTE(2) = PID_TestAccessUnsupportedArrea;
    DiagnosticRequest.BYTE(3) = 0xFF;
    DiagnosticRequest.BYTE(4) = 0xFF;
    DiagnosticRequest.BYTE(5) = 0xFF;
    DiagnosticRequest.BYTE(6) = 0xFF;
    DiagnosticRequest.BYTE(7) = 0xFF;

    output(DiagnosticRequest);


    //-----------------------
	//- EVALUATION & REPORT -
    //-----------------------
	if( 1 != TestWaitForMessage(Dia_4F1h, TimeOut) )
	{
	   TestStepFail("Diagnosis Response timed out");
	}

    if( 1 == TestResponseTime )
    {
       //TimeStampRequest  = getSignalTime(Dia_4F0h::STA_DIAG_FRAGE_TN);
       //TimeStampResponse = getSignalTime(Dia_4F1h::STA_DIAG_ANTWORT_TN);
       ResponseTime      = GetResponseTime();
       if( MaxResponseTime < ResponseTime)
       {
          write("Time of request = %d ms", ResponseTime);
          TestStepFail("Max. response time exceeded");
       }
    }


    if(   ( DiagnosticAddress    != getSignal(Dia_4F1h::STA_DIAG_ANTWORT_TN) )
       || ( NegativeResponse     != getSignal(Dia_4F1h::STA_DIAG_ANTWORT_B1) )
       || ( SID_ReadMemory       != getSignal(Dia_4F1h::STA_DIAG_ANTWORT_B2) )
       || ( INVALID_FORMAT       != getSignal(Dia_4F1h::STA_DIAG_ANTWORT_B3) )
      )
    {
        TestStepFail("wrong message content");
    }


    //----------------------
	//----- STEP-EXIT ------
    //----------------------


///////////////////////////////////////////////////////////////////////////////
//------------------------------ TEST CASE END --------------------------------
///////////////////////////////////////////////////////////////////////////////
}
/*@@end*/

/*@@caplFunc:v_Write_CCP(long,byte,byte[]):*///function
v_Write_CCP(long lAddr, byte bSize, byte bArray[])
{
    CCP_Connect();
    if(1 == TestWaitForMessage(SPA_6EBh, TimeOut))
    {
    }


    CCP_SetMTA(lAddr);
    if(1 == TestWaitForMessage(SPA_6EBh, TimeOut))
    {
    }
     
    CCP_Download(bSize, bArray);
    if(1 == TestWaitForMessage(SPA_6EBh, TimeOut))
    {
    }


    CCP_Disconnect();
    if(1 == TestWaitForMessage(SPA_6EBh, TimeOut))
    {
    }      
}
/*@@end*/

/*@@caplFunc:DumpTestIdentDataEEPROM():*///function
DumpTestIdentDataEEPROM ()
{
/*
    //    write("EEP-Values: %x, %x, %x, %x, %x, %x, %x, %x", b0,b1,b2,b3,b4,b5,b6,b7);
    // Access Date Data
    // ----------------
    byte bArray71_AD[3]={
                     cRespAccessArr71Date1,
                     cRespAccessArr71Date2,
                     cRespAccessArr71PCounter
                     };
    byte bArray73_AD[3]={
                     cRespAccessArr73Date1,
                     cRespAccessArr73Date2,
                     cRespAccessArr73PCounter
                     };
    byte bArray77_AD[3]={
                     cRespAccessArr77Date1,
                     cRespAccessArr77Date2,
                     cRespAccessArr77PCounter
                     };
    byte bArray81_AD[3]={
                     cRespAccessArr81Date1,
                     cRespAccessArr81Date2,
                     cRespAccessArr81PCounter
                     };
                                                                    
    // Tester Ident Data
    // -----------------
    byte bArray71_TI[5]={
                    cRespIdentArr71Manufactor,
                    cRespIdentArr71Id1,
                    cRespIdentArr71Id2,
                    cRespIdentArr71Id3,
                    cRespIdentArr71Id4
                    };
    byte bArray73_TI[5]={
                    cRespIdentArr73Manufactor,
                    cRespIdentArr73Id1,
                    cRespIdentArr73Id2,
                    cRespIdentArr73Id3,
                    cRespIdentArr73Id4
                    };
    byte bArray77_TI[5]={
                    cRespIdentArr77Manufactor,
                    cRespIdentArr77Id1,
                    cRespIdentArr77Id2,
                    cRespIdentArr77Id3,
                    cRespIdentArr77Id4
                    };
    byte bArray81_TI[5]={
                    cRespIdentArr81Manufactor,
                    cRespIdentArr81Id1,
                    cRespIdentArr81Id2,
                    cRespIdentArr81Id3,
                    cRespIdentArr81Id4
                    };
    
    // write Tester Ident Data
    vWrite_CCP(EE_ADDR_TestIdentArr71Arrea, 5, bArray71_TI, cStart);
    vWrite_CCP(EE_ADDR_TestIdentArr73Arrea, 5, bArray73_TI, cRun);
    vWrite_CCP(EE_ADDR_TestIdentArr77Arrea, 5, bArray77_TI, cRun);
    vWrite_CCP(EE_ADDR_TestIdentArr81Arrea, 5, bArray81_TI, cRun);

    // write Access Date Data
    vWrite_CCP(EE_ADDR_TestIdentArr71Date, 3, bArray71_AD, cRun);
    vWrite_CCP(EE_ADDR_TestIdentArr73Date, 3, bArray73_AD, cRun);
    vWrite_CCP(EE_ADDR_TestIdentArr77Date, 3, bArray77_AD, cRun);
    vWrite_CCP(EE_ADDR_TestIdentArr81Date, 3, bArray81_AD, cStop);
*/
}
/*@@end*/

/*@@testcase:TC_22_ReadKeywordZGS_ActiveDiagnosis():*/
testcase TC_22_ReadKeywordZGS_ActiveDiagnosis ()
{
   //LOCALS


///////////////////////////////////////////////////////////////////////////////
//----------------------------- TEST CASE INFO --------------------------------
///////////////////////////////////////////////////////////////////////////////
	TestCaseTitle("ID_3395","4.13.2.2 - Read keyword and ZGS (active diagnosis)");
	TestCaseDescription("This test should prove that the Read Memory diagnosis");
	TestCaseDescription("service for the keyword/ZGS also works correctly");
	TestCaseDescription("in passive diagnosis.");


///////////////////////////////////////////////////////////////////////////////
//------------------------------ TEST STEPS -----------------------------------
///////////////////////////////////////////////////////////////////////////////


TestStep
("step 01"," Keyword/ZGS ");
    //----------------------
	//---- PRECONDITION ----
	//----------------------
    v_SetActiveMode();
    TestWaitForMessage(Dia_4F1h, TimeOut);

    //----------------------
	//----- TEST STEP ------
	//----------------------
    DiagnosticRequest.BYTE(0) = DiagnosticAddress;
    DiagnosticRequest.BYTE(1) = SID_ReadMemory;
    DiagnosticRequest.BYTE(2) = PID_Keyword;
    DiagnosticRequest.BYTE(3) = 0xFF;
    DiagnosticRequest.BYTE(4) = 0xFF;
    DiagnosticRequest.BYTE(5) = 0xFF;
    DiagnosticRequest.BYTE(6) = 0xFF;
    DiagnosticRequest.BYTE(7) = 0xFF;

    output(DiagnosticRequest);


    //-----------------------
	//--- EXPECTED RESULT ---
    //-----------------------
	if( 1 != TestWaitForMessage(Dia_4F1h, TimeOut) )
	{
	   TestStepFail("Diagnosis Response timed out");
	}
    // check response time
    if( 1 == TestResponseTime )
    {
       if( MaxResponseTime < GetResponseTime())
       {
          write("Time of request = %d ms", ResponseTime);
          TestStepFail("Max. response time exceeded");
       }
    }
    // check response content 
    if(   ( DiagnosticAddress       != getSignal(Dia_4F1h::STA_DIAG_ANTWORT_TN) )
       || ( (SID_ReadMemory + 0x40) != getSignal(Dia_4F1h::STA_DIAG_ANTWORT_B1) )
       || ( PID_Keyword             != getSignal(Dia_4F1h::STA_DIAG_ANTWORT_B2) )
       || ( Keyword_1   != getSignal(Dia_4F1h::STA_DIAG_ANTWORT_B3) )
       || ( Keyword_2   != getSignal(Dia_4F1h::STA_DIAG_ANTWORT_B4) )
       || ( ZGS_H       != getSignal(Dia_4F1h::STA_DIAG_ANTWORT_B5) )
       || ( ZGS_Z       != getSignal(Dia_4F1h::STA_DIAG_ANTWORT_B6) )
       || ( ZGS_E       != getSignal(Dia_4F1h::STA_DIAG_ANTWORT_B7) )
      )
    {
        TestStepFail("wrong message content");
    }


    //----------------------
	//--- POSTCONDITION ----
    //----------------------
    v_StopDiagnosis();
    TestWaitForMessage(Dia_4F1h, TimeOut);

///////////////////////////////////////////////////////////////////////////////
//------------------------------ TEST CASE END --------------------------------
///////////////////////////////////////////////////////////////////////////////
}
/*@@end*/

/*@@testcase:TC_23_ReadKeywordZGS_ParametrizationMode():*/
testcase TC_23_ReadKeywordZGS_ParametrizationMode ()
{
   //LOCALS


///////////////////////////////////////////////////////////////////////////////
//----------------------------- TEST CASE INFO --------------------------------
///////////////////////////////////////////////////////////////////////////////
	TestCaseTitle("ID_3396","4.13.2.3 - Read keyword and ZGS (parametrization mode)");
	TestCaseDescription("This test should prove that the Read Memory diagnosis");
	TestCaseDescription("service for the keyword/ZGS also works correctly");
	TestCaseDescription("in parametrization mode.");


///////////////////////////////////////////////////////////////////////////////
//------------------------------ TEST STEPS -----------------------------------
///////////////////////////////////////////////////////////////////////////////


TestStep
("step 01"," Keyword/ZGS ");
    //----------------------
	//---- PRECONDITION ----
	//----------------------
    v_SetParameterMode();
    TestWaitForMessage(Dia_4F1h, TimeOut);

    //----------------------
	//----- TEST STEP ------
	//----------------------
    DiagnosticRequest.BYTE(0) = DiagnosticAddress;
    DiagnosticRequest.BYTE(1) = SID_ReadMemory;
    DiagnosticRequest.BYTE(2) = PID_Keyword;
    DiagnosticRequest.BYTE(3) = 0xFF;
    DiagnosticRequest.BYTE(4) = 0xFF;
    DiagnosticRequest.BYTE(5) = 0xFF;
    DiagnosticRequest.BYTE(6) = 0xFF;
    DiagnosticRequest.BYTE(7) = 0xFF;

    output(DiagnosticRequest);


    //-----------------------
	//--- EXPECTED RESULT ---
    //-----------------------
	if( 1 != TestWaitForMessage(Dia_4F1h, TimeOut) )
	{
	   TestStepFail("Diagnosis Response timed out");
	}
    // check response time
    if( 1 == TestResponseTime )
    {
       if( MaxResponseTime < GetResponseTime())
       {
          write("Time of request = %d ms", ResponseTime);
          TestStepFail("Max. response time exceeded");
       }
    }
    // check response content 
    if(   ( DiagnosticAddress       != getSignal(Dia_4F1h::STA_DIAG_ANTWORT_TN) )
       || ( (SID_ReadMemory + 0x40) != getSignal(Dia_4F1h::STA_DIAG_ANTWORT_B1) )
       || ( PID_Keyword             != getSignal(Dia_4F1h::STA_DIAG_ANTWORT_B2) )
       || ( Keyword_1   != getSignal(Dia_4F1h::STA_DIAG_ANTWORT_B3) )
       || ( Keyword_2   != getSignal(Dia_4F1h::STA_DIAG_ANTWORT_B4) )
       || ( ZGS_H       != getSignal(Dia_4F1h::STA_DIAG_ANTWORT_B5) )
       || ( ZGS_Z       != getSignal(Dia_4F1h::STA_DIAG_ANTWORT_B6) )
       || ( ZGS_E       != getSignal(Dia_4F1h::STA_DIAG_ANTWORT_B7) )
      )
    {
        TestStepFail("wrong message content");
    }


    //----------------------
	//--- POSTCONDITION ----
    //----------------------
    v_StopDiagnosis();
    TestWaitForMessage(Dia_4F1h, TimeOut);

///////////////////////////////////////////////////////////////////////////////
//------------------------------ TEST CASE END --------------------------------
///////////////////////////////////////////////////////////////////////////////
}
/*@@end*/

/*@@testcase:TC_24_ReadKeywordZGS_FBLmode():*/
testcase TC_24_ReadKeywordZGS_FBLmode ()
{
   //LOCALS


///////////////////////////////////////////////////////////////////////////////
//----------------------------- TEST CASE INFO --------------------------------
///////////////////////////////////////////////////////////////////////////////
	TestCaseTitle("ID_3398","4.13.2.3 - Read keyword and ZGS (VDO mode)");
	TestCaseDescription("This test should prove that the Read Memory diagnosis");
	TestCaseDescription("service for the keyword/ZGS also works correctly");
	TestCaseDescription("in VDO mode.");


///////////////////////////////////////////////////////////////////////////////
//------------------------------ TEST STEPS -----------------------------------
///////////////////////////////////////////////////////////////////////////////


TestStep
("step 01"," Keyword/ZGS ");
    //----------------------
	//---- PRECONDITION ----
	//----------------------
    v_SetFBLMode();
    TestWaitForTimeout(5000);
    TesterPresent = 1;

    //----------------------
	//----- TEST STEP ------
	//----------------------
    DiagnosticRequest.BYTE(0) = DiagnosticAddress;
    DiagnosticRequest.BYTE(1) = SID_ReadMemory;
    DiagnosticRequest.BYTE(2) = PID_Keyword;
    DiagnosticRequest.BYTE(3) = 0xFF;
    DiagnosticRequest.BYTE(4) = 0xFF;
    DiagnosticRequest.BYTE(5) = 0xFF;
    DiagnosticRequest.BYTE(6) = 0xFF;
    DiagnosticRequest.BYTE(7) = 0xFF;

    output(DiagnosticRequest);


    //-----------------------
	//--- EXPECTED RESULT ---
    //-----------------------
	if( 1 != TestWaitForMessage(Dia_4F1h, TimeOut) )
	{
	   TestStepFail("Diagnosis Response timed out");
	}
    // check response time
    if( 1 == TestResponseTime )
    {
       if( MaxResponseTime < GetResponseTime())
       {
          write("Time of request = %d ms", ResponseTime);
          TestStepFail("Max. response time exceeded");
       }
    }
    // check response content 
    if(   ( DiagnosticAddress       != getSignal(Dia_4F1h::STA_DIAG_ANTWORT_TN) )
       || ( (SID_ReadMemory + 0x40) != getSignal(Dia_4F1h::STA_DIAG_ANTWORT_B1) )
       || ( PID_Keyword             != getSignal(Dia_4F1h::STA_DIAG_ANTWORT_B2) )
       || ( Keyword_1   != getSignal(Dia_4F1h::STA_DIAG_ANTWORT_B3) )
       || ( Keyword_2   != getSignal(Dia_4F1h::STA_DIAG_ANTWORT_B4) )
       || ( ZGS_H       != getSignal(Dia_4F1h::STA_DIAG_ANTWORT_B5) )
       || ( ZGS_Z       != getSignal(Dia_4F1h::STA_DIAG_ANTWORT_B6) )
       || ( ZGS_E       != getSignal(Dia_4F1h::STA_DIAG_ANTWORT_B7) )
      )
    {
        TestStepFail("wrong message content");
    }


    //----------------------
	//--- POSTCONDITION ----
    //----------------------
    TesterPresent = 0;
    v_StopDiagnosis();
    TestWaitForTimeout(5000);


    ////////////////////////////////////////////////////////////////
    // this reset is necessary due to bug (tracker #842)          //
    // in V5.0; to stop FBL mode a 2. stop request is required    //
    v_ResetECU();                                                 //
    TestWaitForTimeout(5000);                                     //
    ////////////////////////////////////////////////////////////////


///////////////////////////////////////////////////////////////////////////////
//------------------------------ TEST CASE END --------------------------------
///////////////////////////////////////////////////////////////////////////////
}
/*@@end*/

/*@@testcase:TC_25_ReadKeywordZGS_VDOmode():*/
testcase TC_25_ReadKeywordZGS_VDOmode ()
{
   //LOCALS


///////////////////////////////////////////////////////////////////////////////
//----------------------------- TEST CASE INFO --------------------------------
///////////////////////////////////////////////////////////////////////////////
	TestCaseTitle("ID_3398","4.13.2.3 - Read keyword and ZGS (VDO mode)");
	TestCaseDescription("This test should prove that the Read Memory diagnosis");
	TestCaseDescription("service for the keyword/ZGS also works correctly");
	TestCaseDescription("in VDO mode.");


///////////////////////////////////////////////////////////////////////////////
//------------------------------ TEST STEPS -----------------------------------
///////////////////////////////////////////////////////////////////////////////


TestStep
("step 01"," Keyword/ZGS ");
    //----------------------
	//---- PRECONDITION ----
	//----------------------
    v_SetVDOMode();
    TestWaitForMessage(Dia_4F1h, TimeOut);

    //----------------------
	//----- TEST STEP ------
	//----------------------
    DiagnosticRequest.BYTE(0) = DiagnosticAddress;
    DiagnosticRequest.BYTE(1) = SID_ReadMemory;
    DiagnosticRequest.BYTE(2) = PID_Keyword;
    DiagnosticRequest.BYTE(3) = 0xFF;
    DiagnosticRequest.BYTE(4) = 0xFF;
    DiagnosticRequest.BYTE(5) = 0xFF;
    DiagnosticRequest.BYTE(6) = 0xFF;
    DiagnosticRequest.BYTE(7) = 0xFF;

    output(DiagnosticRequest);


    //-----------------------
	//--- EXPECTED RESULT ---
    //-----------------------
	if( 1 != TestWaitForMessage(Dia_4F1h, TimeOut) )
	{
	   TestStepFail("Diagnosis Response timed out");
	}
    // check response time
    if( 1 == TestResponseTime )
    {
       if( MaxResponseTime < GetResponseTime())
       {
          write("Time of request = %d ms", ResponseTime);
          TestStepFail("Max. response time exceeded");
       }
    }
    // check response content 
    if(   ( DiagnosticAddress       != getSignal(Dia_4F1h::STA_DIAG_ANTWORT_TN) )
       || ( (SID_ReadMemory + 0x40) != getSignal(Dia_4F1h::STA_DIAG_ANTWORT_B1) )
       || ( PID_Keyword             != getSignal(Dia_4F1h::STA_DIAG_ANTWORT_B2) )
       || ( Keyword_1   != getSignal(Dia_4F1h::STA_DIAG_ANTWORT_B3) )
       || ( Keyword_2   != getSignal(Dia_4F1h::STA_DIAG_ANTWORT_B4) )
       || ( ZGS_H       != getSignal(Dia_4F1h::STA_DIAG_ANTWORT_B5) )
       || ( ZGS_Z       != getSignal(Dia_4F1h::STA_DIAG_ANTWORT_B6) )
       || ( ZGS_E       != getSignal(Dia_4F1h::STA_DIAG_ANTWORT_B7) )
      )
    {
        TestStepFail("wrong message content");
    }


    //----------------------
	//--- POSTCONDITION ----
    //----------------------
    v_StopDiagnosis();
    TestWaitForMessage(Dia_4F1h, TimeOut);

///////////////////////////////////////////////////////////////////////////////
//------------------------------ TEST CASE END --------------------------------
///////////////////////////////////////////////////////////////////////////////
}
/*@@end*/

/*@@caplFunc:v_UnlockArea81():*///function
v_UnlockArea81 ()
{
   word ReceivedSeed;
   word CalculatedKey;

   v_SetVDOmode();
   TestWaitForMessage(Dia_4F1h, TimeOut);

   v_UnlockRequest(0x81);
   TestWaitForMessage(Dia_4F1h, TimeOut);
   ReceivedSeed = ( (word)(getSignal(Dia_4F1h::STA_DIAG_ANTWORT_B3)) <<8 ) 
                  + (word)(getSignal(Dia_4F1h::STA_DIAG_ANTWORT_B4));

   CalculatedKey = w_CalculateKey(ReceivedSeed, A_Area81 , B_Area81 );
   write("CalculatedKey = ",CalculatedKey);
   
   v_SendKey(0x81, CalculatedKey);
   TestWaitForMessage(Dia_4F1h, TimeOut);

   v_WriteAccessDate(0x81);
   TestWaitForMessage(Dia_4F1h, TimeOut);

   TesterPresent = 1;
}
/*@@end*/

/*@@timer:T_TesterPresent:*/
on timer T_TesterPresent
{
    v_SendTesterPresent();

    setTimer(T_TesterPresent, 3000);
}
/*@@end*/

/*@@caplFunc:v_WriteCameraHeight():*///function
v_WriteCameraHeight ()
{
   v_UnlockArea81();
   DiagnosticRequest.BYTE(0) = DiagnosticAddress;
   DiagnosticRequest.BYTE(1) = SID_WriteMemory;
   DiagnosticRequest.BYTE(2) = PID_CameraHeight;
   DiagnosticRequest.BYTE(3) = 0x16;
   DiagnosticRequest.BYTE(4) = 0x01;
   DiagnosticRequest.BYTE(5) = 0xFF;
   DiagnosticRequest.BYTE(6) = 0xFF;
   DiagnosticRequest.BYTE(7) = 0xFF;

   output(DiagnosticRequest);

   TestWaitForMessage(Dia_4F1h, TimeOut);

   TesterPresent = 0;
}
/*@@end*/

/*@@caplFunc:DumpDefaultEEPROM():*///function
DumpDefaultEEPROM ()
{
    ub_CCP_Activity = EEPROM_REVERSE;
    write("%s", ECUFilePath);
	CCP_Connect();
}
/*@@end*/

/*@@testcase:TC_32_ReadMBPartNumber_active():*/
testcase TC_32_ReadMBPartNumber_active ()
{
   //LOCALS


///////////////////////////////////////////////////////////////////////////////
//----------------------------- TEST CASE INFO --------------------------------
///////////////////////////////////////////////////////////////////////////////
	TestCaseTitle("ID_3413","4.13.3.2 - Read MB part number (active diagnosis)");
	TestCaseDescription("This test should prove that the Read Memory diagnosis");
	TestCaseDescription("service for the MB part number alsoworks correctly");
	TestCaseDescription("in the active diagnosis mode.");

///////////////////////////////////////////////////////////////////////////////
//------------------------------ TEST STEPS -----------------------------------
///////////////////////////////////////////////////////////////////////////////


TestStep
("step 01"," MB Part Number ");
    //----------------------
	//---- PRECONDITION ----
	//----------------------
    v_SetActiveMode();
    TestWaitForMessage(Dia_4F1h, TimeOut);

    //----------------------
	//----- TEST STEP ------
	//----------------------
    DiagnosticRequest.BYTE(0) = DiagnosticAddress;
    DiagnosticRequest.BYTE(1) = SID_ReadMemory;
    DiagnosticRequest.BYTE(2) = PID_MBPartNumber;
    DiagnosticRequest.BYTE(3) = 0xFF;
    DiagnosticRequest.BYTE(4) = 0xFF;
    DiagnosticRequest.BYTE(5) = 0xFF;
    DiagnosticRequest.BYTE(6) = 0xFF;
    DiagnosticRequest.BYTE(7) = 0xFF;

    output(DiagnosticRequest);


    //-----------------------
	//--- EXPECTED RESULT ---
    //-----------------------
	if( 1 != TestWaitForMessage(Dia_4F1h, TimeOut) )
	{
	   TestStepFail("Diagnosis Response timed out");
	}
    // check response time
    if( 1 == TestResponseTime )
    {
       if( MaxResponseTime < GetResponseTime())
       {
          write("Time of request = %d ms", ResponseTime);
          TestStepFail("Max. response time exceeded");
       }
    }
    // check response content
    if(   ( DiagnosticAddress      != getSignal(Dia_4F1h::STA_DIAG_ANTWORT_TN) )
       || ( (SID_ReadMemory + 0x40)!= getSignal(Dia_4F1h::STA_DIAG_ANTWORT_B1) )
       || ( PID_MBPartNumber       != getSignal(Dia_4F1h::STA_DIAG_ANTWORT_B2) )
       || ( MSB1  != getSignal(Dia_4F1h::STA_DIAG_ANTWORT_B3) )
       || ( MSB2  != getSignal(Dia_4F1h::STA_DIAG_ANTWORT_B4) )
       || ( MSB3  != getSignal(Dia_4F1h::STA_DIAG_ANTWORT_B5) )
       || ( MSB4  != getSignal(Dia_4F1h::STA_DIAG_ANTWORT_B6) )
       || ( MSB5  != getSignal(Dia_4F1h::STA_DIAG_ANTWORT_B7) )
      )
    {
        TestStepFail("wrong message content");
    }


    //----------------------
	//--- POSTCONDITION ----
    //----------------------
    v_StopDiagnosis();
    TestWaitForMessage(Dia_4F1h, TimeOut);


///////////////////////////////////////////////////////////////////////////////
//------------------------------ TEST CASE END --------------------------------
///////////////////////////////////////////////////////////////////////////////
}
/*@@end*/

/*@@testcase:TC_33_ReadMBPartNumber_parametrization():*/
testcase TC_33_ReadMBPartNumber_parametrization ()
{
   //LOCALS


///////////////////////////////////////////////////////////////////////////////
//----------------------------- TEST CASE INFO --------------------------------
///////////////////////////////////////////////////////////////////////////////
	TestCaseTitle("ID_3414","4.13.3.3 - Read MB part number (parametrization mode)");
	TestCaseDescription("This test should prove that the Read Memory diagnosis");
	TestCaseDescription("service for the MB part number also works correctly");
	TestCaseDescription("in the parametrization mode.");

///////////////////////////////////////////////////////////////////////////////
//------------------------------ TEST STEPS -----------------------------------
///////////////////////////////////////////////////////////////////////////////


TestStep
("step 01"," MB Part Number ");
    //----------------------
	//---- PRECONDITION ----
	//----------------------
    v_SetParameterMode();
    TestWaitForMessage(Dia_4F1h, TimeOut);

    //----------------------
	//----- TEST STEP ------
	//----------------------
    DiagnosticRequest.BYTE(0) = DiagnosticAddress;
    DiagnosticRequest.BYTE(1) = SID_ReadMemory;
    DiagnosticRequest.BYTE(2) = PID_MBPartNumber;
    DiagnosticRequest.BYTE(3) = 0xFF;
    DiagnosticRequest.BYTE(4) = 0xFF;
    DiagnosticRequest.BYTE(5) = 0xFF;
    DiagnosticRequest.BYTE(6) = 0xFF;
    DiagnosticRequest.BYTE(7) = 0xFF;

    output(DiagnosticRequest);


    //-----------------------
	//--- EXPECTED RESULT ---
    //-----------------------
	if( 1 != TestWaitForMessage(Dia_4F1h, TimeOut) )
	{
	   TestStepFail("Diagnosis Response timed out");
	}
    // check response time
    if( 1 == TestResponseTime )
    {
       if( MaxResponseTime < GetResponseTime())
       {
          write("Time of request = %d ms", ResponseTime);
          TestStepFail("Max. response time exceeded");
       }
    }
    // check response content
    if(   ( DiagnosticAddress      != getSignal(Dia_4F1h::STA_DIAG_ANTWORT_TN) )
       || ( (SID_ReadMemory + 0x40)!= getSignal(Dia_4F1h::STA_DIAG_ANTWORT_B1) )
       || ( PID_MBPartNumber       != getSignal(Dia_4F1h::STA_DIAG_ANTWORT_B2) )
       || ( MSB1  != getSignal(Dia_4F1h::STA_DIAG_ANTWORT_B3) )
       || ( MSB2  != getSignal(Dia_4F1h::STA_DIAG_ANTWORT_B4) )
       || ( MSB3  != getSignal(Dia_4F1h::STA_DIAG_ANTWORT_B5) )
       || ( MSB4  != getSignal(Dia_4F1h::STA_DIAG_ANTWORT_B6) )
       || ( MSB5  != getSignal(Dia_4F1h::STA_DIAG_ANTWORT_B7) )
      )
    {
        TestStepFail("wrong message content");
    }


    //----------------------
	//--- POSTCONDITION ----
    //----------------------
    v_StopDiagnosis();
    TestWaitForMessage(Dia_4F1h, TimeOut);


///////////////////////////////////////////////////////////////////////////////
//------------------------------ TEST CASE END --------------------------------
///////////////////////////////////////////////////////////////////////////////
}
/*@@end*/

/*@@testcase:TC_34_ReadMBPartNumber_FBL():*/
testcase TC_34_ReadMBPartNumber_FBL ()
{
   //LOCALS


///////////////////////////////////////////////////////////////////////////////
//----------------------------- TEST CASE INFO --------------------------------
///////////////////////////////////////////////////////////////////////////////
	TestCaseTitle("ID_3415","4.13.3.4 - Read MB part number (FBL mode)");
	TestCaseDescription("This test should prove that the Read Memory diagnosis");
	TestCaseDescription("service for the MB part number also works correctly");
	TestCaseDescription("in the FBL mode.");

///////////////////////////////////////////////////////////////////////////////
//------------------------------ TEST STEPS -----------------------------------
///////////////////////////////////////////////////////////////////////////////


TestStep
("step 01"," MB Part Number ");
    //----------------------
	//---- PRECONDITION ----
	//----------------------
    v_SetFBLMode();
    TestWaitForTimeout(5000);
    TesterPresent = 1;

    //----------------------
	//----- TEST STEP ------
	//----------------------
    DiagnosticRequest.BYTE(0) = DiagnosticAddress;
    DiagnosticRequest.BYTE(1) = SID_ReadMemory;
    DiagnosticRequest.BYTE(2) = PID_MBPartNumber;
    DiagnosticRequest.BYTE(3) = 0xFF;
    DiagnosticRequest.BYTE(4) = 0xFF;
    DiagnosticRequest.BYTE(5) = 0xFF;
    DiagnosticRequest.BYTE(6) = 0xFF;
    DiagnosticRequest.BYTE(7) = 0xFF;

    output(DiagnosticRequest);


    //-----------------------
	//--- EXPECTED RESULT ---
    //-----------------------
	if( 1 != TestWaitForMessage(Dia_4F1h, TimeOut) )
	{
	   TestStepFail("Diagnosis Response timed out");
	}
    // check response time
    if( 1 == TestResponseTime )
    {
       if( MaxResponseTime < GetResponseTime())
       {
          write("Time of request = %d ms", ResponseTime);
          TestStepFail("Max. response time exceeded");
       }
    }
    // check response content
    if(   ( DiagnosticAddress      != getSignal(Dia_4F1h::STA_DIAG_ANTWORT_TN) )
       || ( (SID_ReadMemory + 0x40)!= getSignal(Dia_4F1h::STA_DIAG_ANTWORT_B1) )
       || ( PID_MBPartNumber       != getSignal(Dia_4F1h::STA_DIAG_ANTWORT_B2) )
       || ( MSB1  != getSignal(Dia_4F1h::STA_DIAG_ANTWORT_B3) )
       || ( MSB2  != getSignal(Dia_4F1h::STA_DIAG_ANTWORT_B4) )
       || ( MSB3  != getSignal(Dia_4F1h::STA_DIAG_ANTWORT_B5) )
       || ( MSB4  != getSignal(Dia_4F1h::STA_DIAG_ANTWORT_B6) )
       || ( MSB5  != getSignal(Dia_4F1h::STA_DIAG_ANTWORT_B7) )
      )
    {
        TestStepFail("wrong message content");
    }


    //----------------------
	//--- POSTCONDITION ----
    //----------------------
    TesterPresent = 0;
    v_StopDiagnosis();
    TestWaitForTimeout(5000);


    ////////////////////////////////////////////////////////////////
    // this reset is necessary due to bug (tracker #842)          //
    // in V5.0; to stop FBL mode a 2. stop request is required    //
    v_ResetECU();                                                 //
    TestWaitForTimeout(5000);                                     //
    ////////////////////////////////////////////////////////////////


///////////////////////////////////////////////////////////////////////////////
//------------------------------ TEST CASE END --------------------------------
///////////////////////////////////////////////////////////////////////////////
}
/*@@end*/

/*@@testcase:TC_35_ReadMBPartNumber_VDO():*/
testcase TC_35_ReadMBPartNumber_VDO ()
{
   //LOCALS


///////////////////////////////////////////////////////////////////////////////
//----------------------------- TEST CASE INFO --------------------------------
///////////////////////////////////////////////////////////////////////////////
	TestCaseTitle("ID_3416","4.13.3.5 - Read MB part number (VDO mode)");
	TestCaseDescription("This test should prove that the Read Memory diagnosis");
	TestCaseDescription("service for the MB part number also works correctly");
	TestCaseDescription("in the VDO mode.");

///////////////////////////////////////////////////////////////////////////////
//------------------------------ TEST STEPS -----------------------------------
///////////////////////////////////////////////////////////////////////////////


TestStep
("step 01"," MB Part Number ");
    //----------------------
	//---- PRECONDITION ----
	//----------------------
    v_SetVDOMode();
    TestWaitForMessage(Dia_4F1h, TimeOut);

    //----------------------
	//----- TEST STEP ------
	//----------------------
    DiagnosticRequest.BYTE(0) = DiagnosticAddress;
    DiagnosticRequest.BYTE(1) = SID_ReadMemory;
    DiagnosticRequest.BYTE(2) = PID_MBPartNumber;
    DiagnosticRequest.BYTE(3) = 0xFF;
    DiagnosticRequest.BYTE(4) = 0xFF;
    DiagnosticRequest.BYTE(5) = 0xFF;
    DiagnosticRequest.BYTE(6) = 0xFF;
    DiagnosticRequest.BYTE(7) = 0xFF;

    output(DiagnosticRequest);


    //-----------------------
	//--- EXPECTED RESULT ---
    //-----------------------
	if( 1 != TestWaitForMessage(Dia_4F1h, TimeOut) )
	{
	   TestStepFail("Diagnosis Response timed out");
	}
    // check response time
    if( 1 == TestResponseTime )
    {
       if( MaxResponseTime < GetResponseTime())
       {
          write("Time of request = %d ms", ResponseTime);
          TestStepFail("Max. response time exceeded");
       }
    }
    // check response content
    if(   ( DiagnosticAddress      != getSignal(Dia_4F1h::STA_DIAG_ANTWORT_TN) )
       || ( (SID_ReadMemory + 0x40)!= getSignal(Dia_4F1h::STA_DIAG_ANTWORT_B1) )
       || ( PID_MBPartNumber       != getSignal(Dia_4F1h::STA_DIAG_ANTWORT_B2) )
       || ( MSB1  != getSignal(Dia_4F1h::STA_DIAG_ANTWORT_B3) )
       || ( MSB2  != getSignal(Dia_4F1h::STA_DIAG_ANTWORT_B4) )
       || ( MSB3  != getSignal(Dia_4F1h::STA_DIAG_ANTWORT_B5) )
       || ( MSB4  != getSignal(Dia_4F1h::STA_DIAG_ANTWORT_B6) )
       || ( MSB5  != getSignal(Dia_4F1h::STA_DIAG_ANTWORT_B7) )
      )
    {
        TestStepFail("wrong message content");
    }


    //----------------------
	//--- POSTCONDITION ----
    //----------------------
    v_StopDiagnosis();
    TestWaitForMessage(Dia_4F1h, TimeOut);


///////////////////////////////////////////////////////////////////////////////
//------------------------------ TEST CASE END --------------------------------
///////////////////////////////////////////////////////////////////////////////
}
/*@@end*/

/*@@testcase:TC_42_ReadTesterProgramNumber_active():*/
testcase TC_42_ReadTesterProgramNumber_active ()
{
   //LOCALS


///////////////////////////////////////////////////////////////////////////////
//----------------------------- TEST CASE INFO --------------------------------
///////////////////////////////////////////////////////////////////////////////
	TestCaseTitle("ID_3417","4.13.4.2 - Read tester program number (active diagnosis)");
	TestCaseDescription("This test should prove that the Read Memory diagnosis service");
    TestCaseDescription("for the tester program number also works correctly");
	TestCaseDescription("in the active diagnosis mode.");



///////////////////////////////////////////////////////////////////////////////
//------------------------------ TEST STEPS -----------------------------------
///////////////////////////////////////////////////////////////////////////////


TestStep
("step 01"," Tester Program Number ");
    //----------------------
	//---- PRECONDITION ----
	//----------------------
    v_SetActiveMode();
    TestWaitForMessage(Dia_4F1h, TimeOut);


    //----------------------
	//----- TEST STEP ------
	//----------------------
    DiagnosticRequest.BYTE(0) = DiagnosticAddress;
    DiagnosticRequest.BYTE(1) = SID_ReadMemory;
    DiagnosticRequest.BYTE(2) = PID_TesterProgramNumber;
    DiagnosticRequest.BYTE(3) = 0xFF;
    DiagnosticRequest.BYTE(4) = 0xFF;
    DiagnosticRequest.BYTE(5) = 0xFF;
    DiagnosticRequest.BYTE(6) = 0xFF;
    DiagnosticRequest.BYTE(7) = 0xFF;

    output(DiagnosticRequest);


    //-----------------------
	//--- EXPECTED RESULT ---
    //-----------------------
	if( 1 != TestWaitForMessage(Dia_4F1h, TimeOut) )
	{
	   TestStepFail("Diagnosis Response timed out");
	}
    // check response time
    if( 1 == TestResponseTime )
    {
       if( MaxResponseTime < GetResponseTime())
       {
          write("Time of request = %d ms", ResponseTime);
          TestStepFail("Max. response time exceeded");
       }
    }
    // check response content
    if(   ( DiagnosticAddress       != getSignal(Dia_4F1h::STA_DIAG_ANTWORT_TN) )
       || ( (SID_ReadMemory + 0x40) != getSignal(Dia_4F1h::STA_DIAG_ANTWORT_B1) )
       || ( PID_TesterProgramNumber != getSignal(Dia_4F1h::STA_DIAG_ANTWORT_B2) )
       || ( TesterProgramNumber     != getSignal(Dia_4F1h::STA_DIAG_ANTWORT_B3) )
       || ( Date1         != getSignal(Dia_4F1h::STA_DIAG_ANTWORT_B4) )
       || ( Date2         != getSignal(Dia_4F1h::STA_DIAG_ANTWORT_B5) )
       || ( HW_Version    != getSignal(Dia_4F1h::STA_DIAG_ANTWORT_B6) )
       || ( SW_Version    != getSignal(Dia_4F1h::STA_DIAG_ANTWORT_B7) )
      )
    {
        TestStepFail("wrong message content");
    }


    //----------------------
	//--- POSTCONDITION ----
    //----------------------
    v_StopDiagnosis();
    TestWaitForMessage(Dia_4F1h, TimeOut);



///////////////////////////////////////////////////////////////////////////////
//------------------------------ TEST CASE END --------------------------------
///////////////////////////////////////////////////////////////////////////////
}
/*@@end*/

/*@@testcase:TC_43_ReadTesterProgramNumber_parametrization():*/
testcase TC_43_ReadTesterProgramNumber_parametrization ()
{
   //LOCALS


///////////////////////////////////////////////////////////////////////////////
//----------------------------- TEST CASE INFO --------------------------------
///////////////////////////////////////////////////////////////////////////////
	TestCaseTitle("ID_3418","4.13.4.3 - Read tester program number (parametrization)");
	TestCaseDescription("This test should prove that the Read Memory diagnosis service");
    TestCaseDescription("for the tester program number also works correctly");
	TestCaseDescription("in the parametrization mode.");



///////////////////////////////////////////////////////////////////////////////
//------------------------------ TEST STEPS -----------------------------------
///////////////////////////////////////////////////////////////////////////////


TestStep
("step 01"," Tester Program Number ");
    //----------------------
	//---- PRECONDITION ----
	//----------------------
    v_SetParameterMode();
    TestWaitForMessage(Dia_4F1h, TimeOut);


    //----------------------
	//----- TEST STEP ------
	//----------------------
    DiagnosticRequest.BYTE(0) = DiagnosticAddress;
    DiagnosticRequest.BYTE(1) = SID_ReadMemory;
    DiagnosticRequest.BYTE(2) = PID_TesterProgramNumber;
    DiagnosticRequest.BYTE(3) = 0xFF;
    DiagnosticRequest.BYTE(4) = 0xFF;
    DiagnosticRequest.BYTE(5) = 0xFF;
    DiagnosticRequest.BYTE(6) = 0xFF;
    DiagnosticRequest.BYTE(7) = 0xFF;

    output(DiagnosticRequest);


    //-----------------------
	//--- EXPECTED RESULT ---
    //-----------------------
	if( 1 != TestWaitForMessage(Dia_4F1h, TimeOut) )
	{
	   TestStepFail("Diagnosis Response timed out");
	}
    // check response time
    if( 1 == TestResponseTime )
    {
       if( MaxResponseTime < GetResponseTime())
       {
          write("Time of request = %d ms", ResponseTime);
          TestStepFail("Max. response time exceeded");
       }
    }
    // check response content
    if(   ( DiagnosticAddress       != getSignal(Dia_4F1h::STA_DIAG_ANTWORT_TN) )
       || ( (SID_ReadMemory + 0x40) != getSignal(Dia_4F1h::STA_DIAG_ANTWORT_B1) )
       || ( PID_TesterProgramNumber != getSignal(Dia_4F1h::STA_DIAG_ANTWORT_B2) )
       || ( TesterProgramNumber     != getSignal(Dia_4F1h::STA_DIAG_ANTWORT_B3) )
       || ( Date1         != getSignal(Dia_4F1h::STA_DIAG_ANTWORT_B4) )
       || ( Date2         != getSignal(Dia_4F1h::STA_DIAG_ANTWORT_B5) )
       || ( HW_Version    != getSignal(Dia_4F1h::STA_DIAG_ANTWORT_B6) )
       || ( SW_Version    != getSignal(Dia_4F1h::STA_DIAG_ANTWORT_B7) )
      )
    {
        TestStepFail("wrong message content");
    }


    //----------------------
	//--- POSTCONDITION ----
    //----------------------
    v_StopDiagnosis();
    TestWaitForMessage(Dia_4F1h, TimeOut);



///////////////////////////////////////////////////////////////////////////////
//------------------------------ TEST CASE END --------------------------------
///////////////////////////////////////////////////////////////////////////////
}
/*@@end*/

/*@@testcase:TC_44_ReadTesterProgramNumber_FBL():*/
testcase TC_44_ReadTesterProgramNumber_FBL ()
{
   //LOCALS


///////////////////////////////////////////////////////////////////////////////
//----------------------------- TEST CASE INFO --------------------------------
///////////////////////////////////////////////////////////////////////////////
	TestCaseTitle("ID_3419","4.13.4.4 - Read tester program number (FBL)");
	TestCaseDescription("This test should prove that the Read Memory diagnosis service");
    TestCaseDescription("for the tester program number also works correctly");
	TestCaseDescription("in the FBL mode.");



///////////////////////////////////////////////////////////////////////////////
//------------------------------ TEST STEPS -----------------------------------
///////////////////////////////////////////////////////////////////////////////


TestStep
("step 01"," Tester Program Number ");
    //----------------------
	//---- PRECONDITION ----
	//----------------------
    v_SetFBLMode();
    TestWaitForTimeout(5000);
    TesterPresent = 1;


    //----------------------
	//----- TEST STEP ------
	//----------------------
    DiagnosticRequest.BYTE(0) = DiagnosticAddress;
    DiagnosticRequest.BYTE(1) = SID_ReadMemory;
    DiagnosticRequest.BYTE(2) = PID_TesterProgramNumber;
    DiagnosticRequest.BYTE(3) = 0xFF;
    DiagnosticRequest.BYTE(4) = 0xFF;
    DiagnosticRequest.BYTE(5) = 0xFF;
    DiagnosticRequest.BYTE(6) = 0xFF;
    DiagnosticRequest.BYTE(7) = 0xFF;

    output(DiagnosticRequest);


    //-----------------------
	//--- EXPECTED RESULT ---
    //-----------------------
	if( 1 != TestWaitForMessage(Dia_4F1h, TimeOut) )
	{
	   TestStepFail("Diagnosis Response timed out");
	}
    // check response time
    if( 1 == TestResponseTime )
    {
       if( MaxResponseTime < GetResponseTime())
       {
          write("Time of request = %d ms", ResponseTime);
          TestStepFail("Max. response time exceeded");
       }
    }
    // check response content
    if(   ( DiagnosticAddress       != getSignal(Dia_4F1h::STA_DIAG_ANTWORT_TN) )
       || ( (SID_ReadMemory + 0x40) != getSignal(Dia_4F1h::STA_DIAG_ANTWORT_B1) )
       || ( PID_TesterProgramNumber != getSignal(Dia_4F1h::STA_DIAG_ANTWORT_B2) )
       || ( TesterProgramNumber     != getSignal(Dia_4F1h::STA_DIAG_ANTWORT_B3) )
       || ( Date1         != getSignal(Dia_4F1h::STA_DIAG_ANTWORT_B4) )
       || ( Date2         != getSignal(Dia_4F1h::STA_DIAG_ANTWORT_B5) )
       || ( HW_Version    != getSignal(Dia_4F1h::STA_DIAG_ANTWORT_B6) )
       || ( SW_Version    != getSignal(Dia_4F1h::STA_DIAG_ANTWORT_B7) )
      )
    {
        TestStepFail("wrong message content");
    }


    //----------------------
	//--- POSTCONDITION ----
    //----------------------
    TesterPresent = 0;
    v_StopDiagnosis();
    TestWaitForTimeout(5000);


    ////////////////////////////////////////////////////////////////
    // this reset is necessary due to bug (tracker #842)          //
    // in V5.0; to stop FBL mode a 2. stop request is required    //
    v_ResetECU();                                                 //
    TestWaitForTimeout(5000);                                     //
    ////////////////////////////////////////////////////////////////


///////////////////////////////////////////////////////////////////////////////
//------------------------------ TEST CASE END --------------------------------
///////////////////////////////////////////////////////////////////////////////
}
/*@@end*/

/*@@testcase:TC_45_ReadTesterProgramNumber_VDO():*/
testcase TC_45_ReadTesterProgramNumber_VDO ()
{
   //LOCALS


///////////////////////////////////////////////////////////////////////////////
//----------------------------- TEST CASE INFO --------------------------------
///////////////////////////////////////////////////////////////////////////////
	TestCaseTitle("ID_3420","4.13.4.5 - Read tester program number (VDO)");
	TestCaseDescription("This test should prove that the Read Memory diagnosis service");
    TestCaseDescription("for the tester program number also works correctly");
	TestCaseDescription("in the VDO mode.");



///////////////////////////////////////////////////////////////////////////////
//------------------------------ TEST STEPS -----------------------------------
///////////////////////////////////////////////////////////////////////////////


TestStep
("step 01"," Tester Program Number ");
    //----------------------
	//---- PRECONDITION ----
	//----------------------
    v_SetVDOMode();
    TestWaitForMessage(Dia_4F1h, TimeOut);


    //----------------------
	//----- TEST STEP ------
	//----------------------
    DiagnosticRequest.BYTE(0) = DiagnosticAddress;
    DiagnosticRequest.BYTE(1) = SID_ReadMemory;
    DiagnosticRequest.BYTE(2) = PID_TesterProgramNumber;
    DiagnosticRequest.BYTE(3) = 0xFF;
    DiagnosticRequest.BYTE(4) = 0xFF;
    DiagnosticRequest.BYTE(5) = 0xFF;
    DiagnosticRequest.BYTE(6) = 0xFF;
    DiagnosticRequest.BYTE(7) = 0xFF;

    output(DiagnosticRequest);


    //-----------------------
	//--- EXPECTED RESULT ---
    //-----------------------
	if( 1 != TestWaitForMessage(Dia_4F1h, TimeOut) )
	{
	   TestStepFail("Diagnosis Response timed out");
	}
    // check response time
    if( 1 == TestResponseTime )
    {
       if( MaxResponseTime < GetResponseTime())
       {
          write("Time of request = %d ms", ResponseTime);
          TestStepFail("Max. response time exceeded");
       }
    }
    // check response content
    if(   ( DiagnosticAddress       != getSignal(Dia_4F1h::STA_DIAG_ANTWORT_TN) )
       || ( (SID_ReadMemory + 0x40) != getSignal(Dia_4F1h::STA_DIAG_ANTWORT_B1) )
       || ( PID_TesterProgramNumber != getSignal(Dia_4F1h::STA_DIAG_ANTWORT_B2) )
       || ( TesterProgramNumber     != getSignal(Dia_4F1h::STA_DIAG_ANTWORT_B3) )
       || ( Date1         != getSignal(Dia_4F1h::STA_DIAG_ANTWORT_B4) )
       || ( Date2         != getSignal(Dia_4F1h::STA_DIAG_ANTWORT_B5) )
       || ( HW_Version    != getSignal(Dia_4F1h::STA_DIAG_ANTWORT_B6) )
       || ( SW_Version    != getSignal(Dia_4F1h::STA_DIAG_ANTWORT_B7) )
      )
    {
        TestStepFail("wrong message content");
    }


    //----------------------
	//--- POSTCONDITION ----
    //----------------------
    v_StopDiagnosis();
    TestWaitForMessage(Dia_4F1h, TimeOut);



///////////////////////////////////////////////////////////////////////////////
//------------------------------ TEST CASE END --------------------------------
///////////////////////////////////////////////////////////////////////////////
}
/*@@end*/

/*@@testcase:TC_52_ReadECUAbbreviation_active():*/
testcase TC_52_ReadECUAbbreviation_active ()
{
   //LOCALS


///////////////////////////////////////////////////////////////////////////////
//----------------------------- TEST CASE INFO --------------------------------
///////////////////////////////////////////////////////////////////////////////
	TestCaseTitle("ID_3421","4.13.5.2 - Read ECU abbreviation (active diagnosis)");
	TestCaseDescription("This test should prove that the Read Memory diagnosis service for");
	TestCaseDescription("the ECU abbreviation also works correctly in the active diagnosis mode.");



///////////////////////////////////////////////////////////////////////////////
//------------------------------ TEST STEPS -----------------------------------
///////////////////////////////////////////////////////////////////////////////


TestStep
("step 01"," ECU abbreviation ");
    //----------------------
	//---- PRECONDITION ----
	//----------------------
    v_SetActiveMode();
    TestWaitForMessage(Dia_4F1h, TimeOut);


    //----------------------
	//----- TEST STEP ------
	//----------------------
    DiagnosticRequest.BYTE(0) = DiagnosticAddress;
    DiagnosticRequest.BYTE(1) = SID_ReadMemory;
    DiagnosticRequest.BYTE(2) = PID_ECUAbbreviation;
    DiagnosticRequest.BYTE(3) = 0xFF;
    DiagnosticRequest.BYTE(4) = 0xFF;
    DiagnosticRequest.BYTE(5) = 0xFF;
    DiagnosticRequest.BYTE(6) = 0xFF;
    DiagnosticRequest.BYTE(7) = 0xFF;

    output(DiagnosticRequest);


    //-----------------------
	//--- EXPECTED RESULT ---
    //-----------------------
	if( 1 != TestWaitForMessage(Dia_4F1h, TimeOut) )
	{
	   TestStepFail("Diagnosis Response timed out");
	}
    // check response time
    if( 1 == TestResponseTime )
    {
       if( MaxResponseTime < GetResponseTime())
       {
          write("Time of request = %d ms", ResponseTime);
          TestStepFail("Max. response time exceeded");
       }
    }
    // check response content
    if(   ( DiagnosticAddress       != getSignal(Dia_4F1h::STA_DIAG_ANTWORT_TN) )
       || ( (SID_ReadMemory + 0x40) != getSignal(Dia_4F1h::STA_DIAG_ANTWORT_B1) )
       || ( PID_ECUAbbreviation     != getSignal(Dia_4F1h::STA_DIAG_ANTWORT_B2) )
       || ( ECU_1     != getSignal(Dia_4F1h::STA_DIAG_ANTWORT_B3) )
       || ( ECU_2     != getSignal(Dia_4F1h::STA_DIAG_ANTWORT_B4) )
       || ( ECU_3     != getSignal(Dia_4F1h::STA_DIAG_ANTWORT_B5) )
       || ( ID_Low    != getSignal(Dia_4F1h::STA_DIAG_ANTWORT_B6) )
       || ( ID_High   != getSignal(Dia_4F1h::STA_DIAG_ANTWORT_B7) )
      )
    {
        TestStepFail("wrong message content");
    }


    //----------------------
	//--- POSTCONDITION ----
    //----------------------
    v_StopDiagnosis();
    TestWaitForMessage(Dia_4F1h, TimeOut);



///////////////////////////////////////////////////////////////////////////////
//------------------------------ TEST CASE END --------------------------------
///////////////////////////////////////////////////////////////////////////////
}
/*@@end*/

/*@@testcase:TC_53_ReadECUAbbreviation_parametrization():*/
testcase TC_53_ReadECUAbbreviation_parametrization ()
{
   //LOCALS


///////////////////////////////////////////////////////////////////////////////
//----------------------------- TEST CASE INFO --------------------------------
///////////////////////////////////////////////////////////////////////////////
	TestCaseTitle("ID_3422","4.13.5.3 - Read ECU abbreviation (parametrization)");
	TestCaseDescription("This test should prove that the Read Memory diagnosis service for");
	TestCaseDescription("the ECU abbreviation also works correctly in the parametrization mode.");



///////////////////////////////////////////////////////////////////////////////
//------------------------------ TEST STEPS -----------------------------------
///////////////////////////////////////////////////////////////////////////////


TestStep
("step 01"," ECU abbreviation ");
    //----------------------
	//---- PRECONDITION ----
	//----------------------
    v_SetParameterMode();
    TestWaitForMessage(Dia_4F1h, TimeOut);


    //----------------------
	//----- TEST STEP ------
	//----------------------
    DiagnosticRequest.BYTE(0) = DiagnosticAddress;
    DiagnosticRequest.BYTE(1) = SID_ReadMemory;
    DiagnosticRequest.BYTE(2) = PID_ECUAbbreviation;
    DiagnosticRequest.BYTE(3) = 0xFF;
    DiagnosticRequest.BYTE(4) = 0xFF;
    DiagnosticRequest.BYTE(5) = 0xFF;
    DiagnosticRequest.BYTE(6) = 0xFF;
    DiagnosticRequest.BYTE(7) = 0xFF;

    output(DiagnosticRequest);


    //-----------------------
	//--- EXPECTED RESULT ---
    //-----------------------
	if( 1 != TestWaitForMessage(Dia_4F1h, TimeOut) )
	{
	   TestStepFail("Diagnosis Response timed out");
	}
    // check response time
    if( 1 == TestResponseTime )
    {
       if( MaxResponseTime < GetResponseTime())
       {
          write("Time of request = %d ms", ResponseTime);
          TestStepFail("Max. response time exceeded");
       }
    }
    // check response content
    if(   ( DiagnosticAddress       != getSignal(Dia_4F1h::STA_DIAG_ANTWORT_TN) )
       || ( (SID_ReadMemory + 0x40) != getSignal(Dia_4F1h::STA_DIAG_ANTWORT_B1) )
       || ( PID_ECUAbbreviation     != getSignal(Dia_4F1h::STA_DIAG_ANTWORT_B2) )
       || ( ECU_1     != getSignal(Dia_4F1h::STA_DIAG_ANTWORT_B3) )
       || ( ECU_2     != getSignal(Dia_4F1h::STA_DIAG_ANTWORT_B4) )
       || ( ECU_3     != getSignal(Dia_4F1h::STA_DIAG_ANTWORT_B5) )
       || ( ID_Low    != getSignal(Dia_4F1h::STA_DIAG_ANTWORT_B6) )
       || ( ID_High   != getSignal(Dia_4F1h::STA_DIAG_ANTWORT_B7) )
      )
    {
        TestStepFail("wrong message content");
    }


    //----------------------
	//--- POSTCONDITION ----
    //----------------------
    v_StopDiagnosis();
    TestWaitForMessage(Dia_4F1h, TimeOut);



///////////////////////////////////////////////////////////////////////////////
//------------------------------ TEST CASE END --------------------------------
///////////////////////////////////////////////////////////////////////////////
}
/*@@end*/

/*@@testcase:TC_54_ReadECUAbbreviation_FBL():*/
testcase TC_54_ReadECUAbbreviation_FBL ()
{
   //LOCALS


///////////////////////////////////////////////////////////////////////////////
//----------------------------- TEST CASE INFO --------------------------------
///////////////////////////////////////////////////////////////////////////////
	TestCaseTitle("ID_3423","4.13.5.5 - Read ECU abbreviation (FBL)");
	TestCaseDescription("This test should prove that the Read Memory diagnosis service for");
	TestCaseDescription("the ECU abbreviation also works correctly in the FBL mode.");



///////////////////////////////////////////////////////////////////////////////
//------------------------------ TEST STEPS -----------------------------------
///////////////////////////////////////////////////////////////////////////////


TestStep
("step 01"," ECU abbreviation ");
    //----------------------
	//---- PRECONDITION ----
	//----------------------
    v_SetFBLMode();
    TestWaitForTimeout(5000);
    TesterPresent = 1;



    //----------------------
	//----- TEST STEP ------
	//----------------------
    DiagnosticRequest.BYTE(0) = DiagnosticAddress;
    DiagnosticRequest.BYTE(1) = SID_ReadMemory;
    DiagnosticRequest.BYTE(2) = PID_ECUAbbreviation;
    DiagnosticRequest.BYTE(3) = 0xFF;
    DiagnosticRequest.BYTE(4) = 0xFF;
    DiagnosticRequest.BYTE(5) = 0xFF;
    DiagnosticRequest.BYTE(6) = 0xFF;
    DiagnosticRequest.BYTE(7) = 0xFF;

    output(DiagnosticRequest);


    //-----------------------
	//--- EXPECTED RESULT ---
    //-----------------------
	if( 1 != TestWaitForMessage(Dia_4F1h, TimeOut) )
	{
	   TestStepFail("Diagnosis Response timed out");
	}
    // check response time
    if( 1 == TestResponseTime )
    {
       if( MaxResponseTime < GetResponseTime())
       {
          write("Time of request = %d ms", ResponseTime);
          TestStepFail("Max. response time exceeded");
       }
    }
    // check response content
    if(   ( DiagnosticAddress       != getSignal(Dia_4F1h::STA_DIAG_ANTWORT_TN) )
       || ( (SID_ReadMemory + 0x40) != getSignal(Dia_4F1h::STA_DIAG_ANTWORT_B1) )
       || ( PID_ECUAbbreviation     != getSignal(Dia_4F1h::STA_DIAG_ANTWORT_B2) )
       || ( ECU_1     != getSignal(Dia_4F1h::STA_DIAG_ANTWORT_B3) )
       || ( ECU_2     != getSignal(Dia_4F1h::STA_DIAG_ANTWORT_B4) )
       || ( ECU_3     != getSignal(Dia_4F1h::STA_DIAG_ANTWORT_B5) )
       || ( ID_Low    != getSignal(Dia_4F1h::STA_DIAG_ANTWORT_B6) )
       || ( ID_High   != getSignal(Dia_4F1h::STA_DIAG_ANTWORT_B7) )
      )
    {
        TestStepFail("wrong message content");
    }


    //----------------------
	//--- POSTCONDITION ----
    //----------------------
    TesterPresent = 0;
    v_StopDiagnosis();
    TestWaitForTimeout(5000);


    ////////////////////////////////////////////////////////////////
    // this reset is necessary due to bug (tracker #842)          //
    // in V5.0; to stop FBL mode a 2. stop request is required    //
    v_ResetECU();                                                 //
    TestWaitForTimeout(5000);                                     //
    ////////////////////////////////////////////////////////////////


///////////////////////////////////////////////////////////////////////////////
//------------------------------ TEST CASE END --------------------------------
///////////////////////////////////////////////////////////////////////////////
}
/*@@end*/

/*@@testcase:TC_55_ReadECUAbbreviation_VDO():*/
testcase TC_55_ReadECUAbbreviation_VDO ()
{
   //LOCALS


///////////////////////////////////////////////////////////////////////////////
//----------------------------- TEST CASE INFO --------------------------------
///////////////////////////////////////////////////////////////////////////////
	TestCaseTitle("ID_3424","4.13.5.5 - Read ECU abbreviation (VDO)");
	TestCaseDescription("This test should prove that the Read Memory diagnosis service for");
	TestCaseDescription("the ECU abbreviation also works correctly in the VDO mode.");



///////////////////////////////////////////////////////////////////////////////
//------------------------------ TEST STEPS -----------------------------------
///////////////////////////////////////////////////////////////////////////////


TestStep
("step 01"," ECU abbreviation ");
    //----------------------
	//---- PRECONDITION ----
	//----------------------
    v_SetVDOMode();
    TestWaitForMessage(Dia_4F1h, TimeOut);


    //----------------------
	//----- TEST STEP ------
	//----------------------
    DiagnosticRequest.BYTE(0) = DiagnosticAddress;
    DiagnosticRequest.BYTE(1) = SID_ReadMemory;
    DiagnosticRequest.BYTE(2) = PID_ECUAbbreviation;
    DiagnosticRequest.BYTE(3) = 0xFF;
    DiagnosticRequest.BYTE(4) = 0xFF;
    DiagnosticRequest.BYTE(5) = 0xFF;
    DiagnosticRequest.BYTE(6) = 0xFF;
    DiagnosticRequest.BYTE(7) = 0xFF;

    output(DiagnosticRequest);


    //-----------------------
	//--- EXPECTED RESULT ---
    //-----------------------
	if( 1 != TestWaitForMessage(Dia_4F1h, TimeOut) )
	{
	   TestStepFail("Diagnosis Response timed out");
	}
    // check response time
    if( 1 == TestResponseTime )
    {
       if( MaxResponseTime < GetResponseTime())
       {
          write("Time of request = %d ms", ResponseTime);
          TestStepFail("Max. response time exceeded");
       }
    }
    // check response content
    if(   ( DiagnosticAddress       != getSignal(Dia_4F1h::STA_DIAG_ANTWORT_TN) )
       || ( (SID_ReadMemory + 0x40) != getSignal(Dia_4F1h::STA_DIAG_ANTWORT_B1) )
       || ( PID_ECUAbbreviation     != getSignal(Dia_4F1h::STA_DIAG_ANTWORT_B2) )
       || ( ECU_1     != getSignal(Dia_4F1h::STA_DIAG_ANTWORT_B3) )
       || ( ECU_2     != getSignal(Dia_4F1h::STA_DIAG_ANTWORT_B4) )
       || ( ECU_3     != getSignal(Dia_4F1h::STA_DIAG_ANTWORT_B5) )
       || ( ID_Low    != getSignal(Dia_4F1h::STA_DIAG_ANTWORT_B6) )
       || ( ID_High   != getSignal(Dia_4F1h::STA_DIAG_ANTWORT_B7) )
      )
    {
        TestStepFail("wrong message content");
    }


    //----------------------
	//--- POSTCONDITION ----
    //----------------------
    v_StopDiagnosis();
    TestWaitForMessage(Dia_4F1h, TimeOut);



///////////////////////////////////////////////////////////////////////////////
//------------------------------ TEST CASE END --------------------------------
///////////////////////////////////////////////////////////////////////////////
}
/*@@end*/

/*@@testcase:TC_62_ReadSupplierSoftwareVersion_active():*/
testcase TC_62_ReadSupplierSoftwareVersion_active ()
{
   //LOCALS


///////////////////////////////////////////////////////////////////////////////
//----------------------------- TEST CASE INFO --------------------------------
///////////////////////////////////////////////////////////////////////////////
	TestCaseTitle("ID_3425","4.13.6.2 - Read Supplier Software Version (active diagnosis mode)");
	TestCaseDescription("This test should prove that the Read Memory diagnosis service for");
	TestCaseDescription("the supplier software version also works correctly");
	TestCaseDescription("in the active diagnosis mode.");



///////////////////////////////////////////////////////////////////////////////
//------------------------------ TEST STEPS -----------------------------------
///////////////////////////////////////////////////////////////////////////////


TestStep
("step 01"," Supplier Software Version ");
    //----------------------
	//---- PRECONDITION ----
	//----------------------
    v_SetActiveMode();
    TestWaitForMessage(Dia_4F1h, TimeOut);


    //----------------------
	//----- TEST STEP ------
	//----------------------
    DiagnosticRequest.BYTE(0) = DiagnosticAddress;
    DiagnosticRequest.BYTE(1) = SID_ReadMemory;
    DiagnosticRequest.BYTE(2) = PID_SupplierSoftwareVersion;
    DiagnosticRequest.BYTE(3) = 0xFF;
    DiagnosticRequest.BYTE(4) = 0xFF;
    DiagnosticRequest.BYTE(5) = 0xFF;
    DiagnosticRequest.BYTE(6) = 0xFF;
    DiagnosticRequest.BYTE(7) = 0xFF;

    output(DiagnosticRequest);


    //-----------------------
	//--- EXPECTED RESULT ---
    //-----------------------
	if( 1 != TestWaitForMessage(Dia_4F1h, TimeOut) )
	{
	   TestStepFail("Diagnosis Response timed out");
	}
    // check response time
    if( 1 == TestResponseTime )
    {
       if( MaxResponseTime < GetResponseTime())
       {
          write("Time of request = %d ms", ResponseTime);
          TestStepFail("Max. response time exceeded");
       }
    }
    // check response content
    if(   ( DiagnosticAddress           != getSignal(Dia_4F1h::STA_DIAG_ANTWORT_TN) )
       || ( (SID_ReadMemory + 0x40)     != getSignal(Dia_4F1h::STA_DIAG_ANTWORT_B1) )
       || ( PID_SupplierSoftwareVersion != getSignal(Dia_4F1h::STA_DIAG_ANTWORT_B2) )
       || ( SW_ASCII_1  != getSignal(Dia_4F1h::STA_DIAG_ANTWORT_B3) )
       || ( SW_ASCII_2  != getSignal(Dia_4F1h::STA_DIAG_ANTWORT_B4) )
       || ( SW_ASCII_3  != getSignal(Dia_4F1h::STA_DIAG_ANTWORT_B5) )
       || ( SW_ASCII_4  != getSignal(Dia_4F1h::STA_DIAG_ANTWORT_B6) )
       || ( SW_ASCII_5  != getSignal(Dia_4F1h::STA_DIAG_ANTWORT_B7) )
      )
    {
        TestStepFail("wrong message content");
    }


    //----------------------
	//--- POSTCONDITION ----
    //----------------------
    v_StopDiagnosis();
    TestWaitForMessage(Dia_4F1h, TimeOut);



///////////////////////////////////////////////////////////////////////////////
//------------------------------ TEST CASE END --------------------------------
///////////////////////////////////////////////////////////////////////////////
}
/*@@end*/

/*@@testcase:TC_63_ReadSupplierSoftwareVersion_parametrization():*/
testcase TC_63_ReadSupplierSoftwareVersion_parametrization ()
{
   //LOCALS


///////////////////////////////////////////////////////////////////////////////
//----------------------------- TEST CASE INFO --------------------------------
///////////////////////////////////////////////////////////////////////////////
	TestCaseTitle("ID_3426","4.13.6.3 - Read Supplier Software Version (parametrization mode)");
	TestCaseDescription("This test should prove that the Read Memory diagnosis service for");
	TestCaseDescription("the supplier software version also works correctly");
	TestCaseDescription("in the parametrization mode.");



///////////////////////////////////////////////////////////////////////////////
//------------------------------ TEST STEPS -----------------------------------
///////////////////////////////////////////////////////////////////////////////


TestStep
("step 01"," Supplier Software Version ");
    //----------------------
	//---- PRECONDITION ----
	//----------------------
    v_SetParameterMode();
    TestWaitForMessage(Dia_4F1h, TimeOut);


    //----------------------
	//----- TEST STEP ------
	//----------------------
    DiagnosticRequest.BYTE(0) = DiagnosticAddress;
    DiagnosticRequest.BYTE(1) = SID_ReadMemory;
    DiagnosticRequest.BYTE(2) = PID_SupplierSoftwareVersion;
    DiagnosticRequest.BYTE(3) = 0xFF;
    DiagnosticRequest.BYTE(4) = 0xFF;
    DiagnosticRequest.BYTE(5) = 0xFF;
    DiagnosticRequest.BYTE(6) = 0xFF;
    DiagnosticRequest.BYTE(7) = 0xFF;

    output(DiagnosticRequest);


    //-----------------------
	//--- EXPECTED RESULT ---
    //-----------------------
	if( 1 != TestWaitForMessage(Dia_4F1h, TimeOut) )
	{
	   TestStepFail("Diagnosis Response timed out");
	}
    // check response time
    if( 1 == TestResponseTime )
    {
       if( MaxResponseTime < GetResponseTime())
       {
          write("Time of request = %d ms", ResponseTime);
          TestStepFail("Max. response time exceeded");
       }
    }
    // check response content
    if(   ( DiagnosticAddress           != getSignal(Dia_4F1h::STA_DIAG_ANTWORT_TN) )
       || ( (SID_ReadMemory + 0x40)     != getSignal(Dia_4F1h::STA_DIAG_ANTWORT_B1) )
       || ( PID_SupplierSoftwareVersion != getSignal(Dia_4F1h::STA_DIAG_ANTWORT_B2) )
       || ( SW_ASCII_1  != getSignal(Dia_4F1h::STA_DIAG_ANTWORT_B3) )
       || ( SW_ASCII_2  != getSignal(Dia_4F1h::STA_DIAG_ANTWORT_B4) )
       || ( SW_ASCII_3  != getSignal(Dia_4F1h::STA_DIAG_ANTWORT_B5) )
       || ( SW_ASCII_4  != getSignal(Dia_4F1h::STA_DIAG_ANTWORT_B6) )
       || ( SW_ASCII_5  != getSignal(Dia_4F1h::STA_DIAG_ANTWORT_B7) )
      )
    {
        TestStepFail("wrong message content");
    }


    //----------------------
	//--- POSTCONDITION ----
    //----------------------
    v_StopDiagnosis();
    TestWaitForMessage(Dia_4F1h, TimeOut);



///////////////////////////////////////////////////////////////////////////////
//------------------------------ TEST CASE END --------------------------------
///////////////////////////////////////////////////////////////////////////////
}
/*@@end*/

/*@@testcase:TC_64_ReadSupplierSoftwareVersion_FBL():*/
testcase TC_64_ReadSupplierSoftwareVersion_FBL ()
{
   //LOCALS


///////////////////////////////////////////////////////////////////////////////
//----------------------------- TEST CASE INFO --------------------------------
///////////////////////////////////////////////////////////////////////////////
	TestCaseTitle("ID_3427","4.13.6.4 - Read Supplier Software Version (FBL mode)");
	TestCaseDescription("This test should prove that the Read Memory diagnosis service for");
	TestCaseDescription("the supplier software version also works correctly");
	TestCaseDescription("in the FBL mode.");



///////////////////////////////////////////////////////////////////////////////
//------------------------------ TEST STEPS -----------------------------------
///////////////////////////////////////////////////////////////////////////////


TestStep
("step 01"," Supplier Software Version ");
    //----------------------
	//---- PRECONDITION ----
	//----------------------
    v_SetFBLMode();
    TestWaitForTimeout(5000);
    TesterPresent = 1;


    //----------------------
	//----- TEST STEP ------
	//----------------------
    DiagnosticRequest.BYTE(0) = DiagnosticAddress;
    DiagnosticRequest.BYTE(1) = SID_ReadMemory;
    DiagnosticRequest.BYTE(2) = PID_SupplierSoftwareVersion;
    DiagnosticRequest.BYTE(3) = 0xFF;
    DiagnosticRequest.BYTE(4) = 0xFF;
    DiagnosticRequest.BYTE(5) = 0xFF;
    DiagnosticRequest.BYTE(6) = 0xFF;
    DiagnosticRequest.BYTE(7) = 0xFF;

    output(DiagnosticRequest);


    //-----------------------
	//--- EXPECTED RESULT ---
    //-----------------------
	if( 1 != TestWaitForMessage(Dia_4F1h, TimeOut) )
	{
	   TestStepFail("Diagnosis Response timed out");
	}
    // check response time
    if( 1 == TestResponseTime )
    {
       if( MaxResponseTime < GetResponseTime())
       {
          write("Time of request = %d ms", ResponseTime);
          TestStepFail("Max. response time exceeded");
       }
    }
    // check response content
    if(   ( DiagnosticAddress           != getSignal(Dia_4F1h::STA_DIAG_ANTWORT_TN) )
       || ( (SID_ReadMemory + 0x40)     != getSignal(Dia_4F1h::STA_DIAG_ANTWORT_B1) )
       || ( PID_SupplierSoftwareVersion != getSignal(Dia_4F1h::STA_DIAG_ANTWORT_B2) )
       || ( SW_ASCII_1  != getSignal(Dia_4F1h::STA_DIAG_ANTWORT_B3) )
       || ( SW_ASCII_2  != getSignal(Dia_4F1h::STA_DIAG_ANTWORT_B4) )
       || ( SW_ASCII_3  != getSignal(Dia_4F1h::STA_DIAG_ANTWORT_B5) )
       || ( SW_ASCII_4  != getSignal(Dia_4F1h::STA_DIAG_ANTWORT_B6) )
       || ( SW_ASCII_5  != getSignal(Dia_4F1h::STA_DIAG_ANTWORT_B7) )
      )
    {
        TestStepFail("wrong message content");
    }


    //----------------------
	//--- POSTCONDITION ----
    //----------------------
    TesterPresent = 0;
    v_StopDiagnosis();
    TestWaitForTimeout(5000);


    ////////////////////////////////////////////////////////////////
    // this reset is necessary due to bug (tracker #842)          //
    // in V5.0; to stop FBL mode a 2. stop request is required    //
    v_ResetECU();                                                 //
    TestWaitForTimeout(5000);                                     //
    ////////////////////////////////////////////////////////////////


///////////////////////////////////////////////////////////////////////////////
//------------------------------ TEST CASE END --------------------------------
///////////////////////////////////////////////////////////////////////////////
}
/*@@end*/

/*@@testcase:TC_65_ReadSupplierSoftwareVersion_VDO():*/
testcase TC_65_ReadSupplierSoftwareVersion_VDO ()
{
   //LOCALS


///////////////////////////////////////////////////////////////////////////////
//----------------------------- TEST CASE INFO --------------------------------
///////////////////////////////////////////////////////////////////////////////
	TestCaseTitle("ID_3702","4.13.6.5 - Read Supplier Software Version (VDO mode)");
	TestCaseDescription("This test should prove that the Read Memory diagnosis service for");
	TestCaseDescription("the supplier software version also works correctly");
	TestCaseDescription("in the VDO mode.");



///////////////////////////////////////////////////////////////////////////////
//------------------------------ TEST STEPS -----------------------------------
///////////////////////////////////////////////////////////////////////////////


TestStep
("step 01"," Supplier Software Version ");
    //----------------------
	//---- PRECONDITION ----
	//----------------------
    v_SetVDOMode();
    TestWaitForMessage(Dia_4F1h, TimeOut);


    //----------------------
	//----- TEST STEP ------
	//----------------------
    DiagnosticRequest.BYTE(0) = DiagnosticAddress;
    DiagnosticRequest.BYTE(1) = SID_ReadMemory;
    DiagnosticRequest.BYTE(2) = PID_SupplierSoftwareVersion;
    DiagnosticRequest.BYTE(3) = 0xFF;
    DiagnosticRequest.BYTE(4) = 0xFF;
    DiagnosticRequest.BYTE(5) = 0xFF;
    DiagnosticRequest.BYTE(6) = 0xFF;
    DiagnosticRequest.BYTE(7) = 0xFF;

    output(DiagnosticRequest);


    //-----------------------
	//--- EXPECTED RESULT ---
    //-----------------------
	if( 1 != TestWaitForMessage(Dia_4F1h, TimeOut) )
	{
	   TestStepFail("Diagnosis Response timed out");
	}
    // check response time
    if( 1 == TestResponseTime )
    {
       if( MaxResponseTime < GetResponseTime())
       {
          write("Time of request = %d ms", ResponseTime);
          TestStepFail("Max. response time exceeded");
       }
    }
    // check response content
    if(   ( DiagnosticAddress           != getSignal(Dia_4F1h::STA_DIAG_ANTWORT_TN) )
       || ( (SID_ReadMemory + 0x40)     != getSignal(Dia_4F1h::STA_DIAG_ANTWORT_B1) )
       || ( PID_SupplierSoftwareVersion != getSignal(Dia_4F1h::STA_DIAG_ANTWORT_B2) )
       || ( SW_ASCII_1  != getSignal(Dia_4F1h::STA_DIAG_ANTWORT_B3) )
       || ( SW_ASCII_2  != getSignal(Dia_4F1h::STA_DIAG_ANTWORT_B4) )
       || ( SW_ASCII_3  != getSignal(Dia_4F1h::STA_DIAG_ANTWORT_B5) )
       || ( SW_ASCII_4  != getSignal(Dia_4F1h::STA_DIAG_ANTWORT_B6) )
       || ( SW_ASCII_5  != getSignal(Dia_4F1h::STA_DIAG_ANTWORT_B7) )
      )
    {
        TestStepFail("wrong message content");
    }


    //----------------------
	//--- POSTCONDITION ----
    //----------------------
    v_StopDiagnosis();
    TestWaitForMessage(Dia_4F1h, TimeOut);



///////////////////////////////////////////////////////////////////////////////
//------------------------------ TEST CASE END --------------------------------
///////////////////////////////////////////////////////////////////////////////
}
/*@@end*/

/*@@testcase:TC_72_ReadDCHardwareVersion_active():*/
testcase TC_72_ReadDCHardwareVersion_active ()
{
   //LOCALS


///////////////////////////////////////////////////////////////////////////////
//----------------------------- TEST CASE INFO --------------------------------
///////////////////////////////////////////////////////////////////////////////
	TestCaseTitle("ID_3428","4.13.7.2 - Read DC Hardware Version (active diagnosis)");
	TestCaseDescription("This test should prove that the Read Memory diagnosis service for");
	TestCaseDescription("the DC hardware version also works correctly");
	TestCaseDescription("in the active diagnosis mode.");
    

///////////////////////////////////////////////////////////////////////////////
//------------------------------ TEST STEPS -----------------------------------
///////////////////////////////////////////////////////////////////////////////


TestStep
("step 01"," DC Hardware Version ");
    //----------------------
	//---- PRECONDITION ----
	//----------------------
    v_SetActiveMode();
    TestWaitForMessage(Dia_4F1h, TimeOut);


    //----------------------
	//----- TEST STEP ------
	//----------------------
    DiagnosticRequest.BYTE(0) = DiagnosticAddress;
    DiagnosticRequest.BYTE(1) = SID_ReadMemory;
    DiagnosticRequest.BYTE(2) = PID_DCHardwareVersion;
    DiagnosticRequest.BYTE(3) = 0xFF;
    DiagnosticRequest.BYTE(4) = 0xFF;
    DiagnosticRequest.BYTE(5) = 0xFF;
    DiagnosticRequest.BYTE(6) = 0xFF;
    DiagnosticRequest.BYTE(7) = 0xFF;

    output(DiagnosticRequest);


    //-----------------------
	//--- EXPECTED RESULT ---
    //-----------------------
	if( 1 != TestWaitForMessage(Dia_4F1h, TimeOut) )
	{
	   TestStepFail("Diagnosis Response timed out");
	}
    // check response time
    if( 1 == TestResponseTime )
    {
       if( MaxResponseTime < GetResponseTime())
       {
          write("Time of request = %d ms", ResponseTime);
          TestStepFail("Max. response time exceeded");
       }
    }
    // check response content
    if(   ( DiagnosticAddress      != getSignal(Dia_4F1h::STA_DIAG_ANTWORT_TN) )
       || ( (SID_ReadMemory + 0x40)!= getSignal(Dia_4F1h::STA_DIAG_ANTWORT_B1) )
       || ( PID_DCHardwareVersion  != getSignal(Dia_4F1h::STA_DIAG_ANTWORT_B2) )
       || ( DC_HW_KW               != getSignal(Dia_4F1h::STA_DIAG_ANTWORT_B3) )
       || ( DC_HW_Year             != getSignal(Dia_4F1h::STA_DIAG_ANTWORT_B4) )
       || ( DC_HW_Patch            != getSignal(Dia_4F1h::STA_DIAG_ANTWORT_B5) )
       || ( 0xFF != getSignal(Dia_4F1h::STA_DIAG_ANTWORT_B6) )
       || ( 0xFF != getSignal(Dia_4F1h::STA_DIAG_ANTWORT_B7) )
      )
    {
        TestStepFail("wrong message content");
    }


    //----------------------
	//--- POSTCONDITION ----
    //----------------------
    v_StopDiagnosis();
    TestWaitForMessage(Dia_4F1h, TimeOut);



///////////////////////////////////////////////////////////////////////////////
//------------------------------ TEST CASE END --------------------------------
///////////////////////////////////////////////////////////////////////////////
}
/*@@end*/

/*@@testcase:TC_83_ReadDCSoftwareVersion_parametrization():*/
testcase TC_83_ReadDCSoftwareVersion_parametrization ()
{
   //LOCALS


///////////////////////////////////////////////////////////////////////////////
//----------------------------- TEST CASE INFO --------------------------------
///////////////////////////////////////////////////////////////////////////////
	TestCaseTitle("ID_3432","4.13.8.3 - Read DC Software Version (parametrization mode)");
	TestCaseDescription("This test should prove that the Read Memory diagnosis service for");
	TestCaseDescription("the DC software version also works correctly");
	TestCaseDescription("in the parametrization mode.");


///////////////////////////////////////////////////////////////////////////////
//------------------------------ TEST STEPS -----------------------------------
///////////////////////////////////////////////////////////////////////////////


TestStep
("step 01"," DC Software Version ");
    //----------------------
	//---- PRECONDITION ----
	//----------------------
     v_SetParameterMode();
    TestWaitForMessage(Dia_4F1h, TimeOut);
       

    //----------------------
	//----- TEST STEP ------
	//----------------------
    DiagnosticRequest.BYTE(0) = DiagnosticAddress;
    DiagnosticRequest.BYTE(1) = SID_ReadMemory;
    DiagnosticRequest.BYTE(2) = PID_DCSoftwareVersion;
    DiagnosticRequest.BYTE(3) = 0xFF;
    DiagnosticRequest.BYTE(4) = 0xFF;
    DiagnosticRequest.BYTE(5) = 0xFF;
    DiagnosticRequest.BYTE(6) = 0xFF;
    DiagnosticRequest.BYTE(7) = 0xFF;

    output(DiagnosticRequest);


    //-----------------------
	//--- EXPECTED RESULT ---
    //-----------------------
	if( 1 != TestWaitForMessage(Dia_4F1h, TimeOut) )
	{
	   TestStepFail("Diagnosis Response timed out");
	}
    // check response time
    if( 1 == TestResponseTime )
    {
       if( MaxResponseTime < GetResponseTime())
       {
          write("Time of request = %d ms", ResponseTime);
          TestStepFail("Max. response time exceeded");
       }
    }
    // check response content
    if(   ( DiagnosticAddress      != getSignal(Dia_4F1h::STA_DIAG_ANTWORT_TN) )
       || ( (SID_ReadMemory + 0x40)!= getSignal(Dia_4F1h::STA_DIAG_ANTWORT_B1) )
       || ( PID_DCSoftwareVersion  != getSignal(Dia_4F1h::STA_DIAG_ANTWORT_B2) )
       || ( DC_SW_KW               != getSignal(Dia_4F1h::STA_DIAG_ANTWORT_B3) )
       || ( DC_SW_Year             != getSignal(Dia_4F1h::STA_DIAG_ANTWORT_B4) )
       || ( DC_SW_Patch            != getSignal(Dia_4F1h::STA_DIAG_ANTWORT_B5) )
       || ( 0xFF != getSignal(Dia_4F1h::STA_DIAG_ANTWORT_B6) )
       || ( 0xFF != getSignal(Dia_4F1h::STA_DIAG_ANTWORT_B7) )
      )
    {
        TestStepFail("wrong message content");
    }


    //----------------------
	//--- POSTCONDITION ----
    //----------------------
    v_StopDiagnosis();
    TestWaitForMessage(Dia_4F1h, TimeOut);



///////////////////////////////////////////////////////////////////////////////
//------------------------------ TEST CASE END --------------------------------
///////////////////////////////////////////////////////////////////////////////
}
/*@@end*/

/*@@testcase:TC_73_ReadDCHardwareVersion_parametrization():*/
testcase TC_73_ReadDCHardwareVersion_parametrization ()
{
   //LOCALS


///////////////////////////////////////////////////////////////////////////////
//----------------------------- TEST CASE INFO --------------------------------
///////////////////////////////////////////////////////////////////////////////
	TestCaseTitle("ID_3429","4.13.7.3 - Read DC Hardware Version (parametrization mode)");
	TestCaseDescription("This test should prove that the Read Memory diagnosis service for");
	TestCaseDescription("the DC hardware version also works correctly");
	TestCaseDescription("in the parametrization mode.");
    

///////////////////////////////////////////////////////////////////////////////
//------------------------------ TEST STEPS -----------------------------------
///////////////////////////////////////////////////////////////////////////////


TestStep
("step 01"," DC Hardware Version ");
    //----------------------
	//---- PRECONDITION ----
	//----------------------
    v_SetParameterMode();
    TestWaitForMessage(Dia_4F1h, TimeOut);


    //----------------------
	//----- TEST STEP ------
	//----------------------
    DiagnosticRequest.BYTE(0) = DiagnosticAddress;
    DiagnosticRequest.BYTE(1) = SID_ReadMemory;
    DiagnosticRequest.BYTE(2) = PID_DCHardwareVersion;
    DiagnosticRequest.BYTE(3) = 0xFF;
    DiagnosticRequest.BYTE(4) = 0xFF;
    DiagnosticRequest.BYTE(5) = 0xFF;
    DiagnosticRequest.BYTE(6) = 0xFF;
    DiagnosticRequest.BYTE(7) = 0xFF;

    output(DiagnosticRequest);


    //-----------------------
	//--- EXPECTED RESULT ---
    //-----------------------
	if( 1 != TestWaitForMessage(Dia_4F1h, TimeOut) )
	{
	   TestStepFail("Diagnosis Response timed out");
	}
    // check response time
    if( 1 == TestResponseTime )
    {
       if( MaxResponseTime < GetResponseTime())
       {
          write("Time of request = %d ms", ResponseTime);
          TestStepFail("Max. response time exceeded");
       }
    }
    // check response content
    if(   ( DiagnosticAddress      != getSignal(Dia_4F1h::STA_DIAG_ANTWORT_TN) )
       || ( (SID_ReadMemory + 0x40)!= getSignal(Dia_4F1h::STA_DIAG_ANTWORT_B1) )
       || ( PID_DCHardwareVersion  != getSignal(Dia_4F1h::STA_DIAG_ANTWORT_B2) )
       || ( DC_HW_KW               != getSignal(Dia_4F1h::STA_DIAG_ANTWORT_B3) )
       || ( DC_HW_Year             != getSignal(Dia_4F1h::STA_DIAG_ANTWORT_B4) )
       || ( DC_HW_Patch            != getSignal(Dia_4F1h::STA_DIAG_ANTWORT_B5) )
       || ( 0xFF != getSignal(Dia_4F1h::STA_DIAG_ANTWORT_B6) )
       || ( 0xFF != getSignal(Dia_4F1h::STA_DIAG_ANTWORT_B7) )
      )
    {
        TestStepFail("wrong message content");
    }


    //----------------------
	//--- POSTCONDITION ----
    //----------------------
    v_StopDiagnosis();
    TestWaitForMessage(Dia_4F1h, TimeOut);



///////////////////////////////////////////////////////////////////////////////
//------------------------------ TEST CASE END --------------------------------
///////////////////////////////////////////////////////////////////////////////
}
/*@@end*/

/*@@testcase:TC_74_ReadDCHardwareVersion_FBL():*/
testcase TC_74_ReadDCHardwareVersion_FBL ()
{
   //LOCALS


///////////////////////////////////////////////////////////////////////////////
//----------------------------- TEST CASE INFO --------------------------------
///////////////////////////////////////////////////////////////////////////////
	TestCaseTitle("ID_3430","4.13.7.4 - Read DC Hardware Version (FBL mode)");
	TestCaseDescription("This test should prove that the Read Memory diagnosis service for");
	TestCaseDescription("the DC hardware version also works correctly");
	TestCaseDescription("in the FBL mode.");
    

///////////////////////////////////////////////////////////////////////////////
//------------------------------ TEST STEPS -----------------------------------
///////////////////////////////////////////////////////////////////////////////


TestStep
("step 01"," DC Hardware Version ");
    //----------------------
	//---- PRECONDITION ----
	//----------------------
    v_SetFBLMode();
    TestWaitForTimeout(5000);
    TesterPresent = 1;


    //----------------------
	//----- TEST STEP ------
	//----------------------
    DiagnosticRequest.BYTE(0) = DiagnosticAddress;
    DiagnosticRequest.BYTE(1) = SID_ReadMemory;
    DiagnosticRequest.BYTE(2) = PID_DCHardwareVersion;
    DiagnosticRequest.BYTE(3) = 0xFF;
    DiagnosticRequest.BYTE(4) = 0xFF;
    DiagnosticRequest.BYTE(5) = 0xFF;
    DiagnosticRequest.BYTE(6) = 0xFF;
    DiagnosticRequest.BYTE(7) = 0xFF;

    output(DiagnosticRequest);


    //-----------------------
	//--- EXPECTED RESULT ---
    //-----------------------
	if( 1 != TestWaitForMessage(Dia_4F1h, TimeOut) )
	{
	   TestStepFail("Diagnosis Response timed out");
	}
    // check response time
    if( 1 == TestResponseTime )
    {
       if( MaxResponseTime < GetResponseTime())
       {
          write("Time of request = %d ms", ResponseTime);
          TestStepFail("Max. response time exceeded");
       }
    }
    // check response content
    if(   ( DiagnosticAddress      != getSignal(Dia_4F1h::STA_DIAG_ANTWORT_TN) )
       || ( (SID_ReadMemory + 0x40)!= getSignal(Dia_4F1h::STA_DIAG_ANTWORT_B1) )
       || ( PID_DCHardwareVersion  != getSignal(Dia_4F1h::STA_DIAG_ANTWORT_B2) )
       || ( DC_HW_KW               != getSignal(Dia_4F1h::STA_DIAG_ANTWORT_B3) )
       || ( DC_HW_Year             != getSignal(Dia_4F1h::STA_DIAG_ANTWORT_B4) )
       || ( DC_HW_Patch            != getSignal(Dia_4F1h::STA_DIAG_ANTWORT_B5) )
       || ( 0xFF != getSignal(Dia_4F1h::STA_DIAG_ANTWORT_B6) )
       || ( 0xFF != getSignal(Dia_4F1h::STA_DIAG_ANTWORT_B7) )
      )
    {
        TestStepFail("wrong message content");
    }


    //----------------------
	//--- POSTCONDITION ----
    //----------------------
    TesterPresent = 0;
    v_StopDiagnosis();
    TestWaitForTimeout(5000);


    ////////////////////////////////////////////////////////////////
    // this reset is necessary due to bug (tracker #842)          //
    // in V5.0; to stop FBL mode a 2. stop request is required    //
    v_ResetECU();                                                 //
    TestWaitForTimeout(5000);                                     //
    ////////////////////////////////////////////////////////////////


///////////////////////////////////////////////////////////////////////////////
//------------------------------ TEST CASE END --------------------------------
///////////////////////////////////////////////////////////////////////////////
}
/*@@end*/

/*@@testcase:TC_75_ReadDCHardwareVersion_VDO():*/
testcase TC_75_ReadDCHardwareVersion_VDO ()
{
   //LOCALS


///////////////////////////////////////////////////////////////////////////////
//----------------------------- TEST CASE INFO --------------------------------
///////////////////////////////////////////////////////////////////////////////
	TestCaseTitle("ID_3703","4.13.7.5 - Read DC Hardware Version (VDO mode)");
	TestCaseDescription("This test should prove that the Read Memory diagnosis service for");
	TestCaseDescription("the DC hardware version also works correctly");
	TestCaseDescription("in the VDO mode.");
    

///////////////////////////////////////////////////////////////////////////////
//------------------------------ TEST STEPS -----------------------------------
///////////////////////////////////////////////////////////////////////////////


TestStep
("step 01"," DC Hardware Version ");
    //----------------------
	//---- PRECONDITION ----
	//----------------------
    v_SetVDOMode();
    TestWaitForMessage(Dia_4F1h, TimeOut);


    //----------------------
	//----- TEST STEP ------
	//----------------------
    DiagnosticRequest.BYTE(0) = DiagnosticAddress;
    DiagnosticRequest.BYTE(1) = SID_ReadMemory;
    DiagnosticRequest.BYTE(2) = PID_DCHardwareVersion;
    DiagnosticRequest.BYTE(3) = 0xFF;
    DiagnosticRequest.BYTE(4) = 0xFF;
    DiagnosticRequest.BYTE(5) = 0xFF;
    DiagnosticRequest.BYTE(6) = 0xFF;
    DiagnosticRequest.BYTE(7) = 0xFF;

    output(DiagnosticRequest);


    //-----------------------
	//--- EXPECTED RESULT ---
    //-----------------------
	if( 1 != TestWaitForMessage(Dia_4F1h, TimeOut) )
	{
	   TestStepFail("Diagnosis Response timed out");
	}
    // check response time
    if( 1 == TestResponseTime )
    {
       if( MaxResponseTime < GetResponseTime())
       {
          write("Time of request = %d ms", ResponseTime);
          TestStepFail("Max. response time exceeded");
       }
    }
    // check response content
    if(   ( DiagnosticAddress      != getSignal(Dia_4F1h::STA_DIAG_ANTWORT_TN) )
       || ( (SID_ReadMemory + 0x40)!= getSignal(Dia_4F1h::STA_DIAG_ANTWORT_B1) )
       || ( PID_DCHardwareVersion  != getSignal(Dia_4F1h::STA_DIAG_ANTWORT_B2) )
       || ( DC_HW_KW               != getSignal(Dia_4F1h::STA_DIAG_ANTWORT_B3) )
       || ( DC_HW_Year             != getSignal(Dia_4F1h::STA_DIAG_ANTWORT_B4) )
       || ( DC_HW_Patch            != getSignal(Dia_4F1h::STA_DIAG_ANTWORT_B5) )
       || ( 0xFF != getSignal(Dia_4F1h::STA_DIAG_ANTWORT_B6) )
       || ( 0xFF != getSignal(Dia_4F1h::STA_DIAG_ANTWORT_B7) )
      )
    {
        TestStepFail("wrong message content");
    }


    //----------------------
	//--- POSTCONDITION ----
    //----------------------
    v_StopDiagnosis();
    TestWaitForMessage(Dia_4F1h, TimeOut);



///////////////////////////////////////////////////////////////////////////////
//------------------------------ TEST CASE END --------------------------------
///////////////////////////////////////////////////////////////////////////////
}
/*@@end*/

/*@@testcase:TC_82_ReadDCSoftwareVersion_active():*/
testcase TC_82_ReadDCSoftwareVersion_active ()
{
   //LOCALS


///////////////////////////////////////////////////////////////////////////////
//----------------------------- TEST CASE INFO --------------------------------
///////////////////////////////////////////////////////////////////////////////
	TestCaseTitle("ID_3431","4.13.8.2 - Read DC Software Version (active diagnosis)");
	TestCaseDescription("This test should prove that the Read Memory diagnosis service for");
	TestCaseDescription("the DC software version also works correctly");
	TestCaseDescription("in the active diagnosis mode.");


///////////////////////////////////////////////////////////////////////////////
//------------------------------ TEST STEPS -----------------------------------
///////////////////////////////////////////////////////////////////////////////


TestStep
("step 01"," DC Software Version ");
    //----------------------
	//---- PRECONDITION ----
	//----------------------
     v_SetActiveMode();
    TestWaitForMessage(Dia_4F1h, TimeOut);
       

    //----------------------
	//----- TEST STEP ------
	//----------------------
    DiagnosticRequest.BYTE(0) = DiagnosticAddress;
    DiagnosticRequest.BYTE(1) = SID_ReadMemory;
    DiagnosticRequest.BYTE(2) = PID_DCSoftwareVersion;
    DiagnosticRequest.BYTE(3) = 0xFF;
    DiagnosticRequest.BYTE(4) = 0xFF;
    DiagnosticRequest.BYTE(5) = 0xFF;
    DiagnosticRequest.BYTE(6) = 0xFF;
    DiagnosticRequest.BYTE(7) = 0xFF;

    output(DiagnosticRequest);


    //-----------------------
	//--- EXPECTED RESULT ---
    //-----------------------
	if( 1 != TestWaitForMessage(Dia_4F1h, TimeOut) )
	{
	   TestStepFail("Diagnosis Response timed out");
	}
    // check response time
    if( 1 == TestResponseTime )
    {
       if( MaxResponseTime < GetResponseTime())
       {
          write("Time of request = %d ms", ResponseTime);
          TestStepFail("Max. response time exceeded");
       }
    }
    // check response content
    if(   ( DiagnosticAddress      != getSignal(Dia_4F1h::STA_DIAG_ANTWORT_TN) )
       || ( (SID_ReadMemory + 0x40)!= getSignal(Dia_4F1h::STA_DIAG_ANTWORT_B1) )
       || ( PID_DCSoftwareVersion  != getSignal(Dia_4F1h::STA_DIAG_ANTWORT_B2) )
       || ( DC_SW_KW               != getSignal(Dia_4F1h::STA_DIAG_ANTWORT_B3) )
       || ( DC_SW_Year             != getSignal(Dia_4F1h::STA_DIAG_ANTWORT_B4) )
       || ( DC_SW_Patch            != getSignal(Dia_4F1h::STA_DIAG_ANTWORT_B5) )
       || ( 0xFF != getSignal(Dia_4F1h::STA_DIAG_ANTWORT_B6) )
       || ( 0xFF != getSignal(Dia_4F1h::STA_DIAG_ANTWORT_B7) )
      )
    {
        TestStepFail("wrong message content");
    }


    //----------------------
	//--- POSTCONDITION ----
    //----------------------
    v_StopDiagnosis();
    TestWaitForMessage(Dia_4F1h, TimeOut);



///////////////////////////////////////////////////////////////////////////////
//------------------------------ TEST CASE END --------------------------------
///////////////////////////////////////////////////////////////////////////////
}
/*@@end*/

/*@@testcase:TC_84_ReadDCSoftwareVersion_FBL():*/
testcase TC_84_ReadDCSoftwareVersion_FBL ()
{
   //LOCALS


///////////////////////////////////////////////////////////////////////////////
//----------------------------- TEST CASE INFO --------------------------------
///////////////////////////////////////////////////////////////////////////////
	TestCaseTitle("ID_3433","4.13.8.4 - Read DC Software Version (FBL mode)");
	TestCaseDescription("This test should prove that the Read Memory diagnosis service for");
	TestCaseDescription("the DC software version also works correctly");
	TestCaseDescription("in the FBL mode.");


///////////////////////////////////////////////////////////////////////////////
//------------------------------ TEST STEPS -----------------------------------
///////////////////////////////////////////////////////////////////////////////


TestStep
("step 01"," DC Software Version ");
    //----------------------
	//---- PRECONDITION ----
	//----------------------
    v_SetFBLMode();
    TestWaitForTimeout(5000);
    TesterPresent = 1;
       

    //----------------------
	//----- TEST STEP ------
	//----------------------
    DiagnosticRequest.BYTE(0) = DiagnosticAddress;
    DiagnosticRequest.BYTE(1) = SID_ReadMemory;
    DiagnosticRequest.BYTE(2) = PID_DCSoftwareVersion;
    DiagnosticRequest.BYTE(3) = 0xFF;
    DiagnosticRequest.BYTE(4) = 0xFF;
    DiagnosticRequest.BYTE(5) = 0xFF;
    DiagnosticRequest.BYTE(6) = 0xFF;
    DiagnosticRequest.BYTE(7) = 0xFF;

    output(DiagnosticRequest);


    //-----------------------
	//--- EXPECTED RESULT ---
    //-----------------------
	if( 1 != TestWaitForMessage(Dia_4F1h, TimeOut) )
	{
	   TestStepFail("Diagnosis Response timed out");
	}
    // check response time
    if( 1 == TestResponseTime )
    {
       if( MaxResponseTime < GetResponseTime())
       {
          write("Time of request = %d ms", ResponseTime);
          TestStepFail("Max. response time exceeded");
       }
    }
    // check response content
    if(   ( DiagnosticAddress      != getSignal(Dia_4F1h::STA_DIAG_ANTWORT_TN) )
       || ( (SID_ReadMemory + 0x40)!= getSignal(Dia_4F1h::STA_DIAG_ANTWORT_B1) )
       || ( PID_DCSoftwareVersion  != getSignal(Dia_4F1h::STA_DIAG_ANTWORT_B2) )
       || ( DC_SW_KW               != getSignal(Dia_4F1h::STA_DIAG_ANTWORT_B3) )
       || ( DC_SW_Year             != getSignal(Dia_4F1h::STA_DIAG_ANTWORT_B4) )
       || ( DC_SW_Patch            != getSignal(Dia_4F1h::STA_DIAG_ANTWORT_B5) )
       || ( 0xFF != getSignal(Dia_4F1h::STA_DIAG_ANTWORT_B6) )
       || ( 0xFF != getSignal(Dia_4F1h::STA_DIAG_ANTWORT_B7) )
      )
    {
        TestStepFail("wrong message content");
    }


    //----------------------
	//--- POSTCONDITION ----
    //----------------------
    TesterPresent = 0;
    v_StopDiagnosis();
    TestWaitForTimeout(5000);


    ////////////////////////////////////////////////////////////////
    // this reset is necessary due to bug (tracker #842)          //
    // in V5.0; to stop FBL mode a 2. stop request is required    //
    v_ResetECU();                                                 //
    TestWaitForTimeout(5000);                                     //
    ////////////////////////////////////////////////////////////////


///////////////////////////////////////////////////////////////////////////////
//------------------------------ TEST CASE END --------------------------------
///////////////////////////////////////////////////////////////////////////////
}
/*@@end*/

/*@@testcase:TC_85_ReadDCSoftwareVersion_VDO():*/
testcase TC_85_ReadDCSoftwareVersion_VDO ()
{
   //LOCALS


///////////////////////////////////////////////////////////////////////////////
//----------------------------- TEST CASE INFO --------------------------------
///////////////////////////////////////////////////////////////////////////////
	TestCaseTitle("ID_3704","4.13.8.5 - Read DC Software Version (VDO mode)");
	TestCaseDescription("This test should prove that the Read Memory diagnosis service for");
	TestCaseDescription("the DC software version also works correctly");
	TestCaseDescription("in the VDO mode.");


///////////////////////////////////////////////////////////////////////////////
//------------------------------ TEST STEPS -----------------------------------
///////////////////////////////////////////////////////////////////////////////


TestStep
("step 01"," DC Software Version ");
    //----------------------
	//---- PRECONDITION ----
	//----------------------
     v_SetVDOMode();
    TestWaitForMessage(Dia_4F1h, TimeOut);
       

    //----------------------
	//----- TEST STEP ------
	//----------------------
    DiagnosticRequest.BYTE(0) = DiagnosticAddress;
    DiagnosticRequest.BYTE(1) = SID_ReadMemory;
    DiagnosticRequest.BYTE(2) = PID_DCSoftwareVersion;
    DiagnosticRequest.BYTE(3) = 0xFF;
    DiagnosticRequest.BYTE(4) = 0xFF;
    DiagnosticRequest.BYTE(5) = 0xFF;
    DiagnosticRequest.BYTE(6) = 0xFF;
    DiagnosticRequest.BYTE(7) = 0xFF;

    output(DiagnosticRequest);


    //-----------------------
	//--- EXPECTED RESULT ---
    //-----------------------
	if( 1 != TestWaitForMessage(Dia_4F1h, TimeOut) )
	{
	   TestStepFail("Diagnosis Response timed out");
	}
    // check response time
    if( 1 == TestResponseTime )
    {
       if( MaxResponseTime < GetResponseTime())
       {
          write("Time of request = %d ms", ResponseTime);
          TestStepFail("Max. response time exceeded");
       }
    }
    // check response content
    if(   ( DiagnosticAddress      != getSignal(Dia_4F1h::STA_DIAG_ANTWORT_TN) )
       || ( (SID_ReadMemory + 0x40)!= getSignal(Dia_4F1h::STA_DIAG_ANTWORT_B1) )
       || ( PID_DCSoftwareVersion  != getSignal(Dia_4F1h::STA_DIAG_ANTWORT_B2) )
       || ( DC_SW_KW               != getSignal(Dia_4F1h::STA_DIAG_ANTWORT_B3) )
       || ( DC_SW_Year             != getSignal(Dia_4F1h::STA_DIAG_ANTWORT_B4) )
       || ( DC_SW_Patch            != getSignal(Dia_4F1h::STA_DIAG_ANTWORT_B5) )
       || ( 0xFF != getSignal(Dia_4F1h::STA_DIAG_ANTWORT_B6) )
       || ( 0xFF != getSignal(Dia_4F1h::STA_DIAG_ANTWORT_B7) )
      )
    {
        TestStepFail("wrong message content");
    }


    //----------------------
	//--- POSTCONDITION ----
    //----------------------
    v_StopDiagnosis();
    TestWaitForMessage(Dia_4F1h, TimeOut);



///////////////////////////////////////////////////////////////////////////////
//------------------------------ TEST CASE END --------------------------------
///////////////////////////////////////////////////////////////////////////////
}
/*@@end*/

/*@@testcase:TC_91_ReadCameraHeight_not_calibrated():*/
testcase TC_91_ReadCameraHeight_not_calibrated ()
{
   //LOCALS
   word EE_Parameter;

///////////////////////////////////////////////////////////////////////////////
//----------------------------- TEST CASE INFO --------------------------------
///////////////////////////////////////////////////////////////////////////////
	TestCaseTitle("ID_3077","4.13.9.1 - Read CameraHeight (camera not calibrated)");
	TestCaseDescription("This test should prove that the system detects");
	TestCaseDescription("an uncalibrated camera respectively an nonconform");
	TestCaseDescription("camera serial number in the system and reacts as follows.");


///////////////////////////////////////////////////////////////////////////////
//------------------------------ TEST STEPS -----------------------------------
///////////////////////////////////////////////////////////////////////////////


TestStep
("step 01"," Camera Height ");
    //----------------------
	//---- PRECONDITION ----
	//----------------------
    // the camera height is already set to 1,00 m by setting the default EEPROM dump
    // and reseting the ECU
    v_ResetECU();
    TestWaitForMessage(Dia_4F1h, TimeOut);
    TestWaitForTimeout(5000);


    //----------------------
	//----- TEST STEP ------
	//----------------------
    DiagnosticRequest.BYTE(0) = DiagnosticAddress;
    DiagnosticRequest.BYTE(1) = SID_ReadMemory;
    DiagnosticRequest.BYTE(2) = PID_CameraHeight;
    DiagnosticRequest.BYTE(3) = 0xFF;
    DiagnosticRequest.BYTE(4) = 0xFF;
    DiagnosticRequest.BYTE(5) = 0xFF;
    DiagnosticRequest.BYTE(6) = 0xFF;
    DiagnosticRequest.BYTE(7) = 0xFF;

    output(DiagnosticRequest);


    //-----------------------
	//--- EXPECTED RESULT ---
    //-----------------------
	if( 1 != TestWaitForMessage(Dia_4F1h, TimeOut) )
	{
	   TestStepFail("Diagnosis Response timed out");
	}
    // check response time
    if( 1 == TestResponseTime )
    {
       if( MaxResponseTime < GetResponseTime())
       {
          write("Time of request = %d ms", ResponseTime);
          TestStepFail("Max. response time exceeded");
       }
    }
    // check response content
    if(   ( DiagnosticAddress      != getSignal(Dia_4F1h::STA_DIAG_ANTWORT_TN) )
       || ( (SID_ReadMemory + 0x40)!= getSignal(Dia_4F1h::STA_DIAG_ANTWORT_B1) )
       || ( PID_CameraHeight       != getSignal(Dia_4F1h::STA_DIAG_ANTWORT_B2) )
       || ( 0x64                   != getSignal(Dia_4F1h::STA_DIAG_ANTWORT_B3) )
       || ( 0x00                   != getSignal(Dia_4F1h::STA_DIAG_ANTWORT_B4) )
      )
    {
        TestStepFail("wrong message content");
    }


    //----------------------
	//--- POSTCONDITION ----
    //----------------------
    TestWaitForTimeout(10000);
    v_UnlockArea81();
    TestWaitForTimeout(100);
    EE_Parameter = v_ReadCCP(EE_ADDR_CameraHeight, 2);
	if( 0x000A != EE_Parameter )
	{
	   TestStepFail("EEPROM parameter wrong");
       write("Read EE_Parameter = 0x%x", EE_Parameter);
	}
    TesterPresent = 0;
    v_StopDiagnosis();
    TestWaitForMessage(Dia_4F1h, TimeOut);


///////////////////////////////////////////////////////////////////////////////
//------------------------------ TEST CASE END --------------------------------
///////////////////////////////////////////////////////////////////////////////
}
/*@@end*/

/*@@testcase:TC_93_ReadCameraHeight_active():*/
testcase TC_93_ReadCameraHeight_active ()
{
   //LOCALS
   word EE_Parameter;


///////////////////////////////////////////////////////////////////////////////
//----------------------------- TEST CASE INFO --------------------------------
///////////////////////////////////////////////////////////////////////////////
	TestCaseTitle("ID_3434","4.13.9.3 - Read Camera Height (active diagnosis mode)");
	TestCaseDescription("This test should prove that the Read Memory diagnosis service");
	TestCaseDescription("for Camera Height (PID = 0x10) works correctly also in active");
    TestCaseDescription("diagnosis mode.");


///////////////////////////////////////////////////////////////////////////////
//------------------------------ TEST STEPS -----------------------------------
///////////////////////////////////////////////////////////////////////////////


TestStep
("step 01"," Camera Height ");
    //----------------------
	//---- PRECONDITION ----
	//----------------------
     v_SetActiveMode();
    TestWaitForMessage(Dia_4F1h, TimeOut);


    //----------------------
	//----- TEST STEP ------
	//----------------------
    DiagnosticRequest.BYTE(0) = DiagnosticAddress;
    DiagnosticRequest.BYTE(1) = SID_ReadMemory;
    DiagnosticRequest.BYTE(2) = PID_CameraHeight;
    DiagnosticRequest.BYTE(3) = 0xFF;
    DiagnosticRequest.BYTE(4) = 0xFF;
    DiagnosticRequest.BYTE(5) = 0xFF;
    DiagnosticRequest.BYTE(6) = 0xFF;
    DiagnosticRequest.BYTE(7) = 0xFF;

    output(DiagnosticRequest);


    //-----------------------
	//--- EXPECTED RESULT ---
    //-----------------------
	if( 1 != TestWaitForMessage(Dia_4F1h, TimeOut) )
	{
	   TestStepFail("Diagnosis Response timed out");
	}
    // check response time
    if( 1 == TestResponseTime )
    {
       if( MaxResponseTime < GetResponseTime())
       {
          write("Time of request = %d ms", ResponseTime);
          TestStepFail("Max. response time exceeded");
       }
    }
    // check response content
    if(   ( DiagnosticAddress      != getSignal(Dia_4F1h::STA_DIAG_ANTWORT_TN) )
       || ( (SID_ReadMemory + 0x40)!= getSignal(Dia_4F1h::STA_DIAG_ANTWORT_B1) )
       || ( PID_CameraHeight       != getSignal(Dia_4F1h::STA_DIAG_ANTWORT_B2) )
       || ( 0x16                   != getSignal(Dia_4F1h::STA_DIAG_ANTWORT_B3) )
       || ( 0x01                   != getSignal(Dia_4F1h::STA_DIAG_ANTWORT_B4) )
      )
    {
        TestStepFail("wrong message content");
    }


    //----------------------
	//--- POSTCONDITION ----
    //----------------------
    TestWaitForTimeout(5000);
    v_UnlockArea81();
    TestWaitForTimeout(100);
    EE_Parameter = v_ReadCCP(EE_ADDR_CameraHeight, 2);
	if( 0x00BC != EE_Parameter )
	{
	   TestStepFail("EEPROM parameter wrong");
       write("Read EE_Parameter = 0x%x", EE_Parameter);
	}
    TesterPresent = 0;
    v_StopDiagnosis();
    TestWaitForMessage(Dia_4F1h, TimeOut);



///////////////////////////////////////////////////////////////////////////////
//------------------------------ TEST CASE END --------------------------------
///////////////////////////////////////////////////////////////////////////////
}
/*@@end*/

/*@@testcase:TC_94_ReadCameraHeight_parametrization():*/
testcase TC_94_ReadCameraHeight_parametrization ()
{
   //LOCALS
   word EE_Parameter;


///////////////////////////////////////////////////////////////////////////////
//----------------------------- TEST CASE INFO --------------------------------
///////////////////////////////////////////////////////////////////////////////
	TestCaseTitle("ID_3435","4.13.9.4 - Read Camera Height (parametrization mode)");
	TestCaseDescription("This test should prove that the Read Memory diagnosis service");
	TestCaseDescription("for Camera Height (PID = 0x10) works correctly also in the");
    TestCaseDescription("parametrization mode.");


///////////////////////////////////////////////////////////////////////////////
//------------------------------ TEST STEPS -----------------------------------
///////////////////////////////////////////////////////////////////////////////


TestStep
("step 01"," Camera Height ");
    //----------------------
	//---- PRECONDITION ----
	//----------------------
     v_SetParameterMode();
    TestWaitForMessage(Dia_4F1h, TimeOut);


    //----------------------
	//----- TEST STEP ------
	//----------------------
    DiagnosticRequest.BYTE(0) = DiagnosticAddress;
    DiagnosticRequest.BYTE(1) = SID_ReadMemory;
    DiagnosticRequest.BYTE(2) = PID_CameraHeight;
    DiagnosticRequest.BYTE(3) = 0xFF;
    DiagnosticRequest.BYTE(4) = 0xFF;
    DiagnosticRequest.BYTE(5) = 0xFF;
    DiagnosticRequest.BYTE(6) = 0xFF;
    DiagnosticRequest.BYTE(7) = 0xFF;

    output(DiagnosticRequest);


    //-----------------------
	//--- EXPECTED RESULT ---
    //-----------------------
	if( 1 != TestWaitForMessage(Dia_4F1h, TimeOut) )
	{
	   TestStepFail("Diagnosis Response timed out");
	}
    // check response time
    if( 1 == TestResponseTime )
    {
       if( MaxResponseTime < GetResponseTime())
       {
          write("Time of request = %d ms", ResponseTime);
          TestStepFail("Max. response time exceeded");
       }
    }
    // check response content
    if(   ( DiagnosticAddress      != getSignal(Dia_4F1h::STA_DIAG_ANTWORT_TN) )
       || ( (SID_ReadMemory + 0x40)!= getSignal(Dia_4F1h::STA_DIAG_ANTWORT_B1) )
       || ( PID_CameraHeight       != getSignal(Dia_4F1h::STA_DIAG_ANTWORT_B2) )
       || ( 0x16                   != getSignal(Dia_4F1h::STA_DIAG_ANTWORT_B3) )
       || ( 0x01                   != getSignal(Dia_4F1h::STA_DIAG_ANTWORT_B4) )
      )
    {
        TestStepFail("wrong message content");
    }


    //----------------------
	//--- POSTCONDITION ----
    //----------------------
    TestWaitForTimeout(5000);
    v_UnlockArea81();
    TestWaitForTimeout(100);
    EE_Parameter = v_ReadCCP(EE_ADDR_CameraHeight, 2);
	if( 0x00BC != EE_Parameter )
	{
	   TestStepFail("EEPROM parameter wrong");
       write("Read EE_Parameter = 0x%x", EE_Parameter);
	}
    TesterPresent = 0;
    v_StopDiagnosis();
    TestWaitForMessage(Dia_4F1h, TimeOut);



///////////////////////////////////////////////////////////////////////////////
//------------------------------ TEST CASE END --------------------------------
///////////////////////////////////////////////////////////////////////////////
}
/*@@end*/

/*@@testcase:TC_95_ReadCameraHeight_VDO():*/
testcase TC_95_ReadCameraHeight_VDO ()
{
   //LOCALS
   word EE_Parameter;


///////////////////////////////////////////////////////////////////////////////
//----------------------------- TEST CASE INFO --------------------------------
///////////////////////////////////////////////////////////////////////////////
	TestCaseTitle("ID_3436","4.13.9.5 - Read Camera Height (VDO mode)");
	TestCaseDescription("This test should prove that the Read Memory diagnosis service");
	TestCaseDescription("for Camera Height (PID = 0x10) works correctly also in the");
    TestCaseDescription("VDO mode.");


///////////////////////////////////////////////////////////////////////////////
//------------------------------ TEST STEPS -----------------------------------
///////////////////////////////////////////////////////////////////////////////


TestStep
("step 01"," Camera Height ");
    //----------------------
	//---- PRECONDITION ----
	//----------------------
     v_SetVDOMode();
    TestWaitForMessage(Dia_4F1h, TimeOut);


    //----------------------
	//----- TEST STEP ------
	//----------------------
    DiagnosticRequest.BYTE(0) = DiagnosticAddress;
    DiagnosticRequest.BYTE(1) = SID_ReadMemory;
    DiagnosticRequest.BYTE(2) = PID_CameraHeight;
    DiagnosticRequest.BYTE(3) = 0xFF;
    DiagnosticRequest.BYTE(4) = 0xFF;
    DiagnosticRequest.BYTE(5) = 0xFF;
    DiagnosticRequest.BYTE(6) = 0xFF;
    DiagnosticRequest.BYTE(7) = 0xFF;

    output(DiagnosticRequest);


    //-----------------------
	//--- EXPECTED RESULT ---
    //-----------------------
	if( 1 != TestWaitForMessage(Dia_4F1h, TimeOut) )
	{
	   TestStepFail("Diagnosis Response timed out");
	}
    // check response time
    if( 1 == TestResponseTime )
    {
       if( MaxResponseTime < GetResponseTime())
       {
          write("Time of request = %d ms", ResponseTime);
          TestStepFail("Max. response time exceeded");
       }
    }
    // check response content
    if(   ( DiagnosticAddress      != getSignal(Dia_4F1h::STA_DIAG_ANTWORT_TN) )
       || ( (SID_ReadMemory + 0x40)!= getSignal(Dia_4F1h::STA_DIAG_ANTWORT_B1) )
       || ( PID_CameraHeight       != getSignal(Dia_4F1h::STA_DIAG_ANTWORT_B2) )
       || ( 0x16                   != getSignal(Dia_4F1h::STA_DIAG_ANTWORT_B3) )
       || ( 0x01                   != getSignal(Dia_4F1h::STA_DIAG_ANTWORT_B4) )
      )
    {
        TestStepFail("wrong message content");
    }


    //----------------------
	//--- POSTCONDITION ----
    //----------------------
    TestWaitForTimeout(5000);
    v_UnlockArea81();
    TestWaitForTimeout(100);
    EE_Parameter = v_ReadCCP(EE_ADDR_CameraHeight, 2);
	if( 0x00BC != EE_Parameter )
	{
	   TestStepFail("EEPROM parameter wrong");
       write("Read EE_Parameter = 0x%x", EE_Parameter);
	}
    TesterPresent = 0;
    v_StopDiagnosis();
    TestWaitForMessage(Dia_4F1h, TimeOut);



///////////////////////////////////////////////////////////////////////////////
//------------------------------ TEST CASE END --------------------------------
///////////////////////////////////////////////////////////////////////////////
}
/*@@end*/

/*@@caplFunc:v_ReadCCP(long,byte):*///function
long v_ReadCCP(long Address, byte Length)
{
   long LogicalAddress;
   long Parameter = 0;

   ub_CCP_Activity = NO_ACTIVITY;

   CCP_Connect();
   if(1 == TestWaitForMessage(SPA_6EBh, TimeOut))
   {
   } 

   CCP_SetMTA(Address);
   if(1 == TestWaitForMessage(SPA_6EBh, TimeOut))
   {
      // write("Addr = 0x%x",Address); 
   } 

   CCP_Upload(Length);
   if(1 == TestWaitForMessage(SPA_6EBh, TimeOut))
   {
       // write("Length = %d",Length);
       switch(Length)
       { 
          case 1:
             Parameter  = (word)getsignal(SPA_6EBh::DTO_Data4);
             break;
          case 2:
             Parameter  = (word)getsignal(SPA_6EBh::DTO_Data4) <<8;
             Parameter |= (byte)getsignal(SPA_6EBh::DTO_Data5);
             break;
          case 4:
             Parameter  = (long)getsignal(SPA_6EBh::DTO_Data4) <<24;
             Parameter |= (long)getsignal(SPA_6EBh::DTO_Data5) <<16;
             Parameter |= (long)getsignal(SPA_6EBh::DTO_Data6) <<8;
             Parameter |= (byte)getsignal(SPA_6EBh::DTO_Data7);
             break;
       }
       // write("Parameter = 0x%x",Parameter); 
   } 
 
   CCP_Disconnect();
   if(1 == TestWaitForMessage(SPA_6EBh, TimeOut))
   {
   } 

   return Parameter;

}
/*@@end*/

/*@@testcase:TC_102_ReadVehicleWidth_active():*/
testcase TC_102_ReadVehicleWidth_active ()
{
   //LOCALS


///////////////////////////////////////////////////////////////////////////////
//----------------------------- TEST CASE INFO --------------------------------
///////////////////////////////////////////////////////////////////////////////
	TestCaseTitle("ID_3437","4.13.10.2 - Read VehicleWidth (active mode)");
	TestCaseDescription("This test should prove that the Read Memory diagnosis service");
	TestCaseDescription("for Vehicle Width (PID = 0x11) works correctly");
	TestCaseDescription("also in the active diagnosis mode.");



///////////////////////////////////////////////////////////////////////////////
//------------------------------ TEST STEPS -----------------------------------
///////////////////////////////////////////////////////////////////////////////


TestStep
("step 01"," Vehicle Width ");
    //----------------------
	//---- PRECONDITION ----
	//----------------------
    v_SetActiveMode();
    TestWaitForMessage(Dia_4F1h, TimeOut);


    //----------------------
	//----- TEST STEP ------
	//----------------------
    DiagnosticRequest.BYTE(0) = DiagnosticAddress;
    DiagnosticRequest.BYTE(1) = SID_ReadMemory;
    DiagnosticRequest.BYTE(2) = PID_VehicleWidth;
    DiagnosticRequest.BYTE(3) = 0xFF;
    DiagnosticRequest.BYTE(4) = 0xFF;
    DiagnosticRequest.BYTE(5) = 0xFF;
    DiagnosticRequest.BYTE(6) = 0xFF;
    DiagnosticRequest.BYTE(7) = 0xFF;

    output(DiagnosticRequest);


    //-----------------------
	//--- EXPECTED RESULT ---
    //-----------------------
	if( 1 != TestWaitForMessage(Dia_4F1h, TimeOut) )
	{
	   TestStepFail("Diagnosis Response timed out");
	}
    // check response time
    if( 1 == TestResponseTime )
    {
       if( MaxResponseTime < GetResponseTime())
       {
          write("Time of request = %d ms", ResponseTime);
          TestStepFail("Max. response time exceeded");
       }
    }
    // check response content
    if(   ( DiagnosticAddress      != getSignal(Dia_4F1h::STA_DIAG_ANTWORT_TN) )
       || ( (SID_ReadMemory + 0x40)!= getSignal(Dia_4F1h::STA_DIAG_ANTWORT_B1) )
       || ( PID_VehicleWidth       != getSignal(Dia_4F1h::STA_DIAG_ANTWORT_B2) )
       || ( 0xFA != getSignal(Dia_4F1h::STA_DIAG_ANTWORT_B3) )
       || ( 0x00 != getSignal(Dia_4F1h::STA_DIAG_ANTWORT_B4) )
      )
    {
        TestStepFail("wrong message content");
    }


    //----------------------
	//--- POSTCONDITION ----
    //----------------------
    v_StopDiagnosis();
    TestWaitForMessage(Dia_4F1h, TimeOut);



///////////////////////////////////////////////////////////////////////////////
//------------------------------ TEST CASE END --------------------------------
///////////////////////////////////////////////////////////////////////////////
}
/*@@end*/

/*@@testcase:TC_103_ReadVehicleWidth_parametrization():*/
testcase TC_103_ReadVehicleWidth_parametrization ()
{
   //LOCALS


///////////////////////////////////////////////////////////////////////////////
//----------------------------- TEST CASE INFO --------------------------------
///////////////////////////////////////////////////////////////////////////////
	TestCaseTitle("ID_3438","4.13.10.3 - Read VehicleWidth (parametrization mode)");
	TestCaseDescription("This test should prove that the Read Memory diagnosis service");
	TestCaseDescription("for Vehicle Width (PID = 0x11) works correctly");
	TestCaseDescription("also in the parametrization mode.");



///////////////////////////////////////////////////////////////////////////////
//------------------------------ TEST STEPS -----------------------------------
///////////////////////////////////////////////////////////////////////////////


TestStep
("step 01"," Vehicle Width ");
    //----------------------
	//---- PRECONDITION ----
	//----------------------
    v_SetParameterMode();
    TestWaitForMessage(Dia_4F1h, TimeOut);


    //----------------------
	//----- TEST STEP ------
	//----------------------
    DiagnosticRequest.BYTE(0) = DiagnosticAddress;
    DiagnosticRequest.BYTE(1) = SID_ReadMemory;
    DiagnosticRequest.BYTE(2) = PID_VehicleWidth;
    DiagnosticRequest.BYTE(3) = 0xFF;
    DiagnosticRequest.BYTE(4) = 0xFF;
    DiagnosticRequest.BYTE(5) = 0xFF;
    DiagnosticRequest.BYTE(6) = 0xFF;
    DiagnosticRequest.BYTE(7) = 0xFF;

    output(DiagnosticRequest);


    //-----------------------
	//--- EXPECTED RESULT ---
    //-----------------------
	if( 1 != TestWaitForMessage(Dia_4F1h, TimeOut) )
	{
	   TestStepFail("Diagnosis Response timed out");
	}
    // check response time
    if( 1 == TestResponseTime )
    {
       if( MaxResponseTime < GetResponseTime())
       {
          write("Time of request = %d ms", ResponseTime);
          TestStepFail("Max. response time exceeded");
       }
    }
    // check response content
    if(   ( DiagnosticAddress      != getSignal(Dia_4F1h::STA_DIAG_ANTWORT_TN) )
       || ( (SID_ReadMemory + 0x40)!= getSignal(Dia_4F1h::STA_DIAG_ANTWORT_B1) )
       || ( PID_VehicleWidth       != getSignal(Dia_4F1h::STA_DIAG_ANTWORT_B2) )
       || ( 0xFA != getSignal(Dia_4F1h::STA_DIAG_ANTWORT_B3) )
       || ( 0x00 != getSignal(Dia_4F1h::STA_DIAG_ANTWORT_B4) )
      )
    {
        TestStepFail("wrong message content");
    }


    //----------------------
	//--- POSTCONDITION ----
    //----------------------
    v_StopDiagnosis();
    TestWaitForMessage(Dia_4F1h, TimeOut);



///////////////////////////////////////////////////////////////////////////////
//------------------------------ TEST CASE END --------------------------------
///////////////////////////////////////////////////////////////////////////////
}
/*@@end*/

/*@@testcase:TC_104_ReadVehicleWidth_VDO():*/
testcase TC_104_ReadVehicleWidth_VDO ()
{
   //LOCALS


///////////////////////////////////////////////////////////////////////////////
//----------------------------- TEST CASE INFO --------------------------------
///////////////////////////////////////////////////////////////////////////////
	TestCaseTitle("ID_3439","4.13.10.4 - Read VehicleWidth (VDO mode)");
	TestCaseDescription("This test should prove that the Read Memory diagnosis service");
	TestCaseDescription("for Vehicle Width (PID = 0x11) works correctly");
	TestCaseDescription("also in the VDO mode.");



///////////////////////////////////////////////////////////////////////////////
//------------------------------ TEST STEPS -----------------------------------
///////////////////////////////////////////////////////////////////////////////


TestStep
("step 01"," Vehicle Width ");
    //----------------------
	//---- PRECONDITION ----
	//----------------------
    v_SetVDOMode();
    TestWaitForMessage(Dia_4F1h, TimeOut);


    //----------------------
	//----- TEST STEP ------
	//----------------------
    DiagnosticRequest.BYTE(0) = DiagnosticAddress;
    DiagnosticRequest.BYTE(1) = SID_ReadMemory;
    DiagnosticRequest.BYTE(2) = PID_VehicleWidth;
    DiagnosticRequest.BYTE(3) = 0xFF;
    DiagnosticRequest.BYTE(4) = 0xFF;
    DiagnosticRequest.BYTE(5) = 0xFF;
    DiagnosticRequest.BYTE(6) = 0xFF;
    DiagnosticRequest.BYTE(7) = 0xFF;

    output(DiagnosticRequest);


    //-----------------------
	//--- EXPECTED RESULT ---
    //-----------------------
	if( 1 != TestWaitForMessage(Dia_4F1h, TimeOut) )
	{
	   TestStepFail("Diagnosis Response timed out");
	}
    // check response time
    if( 1 == TestResponseTime )
    {
       if( MaxResponseTime < GetResponseTime())
       {
          write("Time of request = %d ms", ResponseTime);
          TestStepFail("Max. response time exceeded");
       }
    }
    // check response content
    if(   ( DiagnosticAddress      != getSignal(Dia_4F1h::STA_DIAG_ANTWORT_TN) )
       || ( (SID_ReadMemory + 0x40)!= getSignal(Dia_4F1h::STA_DIAG_ANTWORT_B1) )
       || ( PID_VehicleWidth       != getSignal(Dia_4F1h::STA_DIAG_ANTWORT_B2) )
       || ( 0xFA != getSignal(Dia_4F1h::STA_DIAG_ANTWORT_B3) )
       || ( 0x00 != getSignal(Dia_4F1h::STA_DIAG_ANTWORT_B4) )
      )
    {
        TestStepFail("wrong message content");
    }


    //----------------------
	//--- POSTCONDITION ----
    //----------------------
    v_StopDiagnosis();
    TestWaitForMessage(Dia_4F1h, TimeOut);



///////////////////////////////////////////////////////////////////////////////
//------------------------------ TEST CASE END --------------------------------
///////////////////////////////////////////////////////////////////////////////
}
/*@@end*/

/*@@testcase:TC_112_ReadCameraDisplacement_active():*/
testcase TC_112_ReadCameraDisplacement_active ()
{
   //LOCALS


///////////////////////////////////////////////////////////////////////////////
//----------------------------- TEST CASE INFO --------------------------------
///////////////////////////////////////////////////////////////////////////////
	TestCaseTitle("ÍD_3440","4.13.11.1 - Read Camera Displacement (active diagnosis mode)");
	TestCaseDescription("This test should prove that the Read Memory diagnosis service");
	TestCaseDescription("for Camera Displacement/Lateral Offset (PID = 0x12) also");
	TestCaseDescription("works correctly in the active diagnosis mode");



///////////////////////////////////////////////////////////////////////////////
//------------------------------ TEST STEPS -----------------------------------
///////////////////////////////////////////////////////////////////////////////


TestStep
("step 01"," Camera Displacement ");
    //----------------------
	//---- PRECONDITION ----
	//----------------------
    v_SetActiveMode();
    TestWaitForMessage(Dia_4F1h, TimeOut);

    //----------------------
	//----- TEST STEP ------
	//----------------------
    DiagnosticRequest.BYTE(0) = DiagnosticAddress;
    DiagnosticRequest.BYTE(1) = SID_ReadMemory;
    DiagnosticRequest.BYTE(2) = PID_CameraDisplacement;
    DiagnosticRequest.BYTE(3) = 0xFF;
    DiagnosticRequest.BYTE(4) = 0xFF;
    DiagnosticRequest.BYTE(5) = 0xFF;
    DiagnosticRequest.BYTE(6) = 0xFF;
    DiagnosticRequest.BYTE(7) = 0xFF;

    output(DiagnosticRequest);


    //-----------------------
	//--- EXPECTED RESULT ---
    //-----------------------
	if( 1 != TestWaitForMessage(Dia_4F1h, TimeOut) )
	{
	   TestStepFail("Diagnosis Response timed out");
	}
    // check response time
    if( 1 == TestResponseTime )
    {
       if( MaxResponseTime < GetResponseTime())
       {
          write("Time of request = %d ms", ResponseTime);
          TestStepFail("Max. response time exceeded");
       }
    }
    // check response content
    if(   ( DiagnosticAddress      != getSignal(Dia_4F1h::STA_DIAG_ANTWORT_TN) )
       || ( (SID_ReadMemory + 0x40)!= getSignal(Dia_4F1h::STA_DIAG_ANTWORT_B1) )
       || ( PID_CameraDisplacement != getSignal(Dia_4F1h::STA_DIAG_ANTWORT_B2) )
       || ( 0x00 != getSignal(Dia_4F1h::STA_DIAG_ANTWORT_B3) )
       || ( 0x00 != getSignal(Dia_4F1h::STA_DIAG_ANTWORT_B4) )
      )
    {
        TestStepFail("wrong message content");
    }


    //----------------------
	//--- POSTCONDITION ----
    //----------------------
    v_StopDiagnosis();
    TestWaitForMessage(Dia_4F1h, TimeOut);



///////////////////////////////////////////////////////////////////////////////
//------------------------------ TEST CASE END --------------------------------
///////////////////////////////////////////////////////////////////////////////
}
/*@@end*/

/*@@testcase:TC_113_ReadCameraDisplacement_parametrization():*/
testcase TC_113_ReadCameraDisplacement_parametrization ()
{
   //LOCALS


///////////////////////////////////////////////////////////////////////////////
//----------------------------- TEST CASE INFO --------------------------------
///////////////////////////////////////////////////////////////////////////////
	TestCaseTitle("ÍD_3441","4.13.11.3 - Read Camera Displacement (parametrization mode)");
	TestCaseDescription("This test should prove that the Read Memory diagnosis service");
	TestCaseDescription("for Camera Displacement/Lateral Offset (PID = 0x12) also");
	TestCaseDescription("works correctly in the parametrization mode");



///////////////////////////////////////////////////////////////////////////////
//------------------------------ TEST STEPS -----------------------------------
///////////////////////////////////////////////////////////////////////////////


TestStep
("step 01"," Camera Displacement ");
    //----------------------
	//---- PRECONDITION ----
	//----------------------
    v_SetParameterMode();
    TestWaitForMessage(Dia_4F1h, TimeOut);

    //----------------------
	//----- TEST STEP ------
	//----------------------
    DiagnosticRequest.BYTE(0) = DiagnosticAddress;
    DiagnosticRequest.BYTE(1) = SID_ReadMemory;
    DiagnosticRequest.BYTE(2) = PID_CameraDisplacement;
    DiagnosticRequest.BYTE(3) = 0xFF;
    DiagnosticRequest.BYTE(4) = 0xFF;
    DiagnosticRequest.BYTE(5) = 0xFF;
    DiagnosticRequest.BYTE(6) = 0xFF;
    DiagnosticRequest.BYTE(7) = 0xFF;

    output(DiagnosticRequest);


    //-----------------------
	//--- EXPECTED RESULT ---
    //-----------------------
	if( 1 != TestWaitForMessage(Dia_4F1h, TimeOut) )
	{
	   TestStepFail("Diagnosis Response timed out");
	}
    // check response time
    if( 1 == TestResponseTime )
    {
       if( MaxResponseTime < GetResponseTime())
       {
          write("Time of request = %d ms", ResponseTime);
          TestStepFail("Max. response time exceeded");
       }
    }
    // check response content
    if(   ( DiagnosticAddress      != getSignal(Dia_4F1h::STA_DIAG_ANTWORT_TN) )
       || ( (SID_ReadMemory + 0x40)!= getSignal(Dia_4F1h::STA_DIAG_ANTWORT_B1) )
       || ( PID_CameraDisplacement != getSignal(Dia_4F1h::STA_DIAG_ANTWORT_B2) )
       || ( 0x00 != getSignal(Dia_4F1h::STA_DIAG_ANTWORT_B3) )
       || ( 0x00 != getSignal(Dia_4F1h::STA_DIAG_ANTWORT_B4) )
      )
    {
        TestStepFail("wrong message content");
    }


    //----------------------
	//--- POSTCONDITION ----
    //----------------------
    v_StopDiagnosis();
    TestWaitForMessage(Dia_4F1h, TimeOut);



///////////////////////////////////////////////////////////////////////////////
//------------------------------ TEST CASE END --------------------------------
///////////////////////////////////////////////////////////////////////////////
}
/*@@end*/

/*@@testcase:TC_114_ReadCameraDisplacement_VDO():*/
testcase TC_114_ReadCameraDisplacement_VDO ()
{
   //LOCALS


///////////////////////////////////////////////////////////////////////////////
//----------------------------- TEST CASE INFO --------------------------------
///////////////////////////////////////////////////////////////////////////////
	TestCaseTitle("ÍD_3442","4.13.11.4 - Read Camera Displacement (VDO mode)");
	TestCaseDescription("This test should prove that the Read Memory diagnosis service");
	TestCaseDescription("for Camera Displacement/Lateral Offset (PID = 0x12) also");
	TestCaseDescription("works correctly in the VDO mode");



///////////////////////////////////////////////////////////////////////////////
//------------------------------ TEST STEPS -----------------------------------
///////////////////////////////////////////////////////////////////////////////


TestStep
("step 01"," Camera Displacement ");
    //----------------------
	//---- PRECONDITION ----
	//----------------------
    v_SetVDOMode();
    TestWaitForMessage(Dia_4F1h, TimeOut);

    //----------------------
	//----- TEST STEP ------
	//----------------------
    DiagnosticRequest.BYTE(0) = DiagnosticAddress;
    DiagnosticRequest.BYTE(1) = SID_ReadMemory;
    DiagnosticRequest.BYTE(2) = PID_CameraDisplacement;
    DiagnosticRequest.BYTE(3) = 0xFF;
    DiagnosticRequest.BYTE(4) = 0xFF;
    DiagnosticRequest.BYTE(5) = 0xFF;
    DiagnosticRequest.BYTE(6) = 0xFF;
    DiagnosticRequest.BYTE(7) = 0xFF;

    output(DiagnosticRequest);


    //-----------------------
	//--- EXPECTED RESULT ---
    //-----------------------
	if( 1 != TestWaitForMessage(Dia_4F1h, TimeOut) )
	{
	   TestStepFail("Diagnosis Response timed out");
	}
    // check response time
    if( 1 == TestResponseTime )
    {
       if( MaxResponseTime < GetResponseTime())
       {
          write("Time of request = %d ms", ResponseTime);
          TestStepFail("Max. response time exceeded");
       }
    }
    // check response content
    if(   ( DiagnosticAddress      != getSignal(Dia_4F1h::STA_DIAG_ANTWORT_TN) )
       || ( (SID_ReadMemory + 0x40)!= getSignal(Dia_4F1h::STA_DIAG_ANTWORT_B1) )
       || ( PID_CameraDisplacement != getSignal(Dia_4F1h::STA_DIAG_ANTWORT_B2) )
       || ( 0x00 != getSignal(Dia_4F1h::STA_DIAG_ANTWORT_B3) )
       || ( 0x00 != getSignal(Dia_4F1h::STA_DIAG_ANTWORT_B4) )
      )
    {
        TestStepFail("wrong message content");
    }


    //----------------------
	//--- POSTCONDITION ----
    //----------------------
    v_StopDiagnosis();
    TestWaitForMessage(Dia_4F1h, TimeOut);



///////////////////////////////////////////////////////////////////////////////
//------------------------------ TEST CASE END --------------------------------
///////////////////////////////////////////////////////////////////////////////
}
/*@@end*/

/*@@testcase:TC_115_ReadCameraDisplacement_NegativeValue():*/
testcase TC_115_ReadCameraDisplacement_NegativeValue ()
{
   //LOCALS
   byte EEPROM[1] = 0x00;

///////////////////////////////////////////////////////////////////////////////
//----------------------------- TEST CASE INFO --------------------------------
///////////////////////////////////////////////////////////////////////////////
	TestCaseTitle("ÍD_995","4.13.11.5 - Read Camera Displacement (negative value)");
	TestCaseDescription("This test should prove that the Read Memory diagnosis service");
	TestCaseDescription("for Camera Displacement/Lateral Offset (PID = 0x12) also");
	TestCaseDescription("works correctly with negative values for the camera displacement");



///////////////////////////////////////////////////////////////////////////////
//------------------------------ TEST STEPS -----------------------------------
///////////////////////////////////////////////////////////////////////////////


TestStep
("step 01"," Camera Displacement ");
    //----------------------
	//---- PRECONDITION ----
	//----------------------
    // set camera displacement in EEPROM to -0,5 m 
    v_UnlockArea81();
    v_Write_CCP(EE_ADDR_CameraDisplacement, 0x01, EEPROM);
    TesterPresent = 0;
    v_ResetECU();
    TestWaitForMessage(Dia_4F1h, TimeOut);
    TestWaitForTimeout(5000);


    //----------------------
	//----- TEST STEP ------
	//----------------------
    DiagnosticRequest.BYTE(0) = DiagnosticAddress;
    DiagnosticRequest.BYTE(1) = SID_ReadMemory;
    DiagnosticRequest.BYTE(2) = PID_CameraDisplacement;
    DiagnosticRequest.BYTE(3) = 0xFF;
    DiagnosticRequest.BYTE(4) = 0xFF;
    DiagnosticRequest.BYTE(5) = 0xFF;
    DiagnosticRequest.BYTE(6) = 0xFF;
    DiagnosticRequest.BYTE(7) = 0xFF;

    output(DiagnosticRequest);


    //-----------------------
	//--- EXPECTED RESULT ---
    //-----------------------
	if( 1 != TestWaitForMessage(Dia_4F1h, TimeOut) )
	{
	   TestStepFail("Diagnosis Response timed out");
	}
    // check response time
    if( 1 == TestResponseTime )
    {
       if( MaxResponseTime < GetResponseTime())
       {
          write("Time of request = %d ms", ResponseTime);
          TestStepFail("Max. response time exceeded");
       }
    }
    // check response content
    if(   ( DiagnosticAddress      != getSignal(Dia_4F1h::STA_DIAG_ANTWORT_TN) )
       || ( (SID_ReadMemory + 0x40)!= getSignal(Dia_4F1h::STA_DIAG_ANTWORT_B1) )
       || ( PID_CameraDisplacement != getSignal(Dia_4F1h::STA_DIAG_ANTWORT_B2) )
       || ( 0x32 != getSignal(Dia_4F1h::STA_DIAG_ANTWORT_B3) )
       || ( 0x80 != getSignal(Dia_4F1h::STA_DIAG_ANTWORT_B4) )
      )
    {
        TestStepFail("wrong message content");
    }


    //----------------------
	//--- POSTCONDITION ----
    //----------------------



///////////////////////////////////////////////////////////////////////////////
//------------------------------ TEST CASE END --------------------------------
///////////////////////////////////////////////////////////////////////////////
}
/*@@end*/

/*@@testcase:TC_132_ReadRollAngle_active():*/
testcase TC_132_ReadRollAngle_active ()
{
   //LOCALS


///////////////////////////////////////////////////////////////////////////////
//----------------------------- TEST CASE INFO --------------------------------
///////////////////////////////////////////////////////////////////////////////
	TestCaseTitle("ID_3448","4.13.13.2 - Read Roll Angle (active diagnosis)");
	TestCaseDescription("This test should prove that the Read Memory diagnosis service");
	TestCaseDescription("for Roll Angle - nominal also works correctly");
	TestCaseDescription("in the active diagnosis mode");



///////////////////////////////////////////////////////////////////////////////
//------------------------------ TEST STEPS -----------------------------------
///////////////////////////////////////////////////////////////////////////////


TestStep
("step 01"," Roll Angle ");
    //----------------------
	//---- PRECONDITION ----
	//----------------------
    v_SetActiveMode();
    TestWaitForMessage(Dia_4F1h, TimeOut);


    //----------------------
	//----- TEST STEP ------
	//----------------------
    DiagnosticRequest.BYTE(0) = DiagnosticAddress;
    DiagnosticRequest.BYTE(1) = SID_ReadMemory;
    DiagnosticRequest.BYTE(2) = PID_RollAngle;
    DiagnosticRequest.BYTE(3) = 0xFF;
    DiagnosticRequest.BYTE(4) = 0xFF;
    DiagnosticRequest.BYTE(5) = 0xFF;
    DiagnosticRequest.BYTE(6) = 0xFF;
    DiagnosticRequest.BYTE(7) = 0xFF;

    output(DiagnosticRequest);


    //-----------------------
	//--- EXPECTED RESULT ---
    //-----------------------
	if( 1 != TestWaitForMessage(Dia_4F1h, TimeOut) )
	{
	   TestStepFail("Diagnosis Response timed out");
	}
    // check response time
    if( 1 == TestResponseTime )
    {
       if( MaxResponseTime < GetResponseTime())
       {
          write("Time of request = %d ms", ResponseTime);
          TestStepFail("Max. response time exceeded");
       }
    }
    // check response content
    if(   ( DiagnosticAddress      != getSignal(Dia_4F1h::STA_DIAG_ANTWORT_TN) )
       || ( (SID_ReadMemory + 0x40)!= getSignal(Dia_4F1h::STA_DIAG_ANTWORT_B1) )
       || ( PID_RollAngle          != getSignal(Dia_4F1h::STA_DIAG_ANTWORT_B2) )
       || ( 0x00 != getSignal(Dia_4F1h::STA_DIAG_ANTWORT_B3) )
       || ( 0x00 != getSignal(Dia_4F1h::STA_DIAG_ANTWORT_B4) )
      )
    {
        TestStepFail("wrong message content");
    }


    //----------------------
	//--- POSTCONDITION ----
    //----------------------
    v_StopDiagnosis();
    TestWaitForMessage(Dia_4F1h, TimeOut);



///////////////////////////////////////////////////////////////////////////////
//------------------------------ TEST CASE END --------------------------------
///////////////////////////////////////////////////////////////////////////////
}
/*@@end*/

/*@@testcase:TC_133_ReadRollAngle_parametrization():*/
testcase TC_133_ReadRollAngle_parametrization ()
{
   //LOCALS


///////////////////////////////////////////////////////////////////////////////
//----------------------------- TEST CASE INFO --------------------------------
///////////////////////////////////////////////////////////////////////////////
	TestCaseTitle("ID_3446","4.13.13.2 - Read Roll Angle (parametrization mode)");
	TestCaseDescription("This test should prove that the Read Memory diagnosis service");
	TestCaseDescription("for Roll Angle - nominal also works correctly");
	TestCaseDescription("in the parametrization mode");



///////////////////////////////////////////////////////////////////////////////
//------------------------------ TEST STEPS -----------------------------------
///////////////////////////////////////////////////////////////////////////////


TestStep
("step 01"," Roll Angle ");
    //----------------------
	//---- PRECONDITION ----
	//----------------------
    v_SetParameterMode();
    TestWaitForMessage(Dia_4F1h, TimeOut);


    //----------------------
	//----- TEST STEP ------
	//----------------------
    DiagnosticRequest.BYTE(0) = DiagnosticAddress;
    DiagnosticRequest.BYTE(1) = SID_ReadMemory;
    DiagnosticRequest.BYTE(2) = PID_RollAngle;
    DiagnosticRequest.BYTE(3) = 0xFF;
    DiagnosticRequest.BYTE(4) = 0xFF;
    DiagnosticRequest.BYTE(5) = 0xFF;
    DiagnosticRequest.BYTE(6) = 0xFF;
    DiagnosticRequest.BYTE(7) = 0xFF;

    output(DiagnosticRequest);


    //-----------------------
	//--- EXPECTED RESULT ---
    //-----------------------
	if( 1 != TestWaitForMessage(Dia_4F1h, TimeOut) )
	{
	   TestStepFail("Diagnosis Response timed out");
	}
    // check response time
    if( 1 == TestResponseTime )
    {
       if( MaxResponseTime < GetResponseTime())
       {
          write("Time of request = %d ms", ResponseTime);
          TestStepFail("Max. response time exceeded");
       }
    }
    // check response content
    if(   ( DiagnosticAddress      != getSignal(Dia_4F1h::STA_DIAG_ANTWORT_TN) )
       || ( (SID_ReadMemory + 0x40)!= getSignal(Dia_4F1h::STA_DIAG_ANTWORT_B1) )
       || ( PID_RollAngle          != getSignal(Dia_4F1h::STA_DIAG_ANTWORT_B2) )
       || ( 0x00 != getSignal(Dia_4F1h::STA_DIAG_ANTWORT_B3) )
       || ( 0x00 != getSignal(Dia_4F1h::STA_DIAG_ANTWORT_B4) )
      )
    {
        TestStepFail("wrong message content");
    }


    //----------------------
	//--- POSTCONDITION ----
    //----------------------
    v_StopDiagnosis();
    TestWaitForMessage(Dia_4F1h, TimeOut);



///////////////////////////////////////////////////////////////////////////////
//------------------------------ TEST CASE END --------------------------------
///////////////////////////////////////////////////////////////////////////////
}
/*@@end*/

/*@@testcase:TC_134_ReadRollAngle_VDO():*/
testcase TC_134_ReadRollAngle_VDO ()
{
   //LOCALS


///////////////////////////////////////////////////////////////////////////////
//----------------------------- TEST CASE INFO --------------------------------
///////////////////////////////////////////////////////////////////////////////
	TestCaseTitle("ID_3447","4.13.13.2 - Read Roll Angle (VDO mode)");
	TestCaseDescription("This test should prove that the Read Memory diagnosis service");
	TestCaseDescription("for Roll Angle - nominal also works correctly");
	TestCaseDescription("in the VDO mode");



///////////////////////////////////////////////////////////////////////////////
//------------------------------ TEST STEPS -----------------------------------
///////////////////////////////////////////////////////////////////////////////


TestStep
("step 01"," Roll Angle ");
    //----------------------
	//---- PRECONDITION ----
	//----------------------
    v_SetVDOMode();
    TestWaitForMessage(Dia_4F1h, TimeOut);


    //----------------------
	//----- TEST STEP ------
	//----------------------
    DiagnosticRequest.BYTE(0) = DiagnosticAddress;
    DiagnosticRequest.BYTE(1) = SID_ReadMemory;
    DiagnosticRequest.BYTE(2) = PID_RollAngle;
    DiagnosticRequest.BYTE(3) = 0xFF;
    DiagnosticRequest.BYTE(4) = 0xFF;
    DiagnosticRequest.BYTE(5) = 0xFF;
    DiagnosticRequest.BYTE(6) = 0xFF;
    DiagnosticRequest.BYTE(7) = 0xFF;

    output(DiagnosticRequest);


    //-----------------------
	//--- EXPECTED RESULT ---
    //-----------------------
	if( 1 != TestWaitForMessage(Dia_4F1h, TimeOut) )
	{
	   TestStepFail("Diagnosis Response timed out");
	}
    // check response time
    if( 1 == TestResponseTime )
    {
       if( MaxResponseTime < GetResponseTime())
       {
          write("Time of request = %d ms", ResponseTime);
          TestStepFail("Max. response time exceeded");
       }
    }
    // check response content
    if(   ( DiagnosticAddress      != getSignal(Dia_4F1h::STA_DIAG_ANTWORT_TN) )
       || ( (SID_ReadMemory + 0x40)!= getSignal(Dia_4F1h::STA_DIAG_ANTWORT_B1) )
       || ( PID_RollAngle          != getSignal(Dia_4F1h::STA_DIAG_ANTWORT_B2) )
       || ( 0x00 != getSignal(Dia_4F1h::STA_DIAG_ANTWORT_B3) )
       || ( 0x00 != getSignal(Dia_4F1h::STA_DIAG_ANTWORT_B4) )
      )
    {
        TestStepFail("wrong message content");
    }


    //----------------------
	//--- POSTCONDITION ----
    //----------------------
    v_StopDiagnosis();
    TestWaitForMessage(Dia_4F1h, TimeOut);



///////////////////////////////////////////////////////////////////////////////
//------------------------------ TEST CASE END --------------------------------
///////////////////////////////////////////////////////////////////////////////
}
/*@@end*/

/*@@testcase:TC_135_ReadRollAngle_NegativeValue():*/
testcase TC_135_ReadRollAngle_NegativeValue ()
{
   //LOCALS
   byte EEPROM[1] = 0x00;

///////////////////////////////////////////////////////////////////////////////
//----------------------------- TEST CASE INFO --------------------------------
///////////////////////////////////////////////////////////////////////////////
	TestCaseTitle("ID_1008","4.13.13.5 - Read Roll Angle (negative value)");
	TestCaseDescription("This test should prove that the Read Memory diagnosis service");
	TestCaseDescription("for Roll Angle also works correctly for negative values");
	TestCaseDescription("for the roll angle.");



///////////////////////////////////////////////////////////////////////////////
//------------------------------ TEST STEPS -----------------------------------
///////////////////////////////////////////////////////////////////////////////


TestStep
("step 01"," Roll Angle ");
    //----------------------
	//---- PRECONDITION ----
	//----------------------
    // set nominal roll angle in EEPROM to -10° 
    v_UnlockArea81();
    v_Write_CCP(EE_ADDR_CameraRollAngle, 0x01, EEPROM);
    TesterPresent = 0;
    v_ResetECU();
    TestWaitForMessage(Dia_4F1h, TimeOut);
    TestWaitForTimeout(5000);

    //----------------------
	//----- TEST STEP ------
	//----------------------
    DiagnosticRequest.BYTE(0) = DiagnosticAddress;
    DiagnosticRequest.BYTE(1) = SID_ReadMemory;
    DiagnosticRequest.BYTE(2) = PID_RollAngle;
    DiagnosticRequest.BYTE(3) = 0xFF;
    DiagnosticRequest.BYTE(4) = 0xFF;
    DiagnosticRequest.BYTE(5) = 0xFF;
    DiagnosticRequest.BYTE(6) = 0xFF;
    DiagnosticRequest.BYTE(7) = 0xFF;

    output(DiagnosticRequest);


    //-----------------------
	//--- EXPECTED RESULT ---
    //-----------------------
	if( 1 != TestWaitForMessage(Dia_4F1h, TimeOut) )
	{
	   TestStepFail("Diagnosis Response timed out");
	}
    // check response time
    if( 1 == TestResponseTime )
    {
       if( MaxResponseTime < GetResponseTime())
       {
          write("Time of request = %d ms", ResponseTime);
          TestStepFail("Max. response time exceeded");
       }
    }
    // check response content
    if(   ( DiagnosticAddress      != getSignal(Dia_4F1h::STA_DIAG_ANTWORT_TN) )
       || ( (SID_ReadMemory + 0x40)!= getSignal(Dia_4F1h::STA_DIAG_ANTWORT_B1) )
       || ( PID_RollAngle          != getSignal(Dia_4F1h::STA_DIAG_ANTWORT_B2) )
       || ( 0x64 != getSignal(Dia_4F1h::STA_DIAG_ANTWORT_B3) )
       || ( 0x80 != getSignal(Dia_4F1h::STA_DIAG_ANTWORT_B4) )
      )
    {
        TestStepFail("wrong message content");
    }


    //----------------------
	//--- POSTCONDITION ----
    //----------------------




///////////////////////////////////////////////////////////////////////////////
//------------------------------ TEST CASE END --------------------------------
///////////////////////////////////////////////////////////////////////////////
}
/*@@end*/

/*@@testcase:TC_122_ReadPitchAngle_active():*/
testcase TC_122_ReadPitchAngle_active ()
{
   //LOCALS


///////////////////////////////////////////////////////////////////////////////
//----------------------------- TEST CASE INFO --------------------------------
///////////////////////////////////////////////////////////////////////////////
	TestCaseTitle("ID_3443","4.13.12.2 - Read Pitch Angle (active diagnosis)");
	TestCaseDescription("This test should prove that the Read Memory diagnosis service");
	TestCaseDescription("for the Pitch Angle - nominal also works correctly");
	TestCaseDescription("in the active diagnosis mode");



///////////////////////////////////////////////////////////////////////////////
//------------------------------ TEST STEPS -----------------------------------
///////////////////////////////////////////////////////////////////////////////


TestStep
("step 01"," Pitch Angle ");
    //----------------------
	//---- PRECONDITION ----
	//----------------------
     v_SetActiveMode();
    TestWaitForMessage(Dia_4F1h, TimeOut);
       

    //----------------------
	//----- TEST STEP ------
    DiagnosticRequest.BYTE(0) = DiagnosticAddress;
    DiagnosticRequest.BYTE(1) = SID_ReadMemory;
    DiagnosticRequest.BYTE(2) = PID_PitchAngle;
    DiagnosticRequest.BYTE(3) = 0xFF;
    DiagnosticRequest.BYTE(4) = 0xFF;
    DiagnosticRequest.BYTE(5) = 0xFF;
    DiagnosticRequest.BYTE(6) = 0xFF;
    DiagnosticRequest.BYTE(7) = 0xFF;

    output(DiagnosticRequest);


    //-----------------------
	//--- EXPECTED RESULT ---
    //-----------------------
	if( 1 != TestWaitForMessage(Dia_4F1h, TimeOut) )
	{
	   TestStepFail("Diagnosis Response timed out");
	}
    // check response time
    if( 1 == TestResponseTime )
    {
       if( MaxResponseTime < GetResponseTime())
       {
          write("Time of request = %d ms", ResponseTime);
          TestStepFail("Max. response time exceeded");
       }
    }
    // check response content
    if(   ( DiagnosticAddress      != getSignal(Dia_4F1h::STA_DIAG_ANTWORT_TN) )
       || ( (SID_ReadMemory + 0x40)!= getSignal(Dia_4F1h::STA_DIAG_ANTWORT_B1) )
       || ( PID_PitchAngle         != getSignal(Dia_4F1h::STA_DIAG_ANTWORT_B2) )
       || ( 0x7B != getSignal(Dia_4F1h::STA_DIAG_ANTWORT_B3) )
       || ( 0x00 != getSignal(Dia_4F1h::STA_DIAG_ANTWORT_B4) )

      )
    {
        TestStepFail("wrong message content");
    }


    //----------------------
	//--- POSTCONDITION ----
    //----------------------
    v_StopDiagnosis();
    TestWaitForMessage(Dia_4F1h, TimeOut);



///////////////////////////////////////////////////////////////////////////////
//------------------------------ TEST CASE END --------------------------------
///////////////////////////////////////////////////////////////////////////////
}
/*@@end*/

/*@@testcase:TC_123_ReadPitchAngle_parametrization():*/
testcase TC_123_ReadPitchAngle_parametrization ()
{
   //LOCALS


///////////////////////////////////////////////////////////////////////////////
//----------------------------- TEST CASE INFO --------------------------------
///////////////////////////////////////////////////////////////////////////////
	TestCaseTitle("ID_3444","4.13.12.3 - Read Pitch Angle (parametrization)");
	TestCaseDescription("This test should prove that the Read Memory diagnosis service");
	TestCaseDescription("for the Pitch Angle - nominal also works correctly");
	TestCaseDescription("in the parametrization mode");



///////////////////////////////////////////////////////////////////////////////
//------------------------------ TEST STEPS -----------------------------------
///////////////////////////////////////////////////////////////////////////////


TestStep
("step 01"," Pitch Angle ");
    //----------------------
	//---- PRECONDITION ----
	//----------------------
     v_SetParameterMode();
    TestWaitForMessage(Dia_4F1h, TimeOut);
       

    //----------------------
	//----- TEST STEP ------
    DiagnosticRequest.BYTE(0) = DiagnosticAddress;
    DiagnosticRequest.BYTE(1) = SID_ReadMemory;
    DiagnosticRequest.BYTE(2) = PID_PitchAngle;
    DiagnosticRequest.BYTE(3) = 0xFF;
    DiagnosticRequest.BYTE(4) = 0xFF;
    DiagnosticRequest.BYTE(5) = 0xFF;
    DiagnosticRequest.BYTE(6) = 0xFF;
    DiagnosticRequest.BYTE(7) = 0xFF;

    output(DiagnosticRequest);


    //-----------------------
	//--- EXPECTED RESULT ---
    //-----------------------
	if( 1 != TestWaitForMessage(Dia_4F1h, TimeOut) )
	{
	   TestStepFail("Diagnosis Response timed out");
	}
    // check response time
    if( 1 == TestResponseTime )
    {
       if( MaxResponseTime < GetResponseTime())
       {
          write("Time of request = %d ms", ResponseTime);
          TestStepFail("Max. response time exceeded");
       }
    }
    // check response content
    if(   ( DiagnosticAddress      != getSignal(Dia_4F1h::STA_DIAG_ANTWORT_TN) )
       || ( (SID_ReadMemory + 0x40)!= getSignal(Dia_4F1h::STA_DIAG_ANTWORT_B1) )
       || ( PID_PitchAngle         != getSignal(Dia_4F1h::STA_DIAG_ANTWORT_B2) )
       || ( 0x7B != getSignal(Dia_4F1h::STA_DIAG_ANTWORT_B3) )
       || ( 0x00 != getSignal(Dia_4F1h::STA_DIAG_ANTWORT_B4) )

      )
    {
        TestStepFail("wrong message content");
    }


    //----------------------
	//--- POSTCONDITION ----
    //----------------------
    v_StopDiagnosis();
    TestWaitForMessage(Dia_4F1h, TimeOut);



///////////////////////////////////////////////////////////////////////////////
//------------------------------ TEST CASE END --------------------------------
///////////////////////////////////////////////////////////////////////////////
}
/*@@end*/

/*@@testcase:TC_124_ReadPitchAngle_VDO():*/
testcase TC_124_ReadPitchAngle_VDO ()
{
   //LOCALS


///////////////////////////////////////////////////////////////////////////////
//----------------------------- TEST CASE INFO --------------------------------
///////////////////////////////////////////////////////////////////////////////
	TestCaseTitle("ID_3445","4.13.12.4 - Read Pitch Angle (VDO)");
	TestCaseDescription("This test should prove that the Read Memory diagnosis service");
	TestCaseDescription("for the Pitch Angle - nominal also works correctly");
	TestCaseDescription("in the VDO mode");



///////////////////////////////////////////////////////////////////////////////
//------------------------------ TEST STEPS -----------------------------------
///////////////////////////////////////////////////////////////////////////////


TestStep
("step 01"," Pitch Angle ");
    //----------------------
	//---- PRECONDITION ----
	//----------------------
     v_SetVDOMode();
    TestWaitForMessage(Dia_4F1h, TimeOut);
       

    //----------------------
	//----- TEST STEP ------
    DiagnosticRequest.BYTE(0) = DiagnosticAddress;
    DiagnosticRequest.BYTE(1) = SID_ReadMemory;
    DiagnosticRequest.BYTE(2) = PID_PitchAngle;
    DiagnosticRequest.BYTE(3) = 0xFF;
    DiagnosticRequest.BYTE(4) = 0xFF;
    DiagnosticRequest.BYTE(5) = 0xFF;
    DiagnosticRequest.BYTE(6) = 0xFF;
    DiagnosticRequest.BYTE(7) = 0xFF;

    output(DiagnosticRequest);


    //-----------------------
	//--- EXPECTED RESULT ---
    //-----------------------
	if( 1 != TestWaitForMessage(Dia_4F1h, TimeOut) )
	{
	   TestStepFail("Diagnosis Response timed out");
	}
    // check response time
    if( 1 == TestResponseTime )
    {
       if( MaxResponseTime < GetResponseTime())
       {
          write("Time of request = %d ms", ResponseTime);
          TestStepFail("Max. response time exceeded");
       }
    }
    // check response content
    if(   ( DiagnosticAddress      != getSignal(Dia_4F1h::STA_DIAG_ANTWORT_TN) )
       || ( (SID_ReadMemory + 0x40)!= getSignal(Dia_4F1h::STA_DIAG_ANTWORT_B1) )
       || ( PID_PitchAngle         != getSignal(Dia_4F1h::STA_DIAG_ANTWORT_B2) )
       || ( 0x7B != getSignal(Dia_4F1h::STA_DIAG_ANTWORT_B3) )
       || ( 0x00 != getSignal(Dia_4F1h::STA_DIAG_ANTWORT_B4) )

      )
    {
        TestStepFail("wrong message content");
    }


    //----------------------
	//--- POSTCONDITION ----
    //----------------------
    v_StopDiagnosis();
    TestWaitForMessage(Dia_4F1h, TimeOut);



///////////////////////////////////////////////////////////////////////////////
//------------------------------ TEST CASE END --------------------------------
///////////////////////////////////////////////////////////////////////////////
}
/*@@end*/

/*@@testcase:TC_125_ReadPitchAngle_NegativeValue():*/
testcase TC_125_ReadPitchAngle_NegativeValue ()
{
   //LOCALS
   byte EEPROM[1] = 0xFA;

///////////////////////////////////////////////////////////////////////////////
//----------------------------- TEST CASE INFO --------------------------------
///////////////////////////////////////////////////////////////////////////////
	TestCaseTitle("ID_1006","4.13.12.5 - Read Pitch Angle (negative value)");
	TestCaseDescription("This test should prove that the Read Memory diagnosis service");
	TestCaseDescription("for Pitch Angle - nominal also works correctly for");
	TestCaseDescription("negative values of the nominal pitch angle stored in EEPROM.");



///////////////////////////////////////////////////////////////////////////////
//------------------------------ TEST STEPS -----------------------------------
///////////////////////////////////////////////////////////////////////////////


TestStep
("step 01"," Pitch Angle ");
    //----------------------
	//---- PRECONDITION ----
	//----------------------
     // set nominal pitch angle in EEPROM to 5° 
    v_UnlockArea81();
    v_Write_CCP(EE_ADDR_CameraPitchAngle, 0x01, EEPROM);
    TesterPresent = 0;
    v_ResetECU();
    TestWaitForMessage(Dia_4F1h, TimeOut);
    TestWaitForTimeout(5000);
      

    //----------------------
	//----- TEST STEP ------
    DiagnosticRequest.BYTE(0) = DiagnosticAddress;
    DiagnosticRequest.BYTE(1) = SID_ReadMemory;
    DiagnosticRequest.BYTE(2) = PID_PitchAngle;
    DiagnosticRequest.BYTE(3) = 0xFF;
    DiagnosticRequest.BYTE(4) = 0xFF;
    DiagnosticRequest.BYTE(5) = 0xFF;
    DiagnosticRequest.BYTE(6) = 0xFF;
    DiagnosticRequest.BYTE(7) = 0xFF;

    output(DiagnosticRequest);


    //-----------------------
	//--- EXPECTED RESULT ---
    //-----------------------
	if( 1 != TestWaitForMessage(Dia_4F1h, TimeOut) )
	{
	   TestStepFail("Diagnosis Response timed out");
	}
    // check response time
    if( 1 == TestResponseTime )
    {
       if( MaxResponseTime < GetResponseTime())
       {
          write("Time of request = %d ms", ResponseTime);
          TestStepFail("Max. response time exceeded");
       }
    }
    // check response content
    if(   ( DiagnosticAddress      != getSignal(Dia_4F1h::STA_DIAG_ANTWORT_TN) )
       || ( (SID_ReadMemory + 0x40)!= getSignal(Dia_4F1h::STA_DIAG_ANTWORT_B1) )
       || ( PID_PitchAngle         != getSignal(Dia_4F1h::STA_DIAG_ANTWORT_B2) )
       || ( 0x32 != getSignal(Dia_4F1h::STA_DIAG_ANTWORT_B3) )
       || ( 0x80 != getSignal(Dia_4F1h::STA_DIAG_ANTWORT_B4) )

      )
    {
        TestStepFail("wrong message content");
    }


    //----------------------
	//--- POSTCONDITION ----
    //----------------------




///////////////////////////////////////////////////////////////////////////////
//------------------------------ TEST CASE END --------------------------------
///////////////////////////////////////////////////////////////////////////////
}
/*@@end*/

/*@@testcase:TC_142_ReadStartStateAfterIgnition_active():*/
testcase TC_142_ReadStartStateAfterIgnition_active ()
{
   //LOCALS


///////////////////////////////////////////////////////////////////////////////
//----------------------------- TEST CASE INFO --------------------------------
///////////////////////////////////////////////////////////////////////////////
	TestCaseTitle("ID_3449","4.13.14.2 - Read StartStateAfterIgnition (active diagnosis)");
	TestCaseDescription("This test should prove that the Read Memory diagnosis service");
	TestCaseDescription("for Start State After Ignition On also works correctly");
	TestCaseDescription("in the active diagnosis mode"); 


///////////////////////////////////////////////////////////////////////////////
//------------------------------ TEST STEPS -----------------------------------
///////////////////////////////////////////////////////////////////////////////


TestStep
("step 01"," Start State After Ignition ON ");
    //----------------------
	//---- PRECONDITION ----
	//----------------------
    v_SetActiveMode();
    TestWaitForMessage(Dia_4F1h, TimeOut);
      

    //----------------------
	//----- TEST STEP ------
	//----------------------
    DiagnosticRequest.BYTE(0) = DiagnosticAddress;
    DiagnosticRequest.BYTE(1) = SID_ReadMemory;
    DiagnosticRequest.BYTE(2) = PID_StartStateAfterIgnition;
    DiagnosticRequest.BYTE(3) = 0xFF;
    DiagnosticRequest.BYTE(4) = 0xFF;
    DiagnosticRequest.BYTE(5) = 0xFF;
    DiagnosticRequest.BYTE(6) = 0xFF;
    DiagnosticRequest.BYTE(7) = 0xFF;

    output(DiagnosticRequest);


    //-----------------------
	//--- EXPECTED RESULT ---
    //-----------------------
	if( 1 != TestWaitForMessage(Dia_4F1h, TimeOut) )
	{
	   TestStepFail("Diagnosis Response timed out");
	}
    // check response time
    if( 1 == TestResponseTime )
    {
       if( MaxResponseTime < GetResponseTime())
       {
          write("Time of request = %d ms", ResponseTime);
          TestStepFail("Max. response time exceeded");
       }
    }
    // check response content 
    if(   ( DiagnosticAddress          != getSignal(Dia_4F1h::STA_DIAG_ANTWORT_TN) )
       || ( (SID_ReadMemory + 0x40)    != getSignal(Dia_4F1h::STA_DIAG_ANTWORT_B1) )
       || ( PID_StartStateAfterIgnition!= getSignal(Dia_4F1h::STA_DIAG_ANTWORT_B2) )
       || ( 0xFD != getSignal(Dia_4F1h::STA_DIAG_ANTWORT_B3) )
      )
    {
        TestStepFail("wrong message content");
    }


    //----------------------
	//--- POSTCONDITION ----
    //----------------------
    v_StopDiagnosis();
    TestWaitForMessage(Dia_4F1h, TimeOut);



///////////////////////////////////////////////////////////////////////////////
//------------------------------ TEST CASE END --------------------------------
///////////////////////////////////////////////////////////////////////////////
}
/*@@end*/

/*@@testcase:TC_143_ReadStartStateAfterIgnition_parametrization():*/
testcase TC_143_ReadStartStateAfterIgnition_parametrization ()
{
   //LOCALS


///////////////////////////////////////////////////////////////////////////////
//----------------------------- TEST CASE INFO --------------------------------
///////////////////////////////////////////////////////////////////////////////
	TestCaseTitle("ID_3450","4.13.14.3 - Read StartStateAfterIgnition (parametrization mode)");
	TestCaseDescription("This test should prove that the Read Memory diagnosis service");
	TestCaseDescription("for Start State After Ignition On also works correctly");
	TestCaseDescription("in the parametrization mode"); 


///////////////////////////////////////////////////////////////////////////////
//------------------------------ TEST STEPS -----------------------------------
///////////////////////////////////////////////////////////////////////////////


TestStep
("step 01"," Start State After Ignition ON ");
    //----------------------
	//---- PRECONDITION ----
	//----------------------
    v_SetParameterMode();
    TestWaitForMessage(Dia_4F1h, TimeOut);
      

    //----------------------
	//----- TEST STEP ------
	//----------------------
    DiagnosticRequest.BYTE(0) = DiagnosticAddress;
    DiagnosticRequest.BYTE(1) = SID_ReadMemory;
    DiagnosticRequest.BYTE(2) = PID_StartStateAfterIgnition;
    DiagnosticRequest.BYTE(3) = 0xFF;
    DiagnosticRequest.BYTE(4) = 0xFF;
    DiagnosticRequest.BYTE(5) = 0xFF;
    DiagnosticRequest.BYTE(6) = 0xFF;
    DiagnosticRequest.BYTE(7) = 0xFF;

    output(DiagnosticRequest);


    //-----------------------
	//--- EXPECTED RESULT ---
    //-----------------------
	if( 1 != TestWaitForMessage(Dia_4F1h, TimeOut) )
	{
	   TestStepFail("Diagnosis Response timed out");
	}
    // check response time
    if( 1 == TestResponseTime )
    {
       if( MaxResponseTime < GetResponseTime())
       {
          write("Time of request = %d ms", ResponseTime);
          TestStepFail("Max. response time exceeded");
       }
    }
    // check response content 
    if(   ( DiagnosticAddress          != getSignal(Dia_4F1h::STA_DIAG_ANTWORT_TN) )
       || ( (SID_ReadMemory + 0x40)    != getSignal(Dia_4F1h::STA_DIAG_ANTWORT_B1) )
       || ( PID_StartStateAfterIgnition!= getSignal(Dia_4F1h::STA_DIAG_ANTWORT_B2) )
       || ( 0xFD != getSignal(Dia_4F1h::STA_DIAG_ANTWORT_B3) )
      )
    {
        TestStepFail("wrong message content");
    }


    //----------------------
	//--- POSTCONDITION ----
    //----------------------
    v_StopDiagnosis();
    TestWaitForMessage(Dia_4F1h, TimeOut);



///////////////////////////////////////////////////////////////////////////////
//------------------------------ TEST CASE END --------------------------------
///////////////////////////////////////////////////////////////////////////////
}
/*@@end*/

/*@@testcase:TC_144_ReadStartStateAfterIgnition_VDO():*/
testcase TC_144_ReadStartStateAfterIgnition_VDO ()
{
   //LOCALS


///////////////////////////////////////////////////////////////////////////////
//----------------------------- TEST CASE INFO --------------------------------
///////////////////////////////////////////////////////////////////////////////
	TestCaseTitle("ID_3451","4.13.14.4 - Read StartStateAfterIgnition (VDO mode)");
	TestCaseDescription("This test should prove that the Read Memory diagnosis service");
	TestCaseDescription("for Start State After Ignition On also works correctly");
	TestCaseDescription("in the VDO mode"); 


///////////////////////////////////////////////////////////////////////////////
//------------------------------ TEST STEPS -----------------------------------
///////////////////////////////////////////////////////////////////////////////


TestStep
("step 01"," Start State After Ignition ON ");
    //----------------------
	//---- PRECONDITION ----
	//----------------------
    v_SetVDOMode();
    TestWaitForMessage(Dia_4F1h, TimeOut);
      

    //----------------------
	//----- TEST STEP ------
	//----------------------
    DiagnosticRequest.BYTE(0) = DiagnosticAddress;
    DiagnosticRequest.BYTE(1) = SID_ReadMemory;
    DiagnosticRequest.BYTE(2) = PID_StartStateAfterIgnition;
    DiagnosticRequest.BYTE(3) = 0xFF;
    DiagnosticRequest.BYTE(4) = 0xFF;
    DiagnosticRequest.BYTE(5) = 0xFF;
    DiagnosticRequest.BYTE(6) = 0xFF;
    DiagnosticRequest.BYTE(7) = 0xFF;

    output(DiagnosticRequest);


    //-----------------------
	//--- EXPECTED RESULT ---
    //-----------------------
	if( 1 != TestWaitForMessage(Dia_4F1h, TimeOut) )
	{
	   TestStepFail("Diagnosis Response timed out");
	}
    // check response time
    if( 1 == TestResponseTime )
    {
       if( MaxResponseTime < GetResponseTime())
       {
          write("Time of request = %d ms", ResponseTime);
          TestStepFail("Max. response time exceeded");
       }
    }
    // check response content 
    if(   ( DiagnosticAddress          != getSignal(Dia_4F1h::STA_DIAG_ANTWORT_TN) )
       || ( (SID_ReadMemory + 0x40)    != getSignal(Dia_4F1h::STA_DIAG_ANTWORT_B1) )
       || ( PID_StartStateAfterIgnition!= getSignal(Dia_4F1h::STA_DIAG_ANTWORT_B2) )
       || ( 0xFD != getSignal(Dia_4F1h::STA_DIAG_ANTWORT_B3) )
      )
    {
        TestStepFail("wrong message content");
    }


    //----------------------
	//--- POSTCONDITION ----
    //----------------------
    v_StopDiagnosis();
    TestWaitForMessage(Dia_4F1h, TimeOut);



///////////////////////////////////////////////////////////////////////////////
//------------------------------ TEST CASE END --------------------------------
///////////////////////////////////////////////////////////////////////////////
}
/*@@end*/

/*@@testcase:TC_152_ReadMuteEnable_active():*/
testcase TC_152_ReadMuteEnable_active ()
{
   //LOCALS


///////////////////////////////////////////////////////////////////////////////
//----------------------------- TEST CASE INFO --------------------------------
///////////////////////////////////////////////////////////////////////////////
	TestCaseTitle("ID_3452","4.13.15.2 - Read Mute Enable (active diagnosis)");
	TestCaseDescription("This test should prove that the Read Memory diagnosis service");
	TestCaseDescription("for Mute Enable also works correctly in the active diagnosis mode");


///////////////////////////////////////////////////////////////////////////////
//------------------------------ TEST STEPS -----------------------------------
///////////////////////////////////////////////////////////////////////////////


TestStep
("step 01"," Mute Enable/Disable ");
    //----------------------
	//---- PRECONDITION ----
	//----------------------
    v_SetActiveMode();
    TestWaitForMessage(Dia_4F1h, TimeOut);  

    //----------------------
	//----- TEST STEP ------
	//----------------------
    DiagnosticRequest.BYTE(0) = DiagnosticAddress;
    DiagnosticRequest.BYTE(1) = SID_ReadMemory;
    DiagnosticRequest.BYTE(2) = PID_MuteEnable;
    DiagnosticRequest.BYTE(3) = 0xFF;
    DiagnosticRequest.BYTE(4) = 0xFF;
    DiagnosticRequest.BYTE(5) = 0xFF;
    DiagnosticRequest.BYTE(6) = 0xFF;
    DiagnosticRequest.BYTE(7) = 0xFF;

    output(DiagnosticRequest);


    //-----------------------
	//--- EXPECTED RESULT ---
    //-----------------------
	if( 1 != TestWaitForMessage(Dia_4F1h, TimeOut) )
	{
	   TestStepFail("Diagnosis Response timed out");
	}
    // check response time
    if( 1 == TestResponseTime )
    {
       if( MaxResponseTime < GetResponseTime())
       {
          write("Time of request = %d ms", ResponseTime);
          TestStepFail("Max. response time exceeded");
       }
    }
    // check response content 
    if(   ( DiagnosticAddress      != getSignal(Dia_4F1h::STA_DIAG_ANTWORT_TN) )
       || ( (SID_ReadMemory + 0x40)!= getSignal(Dia_4F1h::STA_DIAG_ANTWORT_B1) )
       || ( PID_MuteEnable         != getSignal(Dia_4F1h::STA_DIAG_ANTWORT_B2) )
       || ( 0xFD != getSignal(Dia_4F1h::STA_DIAG_ANTWORT_B3) )
      )
    {
        TestStepFail("wrong message content");
    }


    //----------------------
	//--- POSTCONDITION ----
    //----------------------
    v_StopDiagnosis();
    TestWaitForMessage(Dia_4F1h, TimeOut);



///////////////////////////////////////////////////////////////////////////////
//------------------------------ TEST CASE END --------------------------------
///////////////////////////////////////////////////////////////////////////////
}
/*@@end*/

/*@@testcase:TC_153_ReadMuteEnable_parametrization():*/
testcase TC_153_ReadMuteEnable_parametrization ()
{
   //LOCALS


///////////////////////////////////////////////////////////////////////////////
//----------------------------- TEST CASE INFO --------------------------------
///////////////////////////////////////////////////////////////////////////////
	TestCaseTitle("ID_3453","4.13.15.3 - Read Mute Enable (parametrization)");
	TestCaseDescription("This test should prove that the Read Memory diagnosis service");
	TestCaseDescription("for Mute Enable also works correctly in the parametrization mode");


///////////////////////////////////////////////////////////////////////////////
//------------------------------ TEST STEPS -----------------------------------
///////////////////////////////////////////////////////////////////////////////


TestStep
("step 01"," Mute Enable/Disable ");
    //----------------------
	//---- PRECONDITION ----
	//----------------------
    v_SetParameterMode();
    TestWaitForMessage(Dia_4F1h, TimeOut);  

    //----------------------
	//----- TEST STEP ------
	//----------------------
    DiagnosticRequest.BYTE(0) = DiagnosticAddress;
    DiagnosticRequest.BYTE(1) = SID_ReadMemory;
    DiagnosticRequest.BYTE(2) = PID_MuteEnable;
    DiagnosticRequest.BYTE(3) = 0xFF;
    DiagnosticRequest.BYTE(4) = 0xFF;
    DiagnosticRequest.BYTE(5) = 0xFF;
    DiagnosticRequest.BYTE(6) = 0xFF;
    DiagnosticRequest.BYTE(7) = 0xFF;

    output(DiagnosticRequest);


    //-----------------------
	//--- EXPECTED RESULT ---
    //-----------------------
	if( 1 != TestWaitForMessage(Dia_4F1h, TimeOut) )
	{
	   TestStepFail("Diagnosis Response timed out");
	}
    // check response time
    if( 1 == TestResponseTime )
    {
       if( MaxResponseTime < GetResponseTime())
       {
          write("Time of request = %d ms", ResponseTime);
          TestStepFail("Max. response time exceeded");
       }
    }
    // check response content 
    if(   ( DiagnosticAddress      != getSignal(Dia_4F1h::STA_DIAG_ANTWORT_TN) )
       || ( (SID_ReadMemory + 0x40)!= getSignal(Dia_4F1h::STA_DIAG_ANTWORT_B1) )
       || ( PID_MuteEnable         != getSignal(Dia_4F1h::STA_DIAG_ANTWORT_B2) )
       || ( 0xFD != getSignal(Dia_4F1h::STA_DIAG_ANTWORT_B3) )
      )
    {
        TestStepFail("wrong message content");
    }


    //----------------------
	//--- POSTCONDITION ----
    //----------------------
    v_StopDiagnosis();
    TestWaitForMessage(Dia_4F1h, TimeOut);



///////////////////////////////////////////////////////////////////////////////
//------------------------------ TEST CASE END --------------------------------
///////////////////////////////////////////////////////////////////////////////
}
/*@@end*/

/*@@testcase:TC_154_ReadMuteEnable_VDO():*/
testcase TC_154_ReadMuteEnable_VDO ()
{
   //LOCALS


///////////////////////////////////////////////////////////////////////////////
//----------------------------- TEST CASE INFO --------------------------------
///////////////////////////////////////////////////////////////////////////////
	TestCaseTitle("ID_3454","4.13.15.4 - Read Mute Enable (VDO)");
	TestCaseDescription("This test should prove that the Read Memory diagnosis service");
	TestCaseDescription("for Mute Enable also works correctly in the VDO mode");


///////////////////////////////////////////////////////////////////////////////
//------------------------------ TEST STEPS -----------------------------------
///////////////////////////////////////////////////////////////////////////////


TestStep
("step 01"," Mute Enable/Disable ");
    //----------------------
	//---- PRECONDITION ----
	//----------------------
    v_SetVDOMode();
    TestWaitForMessage(Dia_4F1h, TimeOut);  

    //----------------------
	//----- TEST STEP ------
	//----------------------
    DiagnosticRequest.BYTE(0) = DiagnosticAddress;
    DiagnosticRequest.BYTE(1) = SID_ReadMemory;
    DiagnosticRequest.BYTE(2) = PID_MuteEnable;
    DiagnosticRequest.BYTE(3) = 0xFF;
    DiagnosticRequest.BYTE(4) = 0xFF;
    DiagnosticRequest.BYTE(5) = 0xFF;
    DiagnosticRequest.BYTE(6) = 0xFF;
    DiagnosticRequest.BYTE(7) = 0xFF;

    output(DiagnosticRequest);


    //-----------------------
	//--- EXPECTED RESULT ---
    //-----------------------
	if( 1 != TestWaitForMessage(Dia_4F1h, TimeOut) )
	{
	   TestStepFail("Diagnosis Response timed out");
	}
    // check response time
    if( 1 == TestResponseTime )
    {
       if( MaxResponseTime < GetResponseTime())
       {
          write("Time of request = %d ms", ResponseTime);
          TestStepFail("Max. response time exceeded");
       }
    }
    // check response content 
    if(   ( DiagnosticAddress      != getSignal(Dia_4F1h::STA_DIAG_ANTWORT_TN) )
       || ( (SID_ReadMemory + 0x40)!= getSignal(Dia_4F1h::STA_DIAG_ANTWORT_B1) )
       || ( PID_MuteEnable         != getSignal(Dia_4F1h::STA_DIAG_ANTWORT_B2) )
       || ( 0xFD != getSignal(Dia_4F1h::STA_DIAG_ANTWORT_B3) )
      )
    {
        TestStepFail("wrong message content");
    }


    //----------------------
	//--- POSTCONDITION ----
    //----------------------
    v_StopDiagnosis();
    TestWaitForMessage(Dia_4F1h, TimeOut);



///////////////////////////////////////////////////////////////////////////////
//------------------------------ TEST CASE END --------------------------------
///////////////////////////////////////////////////////////////////////////////
}
/*@@end*/

