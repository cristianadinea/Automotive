/*@@var:*/
variables
{

dword gCycCheckId;

dword glbHandle = 0; //file handle
long resWait;

byte byte0RQ;
byte byte1RQ;
byte byte0R;
byte byte1R;
byte byte2R;
byte byte0;

MESSAGE TEST_MSG_ENGINE_REQ msgengReq;
MESSAGE TEST_MSG_ENGINE_RES msgengRes;


}
/*@@end*/

/*@@mainTest:MainTest():*/
void MainTest()
{
  
  
   write("*****************************");
   write(" Engine Validation Test");
   write("*****************************");
   write(" ");


  TestGroupBegin("Message Read", "Check the engine ID and RPM");
    
     TestCase2();
  
  TestGroupEnd(); 


}
/*@@end*/

/*@@msg:CAN1.flfcrd_test1_db::TEST_MSG_ENGINE_RES (0x50):*/
on message TEST_MSG_ENGINE_RES
{

msgengRes=this;

}
/*@@end*/

/*@@testcase:TestCase2():*/
testcase TestCase2()
{

 byte byte0RQ;
 byte byte1RQ;
 byte byte0R;
 byte byte1R;
 byte byte2R;
 byte byte0;
 dword byte23;

 TestCaseTitle("ID_2","1.2 - Read Engine RPM -");
 TestCaseDescription("Read is available in any session ");
  
 ///////////////////////////////////////////////////////////////////////////////
 //------------------------------ TEST STEPS -----------------------------------
 ///////////////////////////////////////////////////////////////////////////////


 //TestStep("step 01"," Negative response not alloowed ");
    
 //----------------------
 //---- PRECONDITION ---- 
 //----------------------
    

 //----------------------
 //----- TEST STEP ------
 //----------------------
 
   msgengReq.byte(0)=0x022;
   msgengReq.byte(1)=0x002;
   msgengReq.byte(2)=0x000;
   msgengReq.byte(3)=0x000;
   msgengReq.byte(4)=0x000;
   msgengReq.byte(5)=0x000; 
   msgengReq.byte(6)=0x000;
   msgengReq.byte(7)=0x000;
   msgengReq.can=1;
   output(msgengReq);

   //TestWaitForMessage(80, 15000);
   //-----------------------
   //--- EXPECTED RESULT ---
   //-----------------------
    
	if( 1 != TestWaitForMessage(80, 10000) )
	{
	   TestStepFail("Diagnosis Response timed out");
	}

    else
    {

    byte0R = msgengRes.BYTE(0);
    byte2R = msgengRes.BYTE(2);
    byte23 = msgengRes.dword(2);

    write("-----------------------------------------------TEST CASE 2 -------------------------------------------------------------------");
    write("MESSAGE REQUEST FROM TEST id %x byte0 %X  byte1 %X ",msgengReq.ID,msgengReq.byte(0),msgengReq.byte(1));
    write("MESSAGE RESPONSE FROM TEST id %x byte2 %x  byte3 %x  byte 23 %d",msgengRes.ID,msgengRes.byte(2),byte2R,byte23);
    write("-----------------------------------------------------------------------------------------------------------------------");

    // check response time
//    if( 1 == TestResponseTime )
//    {
//       if( MaxResponseTime < GetResponseTime())
//       {
//          write("Time of request = %d ms", ResponseTime);
//          TestStepFail("Max. response time exceeded");
//       }
//    }
    // check response content
  
    if(byte0R == 0x062) //pos resp
   { 
    if(msgengRes.word(2)< 7000) //upper limit for engine rpm
        { write(" RPM value within the normal limits");
          testStepPass("RPM value within the normal limits");
        }
    else
        {
         write("RPM value outside the normal limits");
         testStepFail("RPM value outside the normal limits");
        }
    }
  else
    { 
     write("Neg resp not  allowed ");
     testStepFail("Neg resp not  allowed");
  }

}

 //----------------------
 //--- POSTCONDITION ----
 //----------------------


///////////////////////////////////////////////////////////////////////////////
//------------------------------ TEST CASE END --------------------------------
///////////////////////////////////////////////////////////////////////////////


}
/*@@end*/

